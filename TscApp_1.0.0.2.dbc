VERSION ""

NS_ :

BS_:

BU_: SampleEcu T6APD

BO_ 2566834768 DM01: 26 T6APD
 SG_ SPN_DTC3 : 80|19@1+ (1,0) [0|0] "" Vector__XXX
 SG_ SPN_DTC2 : 48|19@1+ (1,0) [0|0] "" Vector__XXX
 SG_ FlashAmberWarningLamp : 10|2@1+ (1,0) [0|3] "" Vector__XXX
 SG_ AmberWarningLamp : 2|2@1+ (1,0) [0|3] "" Vector__XXX
 SG_ OC_DTC1 : 40|7@1+ (1,0) [0|0] "" Vector__XXX
 SG_ FMI_DTC1 : 35|5@1+ (1,0) [0|0] "" Vector__XXX
 SG_ SPN_DTC1 : 16|19@1+ (1,0) [0|0] "" Vector__XXX
 SG_ FlashRedStopLamp : 12|2@1+ (1,0) [0|3] "" Vector__XXX
 SG_ FlashProtectLamp : 8|2@1+ (1,0) [0|3] "" Vector__XXX
 SG_ FlashMalfuncIndicatorLamp : 14|2@1+ (1,0) [0|3] "" Vector__XXX
 SG_ RedStopLampState : 4|2@1+ (1,0) [0|3] "" Vector__XXX
 SG_ ProtectLampStatus : 0|2@1+ (1,0) [0|3] "" Vector__XXX

BO_ 2565799504 AC: 8 T6APD
 SG_ ArbitraryAddressCapable : 63|1@1+ (1,0) [0|1] "" Vector__XXX
 SG_ IndustryGroup M : 60|3@1+ (1,0) [0|7] "" Vector__XXX
 SG_ VehicleSystemInstance : 56|4@1+ (1,0) [0|15] "" Vector__XXX
 SG_ Function : 40|8@1+ (1,0) [0|255] "" Vector__XXX
 SG_ FunctionInstance : 35|5@1+ (1,0) [0|31] "" Vector__XXX
 SG_ ECUInstance : 32|3@1+ (1,0) [0|7] "" Vector__XXX
 SG_ ManufacturerCode : 21|11@1+ (1,0) [0|2047] "" Vector__XXX
 SG_ IdentityNumber : 0|21@1+ (1,0) [0|2097152] "" Vector__XXX
 SG_ VehicleSystem m0 : 49|7@1+ (1,0) [0|127] "" Vector__XXX
 SG_ VehicleSystem5 m5 : 49|7@1+ (1,0) [0|127] "" Vector__XXX
 SG_ VehicleSystem4 m4 : 49|7@1+ (1,0) [0|127] "" Vector__XXX
 SG_ VehicleSystem3 m3 : 49|7@1+ (1,0) [0|127] "" Vector__XXX
 SG_ VehicleSystem2 m2 : 49|7@1+ (1,0) [0|127] "" Vector__XXX
 SG_ VehicleSystem1 m1 : 49|7@1+ (1,0) [0|127] "" Vector__XXX

BO_ 2565602896 TPDT: 8 T6APD
 SG_ SequenceNumber : 0|8@1+ (1,0) [0|255] "" Vector__XXX

BO_ 2565668432 TPCMxx: 8 T6APD
 SG_ TotalNumberOfPacketsEoMA : 24|8@1+ (1,0) [0|255] "" Vector__XXX
 SG_ TotalNumberOfPackets : 24|8@1+ (1,0) [0|255] "" Vector__XXX
 SG_ TotalMessageSize : 8|16@1+ (1,0) [0|64255] "" Vector__XXX
 SG_ TotalMessageSizeEoMA : 8|16@1+ (1,0) [0|64255] "" Vector__XXX
 SG_ NextPacketNumberToBeSent : 16|8@1+ (1,0) [0|255] "" Vector__XXX
 SG_ TotalMessageSizeBAM : 8|16@1+ (1,0) [0|64255] "" Vector__XXX
 SG_ TotalNumberOfPacketsBAM : 24|8@1+ (1,0) [0|255] "" Vector__XXX
 SG_ PGNumber : 40|24@1+ (1,0) [0|16777200] "" Vector__XXX
 SG_ MaximumNumberOfPackets : 32|8@1+ (1,0) [0|255] "" Vector__XXX

CM_ SG_ 2566834768 FlashRedStopLamp "This parameter provides the capability to flash the RSL


00 - Slow Flash (1 Hz, 50 % duty cycle)
01 - Fast Flash (2 Hz or faster, 50% duty cycle)
10 - Reserved
11 - Unavailable / Do Not Flash";
CM_ SG_ 2566834768 FlashProtectLamp "This parameter provides the capability to flash the engine protect lamp


00 - Slow Flash (1 Hz, 50 % duty cycle)
01 - Fast Flash (2 Hz or faster, 50% duty cycle)
10 - Reserved
11 - Unavailable / Do Not Flash";
CM_ SG_ 2566834768 FlashMalfuncIndicatorLamp "This parameter provides the capability to flash the MIL
00 - Slow Flash (1 Hz, 50 % duty cycle)
01 - Fast Flash (2 Hz or faster, 50% duty cycle)
10 - Class C DTC
11 - Unavailable / Do Not Flash
Note:  State 10 is for WWH OBD discriminatory ...";
CM_ SG_ 2566834768 RedStopLampState "This lamp is used to relay trouble code information that is of a severe enough condition that it warrants stopping the vehicle.

00     Lamp Off
01     Lamp On
10     Reserved
11     Not available";
CM_ SG_ 2566834768 ProtectLampStatus "This lamp is used to relay trouble code information that is reporting a problem with a vehicle system that is most probably not electronic subsystem related. For instance, engine coolant temperature is exceeding its prescribed temperature range.
00 ...";
CM_ BO_ 2565799504 "Address Claimed
Message used to claim an address for a Controller Application.";
CM_ SG_ 2565799504 IndustryGroup "0 = Global; 
   1  = On-Highway; 
   2  = Agricultural and Forestry; 
   3  = Construction; 
   4  = Marine;
   5  = Industrial - Process
          Control - Stationary (Gen-Sets)
   6  = Reserve for SAE
   7  = Reserve for SAE";
CM_ SG_ 2565799504 ManufacturerCode "Assigned by NMEA 2000 Committee";
CM_ BO_ 2565602896 "Transport Protocol - Data Transfer
Used for the transfer of data associated with Parameter Groups that have more than 8 bytes of data.";
CM_ SG_ 2565602896 SequenceNumber "Sequence Number (TP.DT)";
CM_ BO_ 2565668432 "Transport Protocol - Connection Mgmt
Used for the transfer of Parameter Groups that have 9 or more bytes of data.";
CM_ SG_ 2565668432 TotalNumberOfPacketsEoMA "Total number of packets received for RTS/CTS message.  Zero and one are not valid values.";
CM_ SG_ 2565668432 TotalNumberOfPackets "Total number of packets for RTS/CTS message.  Zero and one are not valid values.";
CM_ SG_ 2565668432 TotalMessageSize "Total message size (in bytes) for RTS/CTS message.  Messages shorter than 9 data bytes should be sent without utilizing the transport protocol.  Messages longer than 1785 can not use the RTS/CTS transport protocol.";
CM_ SG_ 2565668432 TotalMessageSizeEoMA "Total message size (in bytes) received for RTS/CTS message.  Messages shorter than 9 data bytes should be sent without utilizing the transport protocol.  Messages longer than 1785 can not use the RTS/CTS transport protocol.";
CM_ SG_ 2565668432 NextPacketNumberToBeSent "Next Packet Number to be sent (TP.CM_CTS)";
CM_ SG_ 2565668432 TotalMessageSizeBAM "Total message size (in bytes) for BAM  message.  Messages shorter than 9 data bytes should be sent without utilizing the transport protocol.  Messages longer than 1785 can not use the BAM transport protocol.";
CM_ SG_ 2565668432 TotalNumberOfPacketsBAM "Total number of packets for BAM message.  Zero and one are not valid values.";
CM_ SG_ 2565668432 PGNumber "Requested PGN in the TP.CM_RTS message";
CM_ SG_ 2565668432 MaximumNumberOfPackets "Maximum number of packets for RTS/CTS message.  zero through four are not allowed";
BA_DEF_ SG_  "SigType" ENUM  "Default","Range","RangeSigned","ASCII","Discrete","Control","ReferencePGN","DTC","StringDelimiter","StringLength","StringLengthControl","MessageCounter","MessageChecksum";
BA_DEF_ SG_  "GenSigStartValue" INT 0 2147483647;
BA_DEF_ SG_  "GenSigSendType" ENUM  "Cyclic","OnWrite","OnWriteWithRepetition","OnChange","OnChangeWithRepetition","IfActive","IfActiveWithRepetition","NoSigSendType";
BA_DEF_ SG_  "GenSigILSupport" ENUM  "No","Yes";
BA_DEF_ SG_  "GenSigEVName" STRING ;
BA_DEF_ SG_  "SPN" INT 0 524287;
BA_DEF_ BO_  "TpJ1939VarDlc" ENUM  "No","Yes";
BA_DEF_ BO_  "GenMsgILSupport" ENUM  "No","Yes";
BA_DEF_ BO_  "GenMsgRequestable" INT 0 1;
BA_DEF_ BO_  "GenMsgSendType" ENUM  "cyclic","NotUsed","NotUsed","NotUsed","NotUsed","NotUsed","NotUsed","IfActive","noMsgSendType";
BA_DEF_ BO_  "VFrameFormat" ENUM  "StandardCAN","ExtendedCAN","reserved","J1939PG";
BA_DEF_ BO_  "GenMsgCycleTime" INT 0 3600000;
BA_DEF_DEF_  "SigType" "Default";
BA_DEF_DEF_  "GenSigStartValue" 0;
BA_DEF_DEF_  "GenSigSendType" "NoSigSendType";
BA_DEF_DEF_  "GenSigILSupport" "Yes";
BA_DEF_DEF_  "GenSigEVName" "Env@Nodename_@Signame";
BA_DEF_DEF_  "SPN" 0;
BA_DEF_DEF_  "TpJ1939VarDlc" "No";
BA_DEF_DEF_  "GenMsgILSupport" "Yes";
BA_DEF_DEF_  "GenMsgRequestable" 1;
BA_DEF_DEF_  "GenMsgSendType" "noMsgSendType";
BA_DEF_DEF_  "VFrameFormat" "J1939PG";
BA_DEF_DEF_  "GenMsgCycleTime" 0;
BA_ "GenMsgRequestable" BO_ 2565602896 0;
BA_ "GenMsgRequestable" BO_ 2565668432 0;
BA_ "SPN" SG_ 2566834768 FlashRedStopLamp 3039;
BA_ "SigType" SG_ 2566834768 FlashRedStopLamp 5;
BA_ "SPN" SG_ 2566834768 FlashProtectLamp 3041;
BA_ "SigType" SG_ 2566834768 FlashProtectLamp 5;
BA_ "SPN" SG_ 2566834768 FlashMalfuncIndicatorLamp 3038;
BA_ "SigType" SG_ 2566834768 FlashMalfuncIndicatorLamp 5;
BA_ "SPN" SG_ 2566834768 RedStopLampState 623;
BA_ "SigType" SG_ 2566834768 RedStopLampState 4;
BA_ "SPN" SG_ 2566834768 ProtectLampStatus 987;
BA_ "SigType" SG_ 2566834768 ProtectLampStatus 5;
BA_ "SPN" SG_ 2565799504 ArbitraryAddressCapable 2844;
BA_ "SPN" SG_ 2565799504 IndustryGroup 2846;
BA_ "SPN" SG_ 2565799504 VehicleSystemInstance 2843;
BA_ "SPN" SG_ 2565799504 Function 2841;
BA_ "SPN" SG_ 2565799504 FunctionInstance 2839;
BA_ "SPN" SG_ 2565799504 ECUInstance 2840;
BA_ "SPN" SG_ 2565799504 ManufacturerCode 2838;
BA_ "SigType" SG_ 2565799504 ManufacturerCode 1;
BA_ "SPN" SG_ 2565799504 IdentityNumber 2837;
BA_ "SPN" SG_ 2565602896 SequenceNumber 2572;
BA_ "SPN" SG_ 2565668432 TotalNumberOfPacketsEoMA 2565;
BA_ "SPN" SG_ 2565668432 TotalNumberOfPackets 2558;
BA_ "SPN" SG_ 2565668432 TotalMessageSize 2557;
BA_ "SigType" SG_ 2565668432 TotalMessageSize 1;
BA_ "SPN" SG_ 2565668432 TotalMessageSizeEoMA 2564;
BA_ "SigType" SG_ 2565668432 TotalMessageSizeEoMA 1;
BA_ "SPN" SG_ 2565668432 NextPacketNumberToBeSent 2562;
BA_ "SPN" SG_ 2565668432 TotalMessageSizeBAM 2567;
BA_ "SigType" SG_ 2565668432 TotalMessageSizeBAM 1;
BA_ "SPN" SG_ 2565668432 TotalNumberOfPacketsBAM 2568;
BA_ "SPN" SG_ 2565668432 PGNumber 2560;
BA_ "SigType" SG_ 2565668432 PGNumber 6;
BA_ "SPN" SG_ 2565668432 MaximumNumberOfPackets 2559;
VAL_ 2566834768 SPN_DTC3 0 "No Error" 517290 "MCU Node 0, No Error" 517291 "MCU Node 0, No configuration file found" 517292 "MCU Node 0, Invalid J1939 license" 517293 "MCU Node 0, Error downloading configuration file" 517294 "MCU Node 0, Overload protection active" 517295 "MCU Node 0, Invalid app selection" 517296 "MCU Node 0, Overload warning active" 518000 "DCU Node 1, No Error" 518001 "DCU Node 1, status not available" 518002 "DCU Node 1, status not available" 518003 "DCU Node 1, Error, Overcurrent Power Unit" 518004 "DCU Node 1, Error, Overcurrent Analog" 518005 "DCU Node 1, Error, Overvoltage DC Link" 518006 "DCU Node 1, Error, Undervoltage DC Link" 518007 "DCU Node 1, Error, Overload" 518008 "DCU Node 1, Reset Error, Overload" 518009 "DCU Node 1, Error, Overload 02" 518010 "DCU Node 1, Error, Power Module Overheat" 518011 "DCU Node 1, Reset Error, Power Module Overheat" 518012 "DCU Node 1, Error, Internal Power Unit Overheat" 518013 "DCU Node 1, Reset Error, Internal Power Unit Overheat" 518014 "DCU Node 1, Error, Motor Protection" 518015 "DCU Node 1, Reset Error, Motor Protection" 518016 "DCU Node 1, Error, Drive Overheat" 518017 "DCU Node 1, Reset Error, Drive Overheat" 518018 "DCU Node 1, Error, Overspeed" 518019 "DCU Node 1, status not available" 518020 "DCU Node 1, Error, Drive Data" 518021 "DCU Node 1, Error, Motor Data Not Stored" 518022 "DCU Node 1, Error, Indentification" 518023 "DCU Node 1, Error, Speed Difference" 518024 "DCU Node 1, Error, Fieldbus Memory" 518025 "DCU Node 1, status not available" 518026 "DCU Node 1, status not available" 518027 "DCU Node 1, status not available" 518028 "DCU Node 1, status not available" 518029 "DCU Node 1, status not available" 518030 "DCU Node 1, status not available" 518031 "DCU Node 1, status not available" 518032 "DCU Node 1, status not available" 518033 "DCU Node 1, status not available" 518034 "DCU Node 1, status not available" 518035 "DCU Node 1, status not available" 518036 "DCU Node 1, status not available" 518037 "DCU Node 1, status not available" 518038 "DCU Node 1, Error, Memory Size" 518039 "DCU Node 1, Error, Power Unit Software Version" 518040 "DCU Node 1, Error, FPGA Config" 518041 "DCU Node 1, status not available" 518042 "DCU Node 1, status not available" 518043 "DCU Node 1, Error, Encoder Interface Communication" 518044 "DCU Node 1, Error, Invlid Data, Power Unit" 518045 "DCU Node 1, status not available" 518046 "DCU Node 1, status not available" 518047 "DCU Node 1, status not available" 518048 "DCU Node 1, status not available" 518049 "DCU Node 1, status not available" 518050 "DCU Node 1, status not available" 518051 "DCU Node 1, status not available" 518052 "DCU Node 1, Error, Phase Undervoltage" 518053 "DCU Node 1, Error, Rotor Detection Current" 518054 "DCU Node 1, status not available" 518055 "DCU Node 1, status not available" 518056 "DCU Node 1, Error, SW Switch Left" 518057 "DCU Node 1, Error, SW Switch Right" 518058 "DCU Node 1, Error, Fieldbus Watchdog Response" 518059 "DCU Node 1, Error, Prog. Input" 518060 "DCU Node 1, status not available" 518061 "DCU Node 1, status not available" 518062 "DCU Node 1, Error, Power Unit Changed" 518063 "DCU Node 1, Error, Encoder Interface Changed" 518064 "DCU Node 1, Error, Power Unit Type Changed" 518065 "DCU Node 1, Error, Invalid Ver., Encoder Interface" 518066 "DCU Node 1, Error, Overcurrent" 518067 "DCU Node 1, Error, Max Accel/Decel Setting Exceeded" 518068 "DCU Node 1, Error, Overcurrent Brake" 518069 "DCU Node 1, Error, Power Unit" 518070 "DCU Node 1, status not available" 518071 "DCU Node 1, status not available" 518072 "DCU Node 1, status not available" 518073 "DCU Node 1, status not available" 518074 "DCU Node 1, status not available" 518075 "DCU Node 1, status not available" 518076 "DCU Node 1, status not available" 518077 "DCU Node 1, status not available" 518078 "DCU Node 1, status not available" 518079 "DCU Node 1, status not available" 518080 "DCU Node 1, status not available" 518081 "DCU Node 1, Error, Rotor Detection, Five Step" 518082 "DCU Node 1, Error, Rotor Detection, Ld equal Lq" 518083 "DCU Node 1, Error, Limit Switch Forward" 518084 "DCU Node 1, Error, Limit Switch Reverse" 518085 "DCU Node 1, Error, Limit Switch Override Forward" 518086 "DCU Node 1, Error, Limit Switch Override Reverse" 518087 "DCU Node 1, Error Limit Switch" 518088 "DCU Node 1, Error, Power Off End" 518089 "DCU Node 1, Error, Encoder Type Change" 518090 "DCU Node 1, Error, Control Board Communication" 518091 "DCU Node 1, INIT, Encoder Interface" 518092 "DCU Node 1, status not available" 518093 "DCU Node 1, status not available" 518094 "DCU Node 1, status not available" 518095 "DCU Node 1, status not available" 518096 "DCU Node 1, Error, Encoder Missing" 518097 "DCU Node 1, Error, Overspeed (EMF)" 518098 "DCU Node 1, Error, Encoder A Changed" 518099 "DCU Node 1, Error, Encoder B Changed" 518100 "DCU Node 1, Error Overcurrent, Out 01" 518101 "DCU Node 1, Error Overcurrent, Out 02" 518102 "DCU Node 1, Error Overcurrent, Out 03" 518103 "DCU Node 1, Error Overcurrent, Out 04" 518104 "DCU Node 1, Error Overcurrent, Fan" 518105 "DCU Node 1, Error Overcurrent ,Encoder" 518106 "DCU Node 1, Error Overcurrent, 24V Supply" 518107 "DCU Node 1, Error, Overfrequency" 518108 "DCU Node 1, Error Reset, Internal Overheat Control Board" 518109 "DCU Node 1, Error, Internal Overheat, Control Board" 518110 "DCU Node 1, Error, Ramp OH" 518111 "DCU Node 1, Error, Ramp OHI" 518112 "DCU Node 1, Error 24V Supply Undervoltage" 518113 "DCU Node 1, Error STO signals" 518114 "DCU Node 1, Error Ext. 24V Supply Undervoltage" 518115 "DCU Node 1, Error GTR7 Always OFF" 518116 "DCU Node 1, Error GTR7 OC" 518117 "DCU Node 1, Error GTR7 Always ON" 518118 "DCU Node 1, OC at 5V Diagnostic" 518119 "DCU Node 1, Error, Extreme Overpotential" 518120 "DCU Node 1, Error, DC Capacitor Damaged" 518121 "DCU Node 1, status not available" 518122 "DCU Node 1, status not available" 518123 "DCU Node 1, status not available" 518124 "DCU Node 1, status not available" 518125 "DCU Node 1, status not available" 518126 "DCU Node 1, status not available" 518127 "DCU Node 1, status not available" 518128 "DCU Node 1, status not available" 518129 "DCU Node 1, status not available" 518130 "DCU Node 1, status not available" 518131 "DCU Node 1, status not available" 518132 "DCU Node 1, status not available" 518133 "DCU Node 1, status not available" 518134 "DCU Node 1, status not available" 518135 "DCU Node 1, status not available" 518300 "App Node 1, No error" 518301 "App Node 1, No axis" 518302 "App Node 1, Error reading mapping" 518303 "App Node 1, Error reading rated current" 518304 "App Node 1, Error rated current mismatch" 518305 "App Node 1, Error write pll offset" 518306 "App Node 1, Error auto mapping" 518307 "App Node 1, Error interlink communication" 518308 "App Node 1, Error overload parameter" 518309 "App Node 1, Incompatible default download" 518310 "App Node 1, Error downloading default download" 518311 "App Node 1, Default download not found" 518312 "App Node 1, Error CAN data timeout" 518313 "App Node 1, Error CAN data invalid" 518314 "App Node 1, Invalid license" 518315 "App Node 1, Error reinitializing app" 518319 "App Node 1, General application error" 519000 "DCU Node 2, No Error" 519001 "DCU Node 2, status not available" 519002 "DCU Node 2, status not available" 519003 "DCU Node 2, Error, Overcurrent Power Unit" 519004 "DCU Node 2, Error, Overcurrent Analog" 519005 "DCU Node 2, Error, Overvoltage DC Link" 519006 "DCU Node 2, Error, Undervoltage DC Link" 519007 "DCU Node 2, Error, Overload" 519008 "DCU Node 2, Reset Error, Overload" 519009 "DCU Node 2, Error, Overload 02" 519010 "DCU Node 2, Error, Power Module Overheat" 519011 "DCU Node 2, Reset Error, Power Module Overheat" 519012 "DCU Node 2, Error, Internal Power Unit Overheat" 519013 "DCU Node 2, Reset Error, Internal Power Unit Overheat" 519014 "DCU Node 2, Error, Motor Protection" 519015 "DCU Node 2, Reset Error, Motor Protection" 519016 "DCU Node 2, Error, Drive Overheat" 519017 "DCU Node 2, Reset Error, Drive Overheat" 519018 "DCU Node 2, Error, Overspeed" 519019 "DCU Node 2, status not available" 519020 "DCU Node 2, Error, Drive Data" 519021 "DCU Node 2, Error, Motor Data Not Stored" 519022 "DCU Node 2, Error, Indentification" 519023 "DCU Node 2, Error, Speed Difference" 519024 "DCU Node 2, Error, Fieldbus Memory" 519025 "DCU Node 2, status not available" 519026 "DCU Node 2, status not available" 519027 "DCU Node 2, status not available" 519028 "DCU Node 2, status not available" 519029 "DCU Node 2, status not available" 519030 "DCU Node 2, status not available" 519031 "DCU Node 2, status not available" 519032 "DCU Node 2, status not available" 519033 "DCU Node 2, status not available" 519034 "DCU Node 2, status not available" 519035 "DCU Node 2, status not available" 519036 "DCU Node 2, status not available" 519037 "DCU Node 2, status not available" 519038 "DCU Node 2, Error, Memory Size" 519039 "DCU Node 2, Error, Power Unit Software Version" 519040 "DCU Node 2, Error, FPGA Config" 519041 "DCU Node 2, status not available" 519042 "DCU Node 2, status not available" 519043 "DCU Node 2, Error, Encoder Interface Communication" 519044 "DCU Node 2, Error, Invlid Data, Power Unit" 519045 "DCU Node 2, status not available" 519046 "DCU Node 2, status not available" 519047 "DCU Node 2, status not available" 519048 "DCU Node 2, status not available" 519049 "DCU Node 2, status not available" 519050 "DCU Node 2, status not available" 519051 "DCU Node 2, status not available" 519052 "DCU Node 2, Error, Phase Undervoltage" 519053 "DCU Node 2, Error, Rotor Detection Current" 519054 "DCU Node 2, status not available" 519055 "DCU Node 2, status not available" 519056 "DCU Node 2, Error, SW Switch Left" 519057 "DCU Node 2, Error, SW Switch Right" 519058 "DCU Node 2, Error, Fieldbus Watchdog Response" 519059 "DCU Node 2, Error, Prog. Input" 519060 "DCU Node 2, status not available" 519061 "DCU Node 2, status not available" 519062 "DCU Node 2, Error, Power Unit Changed" 519063 "DCU Node 2, Error, Encoder Interface Changed" 519064 "DCU Node 2, Error, Power Unit Type Changed" 519065 "DCU Node 2, Error, Invalid Ver., Encoder Interface" 519066 "DCU Node 2, Error, Overcurrent" 519067 "DCU Node 2, Error, Max Accel/Decel Setting Exceeded" 519068 "DCU Node 2, Error, Overcurrent Brake" 519069 "DCU Node 2, Error, Power Unit" 519070 "DCU Node 2, status not available" 519071 "DCU Node 2, status not available" 519072 "DCU Node 2, status not available" 519073 "DCU Node 2, status not available" 519074 "DCU Node 2, status not available" 519075 "DCU Node 2, status not available" 519076 "DCU Node 2, status not available" 519077 "DCU Node 2, status not available" 519078 "DCU Node 2, status not available" 519079 "DCU Node 2, status not available" 519080 "DCU Node 2, status not available" 519081 "DCU Node 2, Error, Rotor Detection, Five Step" 519082 "DCU Node 2, Error, Rotor Detection, Ld equal Lq" 519083 "DCU Node 2, Error, Limit Switch Forward" 519084 "DCU Node 2, Error, Limit Switch Reverse" 519085 "DCU Node 2, Error, Limit Switch Override Forward" 519086 "DCU Node 2, Error, Limit Switch Override Reverse" 519087 "DCU Node 2, Error Limit Switch" 519088 "DCU Node 2, Error, Power Off End" 519089 "DCU Node 2, Error, Encoder Type Change" 519090 "DCU Node 2, Error, Control Board Communication" 519091 "DCU Node 2, INIT, Encoder Interface" 519092 "DCU Node 2, status not available" 519093 "DCU Node 2, status not available" 519094 "DCU Node 2, status not available" 519095 "DCU Node 2, status not available" 519096 "DCU Node 2, Error, Encoder Missing" 519097 "DCU Node 2, Error, Overspeed (EMF)" 519098 "DCU Node 2, Error, Encoder A Changed" 519099 "DCU Node 2, Error, Encoder B Changed" 519100 "DCU Node 2, Error Overcurrent, Out 01" 519101 "DCU Node 2, Error Overcurrent, Out 02" 519102 "DCU Node 2, Error Overcurrent, Out 03" 519103 "DCU Node 2, Error Overcurrent, Out 04" 519104 "DCU Node 2, Error Overcurrent, Fan" 519105 "DCU Node 2, Error Overcurrent ,Encoder" 519106 "DCU Node 2, Error Overcurrent, 24V Supply" 519107 "DCU Node 2, Error, Overfrequency" 519108 "DCU Node 2, Error Reset, Internal Overheat Control Board" 519109 "DCU Node 2, Error, Internal Overheat, Control Board" 519110 "DCU Node 2, Error, Ramp OH" 519111 "DCU Node 2, Error, Ramp OHI" 519112 "DCU Node 2, Error 24V Supply Undervoltage" 519113 "DCU Node 2, Error STO signals" 519114 "DCU Node 2, Error Ext. 24V Supply Undervoltage" 519115 "DCU Node 2, Error GTR7 Always OFF" 519116 "DCU Node 2, Error GTR7 OC" 519117 "DCU Node 2, Error GTR7 Always ON" 519118 "DCU Node 2, OC at 5V Diagnostic" 519119 "DCU Node 2, Error, Extreme Overpotential" 519120 "DCU Node 2, Error, DC Capacitor Damaged" 519121 "DCU Node 2, status not available" 519122 "DCU Node 2, status not available" 519123 "DCU Node 2, status not available" 519124 "DCU Node 2, status not available" 519125 "DCU Node 2, status not available" 519126 "DCU Node 2, status not available" 519127 "DCU Node 2, status not available" 519128 "DCU Node 2, status not available" 519129 "DCU Node 2, status not available" 519130 "DCU Node 2, status not available" 519131 "DCU Node 2, status not available" 519132 "DCU Node 2, status not available" 519133 "DCU Node 2, status not available" 519134 "DCU Node 2, status not available" 519135 "DCU Node 2, status not available" 519300 "App Node 2, No error" 519301 "App Node 2, No axis" 519302 "App Node 2, Error reading mapping" 519303 "App Node 2, Error reading rated current" 519304 "App Node 2, Error rated current mismatch" 519305 "App Node 2, Error write pll offset" 519306 "App Node 2, Error auto mapping" 519307 "App Node 2, Error interlink communication" 519308 "App Node 2, Error overload parameter" 519309 "App Node 2, Incompatible default download" 519310 "App Node 2, Error downloading default download" 519311 "App Node 2, Default download not found" 519312 "App Node 2, Error CAN data timeout" 519313 "App Node 2, Error CAN data invalid" 519314 "App Node 2, Invalid license" 519315 "App Node 2, Error reinitializing app" 519319 "App Node 2, General application error" 520000 "DCU Node 3, No Error" 520001 "DCU Node 3, status not available" 520002 "DCU Node 3, status not available" 520003 "DCU Node 3, Error, Overcurrent Power Unit" 520004 "DCU Node 3, Error, Overcurrent Analog" 520005 "DCU Node 3, Error, Overvoltage DC Link" 520006 "DCU Node 3, Error, Undervoltage DC Link" 520007 "DCU Node 3, Error, Overload" 520008 "DCU Node 3, Reset Error, Overload" 520009 "DCU Node 3, Error, Overload 02" 520010 "DCU Node 3, Error, Power Module Overheat" 520011 "DCU Node 3, Reset Error, Power Module Overheat" 520012 "DCU Node 3, Error, Internal Power Unit Overheat" 520013 "DCU Node 3, Reset Error, Internal Power Unit Overheat" 520014 "DCU Node 3, Error, Motor Protection" 520015 "DCU Node 3, Reset Error, Motor Protection" 520016 "DCU Node 3, Error, Drive Overheat" 520017 "DCU Node 3, Reset Error, Drive Overheat" 520018 "DCU Node 3, Error, Overspeed" 520019 "DCU Node 3, status not available" 520020 "DCU Node 3, Error, Drive Data" 520021 "DCU Node 3, Error, Motor Data Not Stored" 520022 "DCU Node 3, Error, Indentification" 520023 "DCU Node 3, Error, Speed Difference" 520024 "DCU Node 3, Error, Fieldbus Memory" 520025 "DCU Node 3, status not available" 520026 "DCU Node 3, status not available" 520027 "DCU Node 3, status not available" 520028 "DCU Node 3, status not available" 520029 "DCU Node 3, status not available" 520030 "DCU Node 3, status not available" 520031 "DCU Node 3, status not available" 520032 "DCU Node 3, status not available" 520033 "DCU Node 3, status not available" 520034 "DCU Node 3, status not available" 520035 "DCU Node 3, status not available" 520036 "DCU Node 3, status not available" 520037 "DCU Node 3, status not available" 520038 "DCU Node 3, Error, Memory Size" 520039 "DCU Node 3, Error, Power Unit Software Version" 520040 "DCU Node 3, Error, FPGA Config" 520041 "DCU Node 3, status not available" 520042 "DCU Node 3, status not available" 520043 "DCU Node 3, Error, Encoder Interface Communication" 520044 "DCU Node 3, Error, Invlid Data, Power Unit" 520045 "DCU Node 3, status not available" 520046 "DCU Node 3, status not available" 520047 "DCU Node 3, status not available" 520048 "DCU Node 3, status not available" 520049 "DCU Node 3, status not available" 520050 "DCU Node 3, status not available" 520051 "DCU Node 3, status not available" 520052 "DCU Node 3, Error, Phase Undervoltage" 520053 "DCU Node 3, Error, Rotor Detection Current" 520054 "DCU Node 3, status not available" 520055 "DCU Node 3, status not available" 520056 "DCU Node 3, Error, SW Switch Left" 520057 "DCU Node 3, Error, SW Switch Right" 520058 "DCU Node 3, Error, Fieldbus Watchdog Response" 520059 "DCU Node 3, Error, Prog. Input" 520060 "DCU Node 3, status not available" 520061 "DCU Node 3, status not available" 520062 "DCU Node 3, Error, Power Unit Changed" 520063 "DCU Node 3, Error, Encoder Interface Changed" 520064 "DCU Node 3, Error, Power Unit Type Changed" 520065 "DCU Node 3, Error, Invalid Ver., Encoder Interface" 520066 "DCU Node 3, Error, Overcurrent" 520067 "DCU Node 3, Error, Max Accel/Decel Setting Exceeded" 520068 "DCU Node 3, Error, Overcurrent Brake" 520069 "DCU Node 3, Error, Power Unit" 520070 "DCU Node 3, status not available" 520071 "DCU Node 3, status not available" 520072 "DCU Node 3, status not available" 520073 "DCU Node 3, status not available" 520074 "DCU Node 3, status not available" 520075 "DCU Node 3, status not available" 520076 "DCU Node 3, status not available" 520077 "DCU Node 3, status not available" 520078 "DCU Node 3, status not available" 520079 "DCU Node 3, status not available" 520080 "DCU Node 3, status not available" 520081 "DCU Node 3, Error, Rotor Detection, Five Step" 520082 "DCU Node 3, Error, Rotor Detection, Ld equal Lq" 520083 "DCU Node 3, Error, Limit Switch Forward" 520084 "DCU Node 3, Error, Limit Switch Reverse" 520085 "DCU Node 3, Error, Limit Switch Override Forward" 520086 "DCU Node 3, Error, Limit Switch Override Reverse" 520087 "DCU Node 3, Error Limit Switch" 520088 "DCU Node 3, Error, Power Off End" 520089 "DCU Node 3, Error, Encoder Type Change" 520090 "DCU Node 3, Error, Control Board Communication" 520091 "DCU Node 3, INIT, Encoder Interface" 520092 "DCU Node 3, status not available" 520093 "DCU Node 3, status not available" 520094 "DCU Node 3, status not available" 520095 "DCU Node 3, status not available" 520096 "DCU Node 3, Error, Encoder Missing" 520097 "DCU Node 3, Error, Overspeed (EMF)" 520098 "DCU Node 3, Error, Encoder A Changed" 520099 "DCU Node 3, Error, Encoder B Changed" 520100 "DCU Node 3, Error Overcurrent, Out 01" 520101 "DCU Node 3, Error Overcurrent, Out 02" 520102 "DCU Node 3, Error Overcurrent, Out 03" 520103 "DCU Node 3, Error Overcurrent, Out 04" 520104 "DCU Node 3, Error Overcurrent, Fan" 520105 "DCU Node 3, Error Overcurrent ,Encoder" 520106 "DCU Node 3, Error Overcurrent, 24V Supply" 520107 "DCU Node 3, Error, Overfrequency" 520108 "DCU Node 3, Error Reset, Internal Overheat Control Board" 520109 "DCU Node 3, Error, Internal Overheat, Control Board" 520110 "DCU Node 3, Error, Ramp OH" 520111 "DCU Node 3, Error, Ramp OHI" 520112 "DCU Node 3, Error 24V Supply Undervoltage" 520113 "DCU Node 3, Error STO signals" 520114 "DCU Node 3, Error Ext. 24V Supply Undervoltage" 520115 "DCU Node 3, Error GTR7 Always OFF" 520116 "DCU Node 3, Error GTR7 OC" 520117 "DCU Node 3, Error GTR7 Always ON" 520118 "DCU Node 3, OC at 5V Diagnostic" 520119 "DCU Node 3, Error, Extreme Overpotential" 520120 "DCU Node 3, Error, DC Capacitor Damaged" 520121 "DCU Node 3, status not available" 520122 "DCU Node 3, status not available" 520123 "DCU Node 3, status not available" 520124 "DCU Node 3, status not available" 520125 "DCU Node 3, status not available" 520126 "DCU Node 3, status not available" 520127 "DCU Node 3, status not available" 520128 "DCU Node 3, status not available" 520129 "DCU Node 3, status not available" 520130 "DCU Node 3, status not available" 520131 "DCU Node 3, status not available" 520132 "DCU Node 3, status not available" 520133 "DCU Node 3, status not available" 520134 "DCU Node 3, status not available" 520135 "DCU Node 3, status not available" 520300 "App Node 3, No error" 520301 "App Node 3, No axis" 520302 "App Node 3, Error reading mapping" 520303 "App Node 3, Error reading rated current" 520304 "App Node 3, Error rated current mismatch" 520305 "App Node 3, Error write pll offset" 520306 "App Node 3, Error auto mapping" 520307 "App Node 3, Error interlink communication" 520308 "App Node 3, Error overload parameter" 520309 "App Node 3, Incompatible default download" 520310 "App Node 3, Error downloading default download" 520311 "App Node 3, Default download not found" 520312 "App Node 3, Error CAN data timeout" 520313 "App Node 3, Error CAN data invalid" 520314 "App Node 3, Invalid license" 520315 "App Node 3, Error reinitializing app" 520319 "App Node 3, General application error" 521000 "DCU Node 4, No Error" 521001 "DCU Node 4, status not available" 521002 "DCU Node 4, status not available" 521003 "DCU Node 4, Error, Overcurrent Power Unit" 521004 "DCU Node 4, Error, Overcurrent Analog" 521005 "DCU Node 4, Error, Overvoltage DC Link" 521006 "DCU Node 4, Error, Undervoltage DC Link" 521007 "DCU Node 4, Error, Overload" 521008 "DCU Node 4, Reset Error, Overload" 521009 "DCU Node 4, Error, Overload 02" 521010 "DCU Node 4, Error, Power Module Overheat" 521011 "DCU Node 4, Reset Error, Power Module Overheat" 521012 "DCU Node 4, Error, Internal Power Unit Overheat" 521013 "DCU Node 4, Reset Error, Internal Power Unit Overheat" 521014 "DCU Node 4, Error, Motor Protection" 521015 "DCU Node 4, Reset Error, Motor Protection" 521016 "DCU Node 4, Error, Drive Overheat" 521017 "DCU Node 4, Reset Error, Drive Overheat" 521018 "DCU Node 4, Error, Overspeed" 521019 "DCU Node 4, status not available" 521020 "DCU Node 4, Error, Drive Data" 521021 "DCU Node 4, Error, Motor Data Not Stored" 521022 "DCU Node 4, Error, Indentification" 521023 "DCU Node 4, Error, Speed Difference" 521024 "DCU Node 4, Error, Fieldbus Memory" 521025 "DCU Node 4, status not available" 521026 "DCU Node 4, status not available" 521027 "DCU Node 4, status not available" 521028 "DCU Node 4, status not available" 521029 "DCU Node 4, status not available" 521030 "DCU Node 4, status not available" 521031 "DCU Node 4, status not available" 521032 "DCU Node 4, status not available" 521033 "DCU Node 4, status not available" 521034 "DCU Node 4, status not available" 521035 "DCU Node 4, status not available" 521036 "DCU Node 4, status not available" 521037 "DCU Node 4, status not available" 521038 "DCU Node 4, Error, Memory Size" 521039 "DCU Node 4, Error, Power Unit Software Version" 521040 "DCU Node 4, Error, FPGA Config" 521041 "DCU Node 4, status not available" 521042 "DCU Node 4, status not available" 521043 "DCU Node 4, Error, Encoder Interface Communication" 521044 "DCU Node 4, Error, Invlid Data, Power Unit" 521045 "DCU Node 4, status not available" 521046 "DCU Node 4, status not available" 521047 "DCU Node 4, status not available" 521048 "DCU Node 4, status not available" 521049 "DCU Node 4, status not available" 521050 "DCU Node 4, status not available" 521051 "DCU Node 4, status not available" 521052 "DCU Node 4, Error, Phase Undervoltage" 521053 "DCU Node 4, Error, Rotor Detection Current" 521054 "DCU Node 4, status not available" 521055 "DCU Node 4, status not available" 521056 "DCU Node 4, Error, SW Switch Left" 521057 "DCU Node 4, Error, SW Switch Right" 521058 "DCU Node 4, Error, Fieldbus Watchdog Response" 521059 "DCU Node 4, Error, Prog. Input" 521060 "DCU Node 4, status not available" 521061 "DCU Node 4, status not available" 521062 "DCU Node 4, Error, Power Unit Changed" 521063 "DCU Node 4, Error, Encoder Interface Changed" 521064 "DCU Node 4, Error, Power Unit Type Changed" 521065 "DCU Node 4, Error, Invalid Ver., Encoder Interface" 521066 "DCU Node 4, Error, Overcurrent" 521067 "DCU Node 4, Error, Max Accel/Decel Setting Exceeded" 521068 "DCU Node 4, Error, Overcurrent Brake" 521069 "DCU Node 4, Error, Power Unit" 521070 "DCU Node 4, status not available" 521071 "DCU Node 4, status not available" 521072 "DCU Node 4, status not available" 521073 "DCU Node 4, status not available" 521074 "DCU Node 4, status not available" 521075 "DCU Node 4, status not available" 521076 "DCU Node 4, status not available" 521077 "DCU Node 4, status not available" 521078 "DCU Node 4, status not available" 521079 "DCU Node 4, status not available" 521080 "DCU Node 4, status not available" 521081 "DCU Node 4, Error, Rotor Detection, Five Step" 521082 "DCU Node 4, Error, Rotor Detection, Ld equal Lq" 521083 "DCU Node 4, Error, Limit Switch Forward" 521084 "DCU Node 4, Error, Limit Switch Reverse" 521085 "DCU Node 4, Error, Limit Switch Override Forward" 521086 "DCU Node 4, Error, Limit Switch Override Reverse" 521087 "DCU Node 4, Error Limit Switch" 521088 "DCU Node 4, Error, Power Off End" 521089 "DCU Node 4, Error, Encoder Type Change" 521090 "DCU Node 4, Error, Control Board Communication" 521091 "DCU Node 4, INIT, Encoder Interface" 521092 "DCU Node 4, status not available" 521093 "DCU Node 4, status not available" 521094 "DCU Node 4, status not available" 521095 "DCU Node 4, status not available" 521096 "DCU Node 4, Error, Encoder Missing" 521097 "DCU Node 4, Error, Overspeed (EMF)" 521098 "DCU Node 4, Error, Encoder A Changed" 521099 "DCU Node 4, Error, Encoder B Changed" 521100 "DCU Node 4, Error Overcurrent, Out 01" 521101 "DCU Node 4, Error Overcurrent, Out 02" 521102 "DCU Node 4, Error Overcurrent, Out 03" 521103 "DCU Node 4, Error Overcurrent, Out 04" 521104 "DCU Node 4, Error Overcurrent, Fan" 521105 "DCU Node 4, Error Overcurrent ,Encoder" 521106 "DCU Node 4, Error Overcurrent, 24V Supply" 521107 "DCU Node 4, Error, Overfrequency" 521108 "DCU Node 4, Error Reset, Internal Overheat Control Board" 521109 "DCU Node 4, Error, Internal Overheat, Control Board" 521110 "DCU Node 4, Error, Ramp OH" 521111 "DCU Node 4, Error, Ramp OHI" 521112 "DCU Node 4, Error 24V Supply Undervoltage" 521113 "DCU Node 4, Error STO signals" 521114 "DCU Node 4, Error Ext. 24V Supply Undervoltage" 521115 "DCU Node 4, Error GTR7 Always OFF" 521116 "DCU Node 4, Error GTR7 OC" 521117 "DCU Node 4, Error GTR7 Always ON" 521118 "DCU Node 4, OC at 5V Diagnostic" 521119 "DCU Node 4, Error, Extreme Overpotential" 521120 "DCU Node 4, Error, DC Capacitor Damaged" 521121 "DCU Node 4, status not available" 521122 "DCU Node 4, status not available" 521123 "DCU Node 4, status not available" 521124 "DCU Node 4, status not available" 521125 "DCU Node 4, status not available" 521126 "DCU Node 4, status not available" 521127 "DCU Node 4, status not available" 521128 "DCU Node 4, status not available" 521129 "DCU Node 4, status not available" 521130 "DCU Node 4, status not available" 521131 "DCU Node 4, status not available" 521132 "DCU Node 4, status not available" 521133 "DCU Node 4, status not available" 521134 "DCU Node 4, status not available" 521135 "DCU Node 4, status not available" 521300 "App Node 4, No error" 521301 "App Node 4, No axis" 521302 "App Node 4, Error reading mapping" 521303 "App Node 4, Error reading rated current" 521304 "App Node 4, Error rated current mismatch" 521305 "App Node 4, Error write pll offset" 521306 "App Node 4, Error auto mapping" 521307 "App Node 4, Error interlink communication" 521308 "App Node 4, Error overload parameter" 521309 "App Node 4, Incompatible default download" 521310 "App Node 4, Error downloading default download" 521311 "App Node 4, Default download not found" 521312 "App Node 4, Error CAN data timeout" 521313 "App Node 4, Error CAN data invalid" 521314 "App Node 4, Invalid license" 521315 "App Node 4, Error reinitializing app" 521319 "App Node 4, General application error" 522000 "DCU Node 5, No Error" 522001 "DCU Node 5, status not available" 522002 "DCU Node 5, status not available" 522003 "DCU Node 5, Error, Overcurrent Power Unit" 522004 "DCU Node 5, Error, Overcurrent Analog" 522005 "DCU Node 5, Error, Overvoltage DC Link" 522006 "DCU Node 5, Error, Undervoltage DC Link" 522007 "DCU Node 5, Error, Overload" 522008 "DCU Node 5, Reset Error, Overload" 522009 "DCU Node 5, Error, Overload 02" 522010 "DCU Node 5, Error, Power Module Overheat" 522011 "DCU Node 5, Reset Error, Power Module Overheat" 522012 "DCU Node 5, Error, Internal Power Unit Overheat" 522013 "DCU Node 5, Reset Error, Internal Power Unit Overheat" 522014 "DCU Node 5, Error, Motor Protection" 522015 "DCU Node 5, Reset Error, Motor Protection" 522016 "DCU Node 5, Error, Drive Overheat" 522017 "DCU Node 5, Reset Error, Drive Overheat" 522018 "DCU Node 5, Error, Overspeed" 522019 "DCU Node 5, status not available" 522020 "DCU Node 5, Error, Drive Data" 522021 "DCU Node 5, Error, Motor Data Not Stored" 522022 "DCU Node 5, Error, Indentification" 522023 "DCU Node 5, Error, Speed Difference" 522024 "DCU Node 5, Error, Fieldbus Memory" 522025 "DCU Node 5, status not available" 522026 "DCU Node 5, status not available" 522027 "DCU Node 5, status not available" 522028 "DCU Node 5, status not available" 522029 "DCU Node 5, status not available" 522030 "DCU Node 5, status not available" 522031 "DCU Node 5, status not available" 522032 "DCU Node 5, status not available" 522033 "DCU Node 5, status not available" 522034 "DCU Node 5, status not available" 522035 "DCU Node 5, status not available" 522036 "DCU Node 5, status not available" 522037 "DCU Node 5, status not available" 522038 "DCU Node 5, Error, Memory Size" 522039 "DCU Node 5, Error, Power Unit Software Version" 522040 "DCU Node 5, Error, FPGA Config" 522041 "DCU Node 5, status not available" 522042 "DCU Node 5, status not available" 522043 "DCU Node 5, Error, Encoder Interface Communication" 522044 "DCU Node 5, Error, Invlid Data, Power Unit" 522045 "DCU Node 5, status not available" 522046 "DCU Node 5, status not available" 522047 "DCU Node 5, status not available" 522048 "DCU Node 5, status not available" 522049 "DCU Node 5, status not available" 522050 "DCU Node 5, status not available" 522051 "DCU Node 5, status not available" 522052 "DCU Node 5, Error, Phase Undervoltage" 522053 "DCU Node 5, Error, Rotor Detection Current" 522054 "DCU Node 5, status not available" 522055 "DCU Node 5, status not available" 522056 "DCU Node 5, Error, SW Switch Left" 522057 "DCU Node 5, Error, SW Switch Right" 522058 "DCU Node 5, Error, Fieldbus Watchdog Response" 522059 "DCU Node 5, Error, Prog. Input" 522060 "DCU Node 5, status not available" 522061 "DCU Node 5, status not available" 522062 "DCU Node 5, Error, Power Unit Changed" 522063 "DCU Node 5, Error, Encoder Interface Changed" 522064 "DCU Node 5, Error, Power Unit Type Changed" 522065 "DCU Node 5, Error, Invalid Ver., Encoder Interface" 522066 "DCU Node 5, Error, Overcurrent" 522067 "DCU Node 5, Error, Max Accel/Decel Setting Exceeded" 522068 "DCU Node 5, Error, Overcurrent Brake" 522069 "DCU Node 5, Error, Power Unit" 522070 "DCU Node 5, status not available" 522071 "DCU Node 5, status not available" 522072 "DCU Node 5, status not available" 522073 "DCU Node 5, status not available" 522074 "DCU Node 5, status not available" 522075 "DCU Node 5, status not available" 522076 "DCU Node 5, status not available" 522077 "DCU Node 5, status not available" 522078 "DCU Node 5, status not available" 522079 "DCU Node 5, status not available" 522080 "DCU Node 5, status not available" 522081 "DCU Node 5, Error, Rotor Detection, Five Step" 522082 "DCU Node 5, Error, Rotor Detection, Ld equal Lq" 522083 "DCU Node 5, Error, Limit Switch Forward" 522084 "DCU Node 5, Error, Limit Switch Reverse" 522085 "DCU Node 5, Error, Limit Switch Override Forward" 522086 "DCU Node 5, Error, Limit Switch Override Reverse" 522087 "DCU Node 5, Error Limit Switch" 522088 "DCU Node 5, Error, Power Off End" 522089 "DCU Node 5, Error, Encoder Type Change" 522090 "DCU Node 5, Error, Control Board Communication" 522091 "DCU Node 5, INIT, Encoder Interface" 522092 "DCU Node 5, status not available" 522093 "DCU Node 5, status not available" 522094 "DCU Node 5, status not available" 522095 "DCU Node 5, status not available" 522096 "DCU Node 5, Error, Encoder Missing" 522097 "DCU Node 5, Error, Overspeed (EMF)" 522098 "DCU Node 5, Error, Encoder A Changed" 522099 "DCU Node 5, Error, Encoder B Changed" 522100 "DCU Node 5, Error Overcurrent, Out 01" 522101 "DCU Node 5, Error Overcurrent, Out 02" 522102 "DCU Node 5, Error Overcurrent, Out 03" 522103 "DCU Node 5, Error Overcurrent, Out 04" 522104 "DCU Node 5, Error Overcurrent, Fan" 522105 "DCU Node 5, Error Overcurrent ,Encoder" 522106 "DCU Node 5, Error Overcurrent, 24V Supply" 522107 "DCU Node 5, Error, Overfrequency" 522108 "DCU Node 5, Error Reset, Internal Overheat Control Board" 522109 "DCU Node 5, Error, Internal Overheat, Control Board" 522110 "DCU Node 5, Error, Ramp OH" 522111 "DCU Node 5, Error, Ramp OHI" 522112 "DCU Node 5, Error 24V Supply Undervoltage" 522113 "DCU Node 5, Error STO signals" 522114 "DCU Node 5, Error Ext. 24V Supply Undervoltage" 522115 "DCU Node 5, Error GTR7 Always OFF" 522116 "DCU Node 5, Error GTR7 OC" 522117 "DCU Node 5, Error GTR7 Always ON" 522118 "DCU Node 5, OC at 5V Diagnostic" 522119 "DCU Node 5, Error, Extreme Overpotential" 522120 "DCU Node 5, Error, DC Capacitor Damaged" 522121 "DCU Node 5, status not available" 522122 "DCU Node 5, status not available" 522123 "DCU Node 5, status not available" 522124 "DCU Node 5, status not available" 522125 "DCU Node 5, status not available" 522126 "DCU Node 5, status not available" 522127 "DCU Node 5, status not available" 522128 "DCU Node 5, status not available" 522129 "DCU Node 5, status not available" 522130 "DCU Node 5, status not available" 522131 "DCU Node 5, status not available" 522132 "DCU Node 5, status not available" 522133 "DCU Node 5, status not available" 522134 "DCU Node 5, status not available" 522135 "DCU Node 5, status not available" 522300 "App Node 5, No error" 522301 "App Node 5, No axis" 522302 "App Node 5, Error reading mapping" 522303 "App Node 5, Error reading rated current" 522304 "App Node 5, Error rated current mismatch" 522305 "App Node 5, Error write pll offset" 522306 "App Node 5, Error auto mapping" 522307 "App Node 5, Error interlink communication" 522308 "App Node 5, Error overload parameter" 522309 "App Node 5, Incompatible default download" 522310 "App Node 5, Error downloading default download" 522311 "App Node 5, Default download not found" 522312 "App Node 5, Error CAN data timeout" 522313 "App Node 5, Error CAN data invalid" 522314 "App Node 5, Invalid license" 522315 "App Node 5, Error reinitializing app" 522319 "App Node 5, General application error" 523000 "DCU Node 6, No Error" 523001 "DCU Node 6, status not available" 523002 "DCU Node 6, status not available" 523003 "DCU Node 6, Error, Overcurrent Power Unit" 523004 "DCU Node 6, Error, Overcurrent Analog" 523005 "DCU Node 6, Error, Overvoltage DC Link" 523006 "DCU Node 6, Error, Undervoltage DC Link" 523007 "DCU Node 6, Error, Overload" 523008 "DCU Node 6, Reset Error, Overload" 523009 "DCU Node 6, Error, Overload 02" 523010 "DCU Node 6, Error, Power Module Overheat" 523011 "DCU Node 6, Reset Error, Power Module Overheat" 523012 "DCU Node 6, Error, Internal Power Unit Overheat" 523013 "DCU Node 6, Reset Error, Internal Power Unit Overheat" 523014 "DCU Node 6, Error, Motor Protection" 523015 "DCU Node 6, Reset Error, Motor Protection" 523016 "DCU Node 6, Error, Drive Overheat" 523017 "DCU Node 6, Reset Error, Drive Overheat" 523018 "DCU Node 6, Error, Overspeed" 523019 "DCU Node 6, status not available" 523020 "DCU Node 6, Error, Drive Data" 523021 "DCU Node 6, Error, Motor Data Not Stored" 523022 "DCU Node 6, Error, Indentification" 523023 "DCU Node 6, Error, Speed Difference" 523024 "DCU Node 6, Error, Fieldbus Memory" 523025 "DCU Node 6, status not available" 523026 "DCU Node 6, status not available" 523027 "DCU Node 6, status not available" 523028 "DCU Node 6, status not available" 523029 "DCU Node 6, status not available" 523030 "DCU Node 6, status not available" 523031 "DCU Node 6, status not available" 523032 "DCU Node 6, status not available" 523033 "DCU Node 6, status not available" 523034 "DCU Node 6, status not available" 523035 "DCU Node 6, status not available" 523036 "DCU Node 6, status not available" 523037 "DCU Node 6, status not available" 523038 "DCU Node 6, Error, Memory Size" 523039 "DCU Node 6, Error, Power Unit Software Version" 523040 "DCU Node 6, Error, FPGA Config" 523041 "DCU Node 6, status not available" 523042 "DCU Node 6, status not available" 523043 "DCU Node 6, Error, Encoder Interface Communication" 523044 "DCU Node 6, Error, Invlid Data, Power Unit" 523045 "DCU Node 6, status not available" 523046 "DCU Node 6, status not available" 523047 "DCU Node 6, status not available" 523048 "DCU Node 6, status not available" 523049 "DCU Node 6, status not available" 523050 "DCU Node 6, status not available" 523051 "DCU Node 6, status not available" 523052 "DCU Node 6, Error, Phase Undervoltage" 523053 "DCU Node 6, Error, Rotor Detection Current" 523054 "DCU Node 6, status not available" 523055 "DCU Node 6, status not available" 523056 "DCU Node 6, Error, SW Switch Left" 523057 "DCU Node 6, Error, SW Switch Right" 523058 "DCU Node 6, Error, Fieldbus Watchdog Response" 523059 "DCU Node 6, Error, Prog. Input" 523060 "DCU Node 6, status not available" 523061 "DCU Node 6, status not available" 523062 "DCU Node 6, Error, Power Unit Changed" 523063 "DCU Node 6, Error, Encoder Interface Changed" 523064 "DCU Node 6, Error, Power Unit Type Changed" 523065 "DCU Node 6, Error, Invalid Ver., Encoder Interface" 523066 "DCU Node 6, Error, Overcurrent" 523067 "DCU Node 6, Error, Max Accel/Decel Setting Exceeded" 523068 "DCU Node 6, Error, Overcurrent Brake" 523069 "DCU Node 6, Error, Power Unit" 523070 "DCU Node 6, status not available" 523071 "DCU Node 6, status not available" 523072 "DCU Node 6, status not available" 523073 "DCU Node 6, status not available" 523074 "DCU Node 6, status not available" 523075 "DCU Node 6, status not available" 523076 "DCU Node 6, status not available" 523077 "DCU Node 6, status not available" 523078 "DCU Node 6, status not available" 523079 "DCU Node 6, status not available" 523080 "DCU Node 6, status not available" 523081 "DCU Node 6, Error, Rotor Detection, Five Step" 523082 "DCU Node 6, Error, Rotor Detection, Ld equal Lq" 523083 "DCU Node 6, Error, Limit Switch Forward" 523084 "DCU Node 6, Error, Limit Switch Reverse" 523085 "DCU Node 6, Error, Limit Switch Override Forward" 523086 "DCU Node 6, Error, Limit Switch Override Reverse" 523087 "DCU Node 6, Error Limit Switch" 523088 "DCU Node 6, Error, Power Off End" 523089 "DCU Node 6, Error, Encoder Type Change" 523090 "DCU Node 6, Error, Control Board Communication" 523091 "DCU Node 6, INIT, Encoder Interface" 523092 "DCU Node 6, status not available" 523093 "DCU Node 6, status not available" 523094 "DCU Node 6, status not available" 523095 "DCU Node 6, status not available" 523096 "DCU Node 6, Error, Encoder Missing" 523097 "DCU Node 6, Error, Overspeed (EMF)" 523098 "DCU Node 6, Error, Encoder A Changed" 523099 "DCU Node 6, Error, Encoder B Changed" 523100 "DCU Node 6, Error Overcurrent, Out 01" 523101 "DCU Node 6, Error Overcurrent, Out 02" 523102 "DCU Node 6, Error Overcurrent, Out 03" 523103 "DCU Node 6, Error Overcurrent, Out 04" 523104 "DCU Node 6, Error Overcurrent, Fan" 523105 "DCU Node 6, Error Overcurrent ,Encoder" 523106 "DCU Node 6, Error Overcurrent, 24V Supply" 523107 "DCU Node 6, Error, Overfrequency" 523108 "DCU Node 6, Error Reset, Internal Overheat Control Board" 523109 "DCU Node 6, Error, Internal Overheat, Control Board" 523110 "DCU Node 6, Error, Ramp OH" 523111 "DCU Node 6, Error, Ramp OHI" 523112 "DCU Node 6, Error 24V Supply Undervoltage" 523113 "DCU Node 6, Error STO signals" 523114 "DCU Node 6, Error Ext. 24V Supply Undervoltage" 523115 "DCU Node 6, Error GTR7 Always OFF" 523116 "DCU Node 6, Error GTR7 OC" 523117 "DCU Node 6, Error GTR7 Always ON" 523118 "DCU Node 6, OC at 5V Diagnostic" 523119 "DCU Node 6, Error, Extreme Overpotential" 523120 "DCU Node 6, Error, DC Capacitor Damaged" 523121 "DCU Node 6, status not available" 523122 "DCU Node 6, status not available" 523123 "DCU Node 6, status not available" 523124 "DCU Node 6, status not available" 523125 "DCU Node 6, status not available" 523126 "DCU Node 6, status not available" 523127 "DCU Node 6, status not available" 523128 "DCU Node 6, status not available" 523129 "DCU Node 6, status not available" 523130 "DCU Node 6, status not available" 523131 "DCU Node 6, status not available" 523132 "DCU Node 6, status not available" 523133 "DCU Node 6, status not available" 523134 "DCU Node 6, status not available" 523135 "DCU Node 6, status not available" 523300 "App Node 6, No error" 523301 "App Node 6, No axis" 523302 "App Node 6, Error reading mapping" 523303 "App Node 6, Error reading rated current" 523304 "App Node 6, Error rated current mismatch" 523305 "App Node 6, Error write pll offset" 523306 "App Node 6, Error auto mapping" 523307 "App Node 6, Error interlink communication" 523308 "App Node 6, Error overload parameter" 523309 "App Node 6, Incompatible default download" 523310 "App Node 6, Error downloading default download" 523311 "App Node 6, Default download not found" 523312 "App Node 6, Error CAN data timeout" 523313 "App Node 6, Error CAN data invalid" 523314 "App Node 6, Invalid license" 523315 "App Node 6, Error reinitializing app" 523319 "App Node 6, General application error" ;
VAL_ 2566834768 SPN_DTC2 0 "No Error" 517290 "MCU Node 0, No Error" 517291 "MCU Node 0, No configuration file found" 517292 "MCU Node 0, Invalid J1939 license" 517293 "MCU Node 0, Error downloading configuration file" 517294 "MCU Node 0, Overload protection active" 517295 "MCU Node 0, Invalid app selection" 517296 "MCU Node 0, Overload warning active" 518000 "DCU Node 1, No Error" 518001 "DCU Node 1, status not available" 518002 "DCU Node 1, status not available" 518003 "DCU Node 1, Error, Overcurrent Power Unit" 518004 "DCU Node 1, Error, Overcurrent Analog" 518005 "DCU Node 1, Error, Overvoltage DC Link" 518006 "DCU Node 1, Error, Undervoltage DC Link" 518007 "DCU Node 1, Error, Overload" 518008 "DCU Node 1, Reset Error, Overload" 518009 "DCU Node 1, Error, Overload 02" 518010 "DCU Node 1, Error, Power Module Overheat" 518011 "DCU Node 1, Reset Error, Power Module Overheat" 518012 "DCU Node 1, Error, Internal Power Unit Overheat" 518013 "DCU Node 1, Reset Error, Internal Power Unit Overheat" 518014 "DCU Node 1, Error, Motor Protection" 518015 "DCU Node 1, Reset Error, Motor Protection" 518016 "DCU Node 1, Error, Drive Overheat" 518017 "DCU Node 1, Reset Error, Drive Overheat" 518018 "DCU Node 1, Error, Overspeed" 518019 "DCU Node 1, status not available" 518020 "DCU Node 1, Error, Drive Data" 518021 "DCU Node 1, Error, Motor Data Not Stored" 518022 "DCU Node 1, Error, Indentification" 518023 "DCU Node 1, Error, Speed Difference" 518024 "DCU Node 1, Error, Fieldbus Memory" 518025 "DCU Node 1, status not available" 518026 "DCU Node 1, status not available" 518027 "DCU Node 1, status not available" 518028 "DCU Node 1, status not available" 518029 "DCU Node 1, status not available" 518030 "DCU Node 1, status not available" 518031 "DCU Node 1, status not available" 518032 "DCU Node 1, status not available" 518033 "DCU Node 1, status not available" 518034 "DCU Node 1, status not available" 518035 "DCU Node 1, status not available" 518036 "DCU Node 1, status not available" 518037 "DCU Node 1, status not available" 518038 "DCU Node 1, Error, Memory Size" 518039 "DCU Node 1, Error, Power Unit Software Version" 518040 "DCU Node 1, Error, FPGA Config" 518041 "DCU Node 1, status not available" 518042 "DCU Node 1, status not available" 518043 "DCU Node 1, Error, Encoder Interface Communication" 518044 "DCU Node 1, Error, Invlid Data, Power Unit" 518045 "DCU Node 1, status not available" 518046 "DCU Node 1, status not available" 518047 "DCU Node 1, status not available" 518048 "DCU Node 1, status not available" 518049 "DCU Node 1, status not available" 518050 "DCU Node 1, status not available" 518051 "DCU Node 1, status not available" 518052 "DCU Node 1, Error, Phase Undervoltage" 518053 "DCU Node 1, Error, Rotor Detection Current" 518054 "DCU Node 1, status not available" 518055 "DCU Node 1, status not available" 518056 "DCU Node 1, Error, SW Switch Left" 518057 "DCU Node 1, Error, SW Switch Right" 518058 "DCU Node 1, Error, Fieldbus Watchdog Response" 518059 "DCU Node 1, Error, Prog. Input" 518060 "DCU Node 1, status not available" 518061 "DCU Node 1, status not available" 518062 "DCU Node 1, Error, Power Unit Changed" 518063 "DCU Node 1, Error, Encoder Interface Changed" 518064 "DCU Node 1, Error, Power Unit Type Changed" 518065 "DCU Node 1, Error, Invalid Ver., Encoder Interface" 518066 "DCU Node 1, Error, Overcurrent" 518067 "DCU Node 1, Error, Max Accel/Decel Setting Exceeded" 518068 "DCU Node 1, Error, Overcurrent Brake" 518069 "DCU Node 1, Error, Power Unit" 518070 "DCU Node 1, status not available" 518071 "DCU Node 1, status not available" 518072 "DCU Node 1, status not available" 518073 "DCU Node 1, status not available" 518074 "DCU Node 1, status not available" 518075 "DCU Node 1, status not available" 518076 "DCU Node 1, status not available" 518077 "DCU Node 1, status not available" 518078 "DCU Node 1, status not available" 518079 "DCU Node 1, status not available" 518080 "DCU Node 1, status not available" 518081 "DCU Node 1, Error, Rotor Detection, Five Step" 518082 "DCU Node 1, Error, Rotor Detection, Ld equal Lq" 518083 "DCU Node 1, Error, Limit Switch Forward" 518084 "DCU Node 1, Error, Limit Switch Reverse" 518085 "DCU Node 1, Error, Limit Switch Override Forward" 518086 "DCU Node 1, Error, Limit Switch Override Reverse" 518087 "DCU Node 1, Error Limit Switch" 518088 "DCU Node 1, Error, Power Off End" 518089 "DCU Node 1, Error, Encoder Type Change" 518090 "DCU Node 1, Error, Control Board Communication" 518091 "DCU Node 1, INIT, Encoder Interface" 518092 "DCU Node 1, status not available" 518093 "DCU Node 1, status not available" 518094 "DCU Node 1, status not available" 518095 "DCU Node 1, status not available" 518096 "DCU Node 1, Error, Encoder Missing" 518097 "DCU Node 1, Error, Overspeed (EMF)" 518098 "DCU Node 1, Error, Encoder A Changed" 518099 "DCU Node 1, Error, Encoder B Changed" 518100 "DCU Node 1, Error Overcurrent, Out 01" 518101 "DCU Node 1, Error Overcurrent, Out 02" 518102 "DCU Node 1, Error Overcurrent, Out 03" 518103 "DCU Node 1, Error Overcurrent, Out 04" 518104 "DCU Node 1, Error Overcurrent, Fan" 518105 "DCU Node 1, Error Overcurrent ,Encoder" 518106 "DCU Node 1, Error Overcurrent, 24V Supply" 518107 "DCU Node 1, Error, Overfrequency" 518108 "DCU Node 1, Error Reset, Internal Overheat Control Board" 518109 "DCU Node 1, Error, Internal Overheat, Control Board" 518110 "DCU Node 1, Error, Ramp OH" 518111 "DCU Node 1, Error, Ramp OHI" 518112 "DCU Node 1, Error 24V Supply Undervoltage" 518113 "DCU Node 1, Error STO signals" 518114 "DCU Node 1, Error Ext. 24V Supply Undervoltage" 518115 "DCU Node 1, Error GTR7 Always OFF" 518116 "DCU Node 1, Error GTR7 OC" 518117 "DCU Node 1, Error GTR7 Always ON" 518118 "DCU Node 1, OC at 5V Diagnostic" 518119 "DCU Node 1, Error, Extreme Overpotential" 518120 "DCU Node 1, Error, DC Capacitor Damaged" 518121 "DCU Node 1, status not available" 518122 "DCU Node 1, status not available" 518123 "DCU Node 1, status not available" 518124 "DCU Node 1, status not available" 518125 "DCU Node 1, status not available" 518126 "DCU Node 1, status not available" 518127 "DCU Node 1, status not available" 518128 "DCU Node 1, status not available" 518129 "DCU Node 1, status not available" 518130 "DCU Node 1, status not available" 518131 "DCU Node 1, status not available" 518132 "DCU Node 1, status not available" 518133 "DCU Node 1, status not available" 518134 "DCU Node 1, status not available" 518135 "DCU Node 1, status not available" 518300 "App Node 1, No error" 518301 "App Node 1, No axis" 518302 "App Node 1, Error reading mapping" 518303 "App Node 1, Error reading rated current" 518304 "App Node 1, Error rated current mismatch" 518305 "App Node 1, Error write pll offset" 518306 "App Node 1, Error auto mapping" 518307 "App Node 1, Error interlink communication" 518308 "App Node 1, Error overload parameter" 518309 "App Node 1, Incompatible default download" 518310 "App Node 1, Error downloading default download" 518311 "App Node 1, Default download not found" 518312 "App Node 1, Error CAN data timeout" 518313 "App Node 1, Error CAN data invalid" 518314 "App Node 1, Invalid license" 518315 "App Node 1, Error reinitializing app" 518319 "App Node 1, General application error" 519000 "DCU Node 2, No Error" 519001 "DCU Node 2, status not available" 519002 "DCU Node 2, status not available" 519003 "DCU Node 2, Error, Overcurrent Power Unit" 519004 "DCU Node 2, Error, Overcurrent Analog" 519005 "DCU Node 2, Error, Overvoltage DC Link" 519006 "DCU Node 2, Error, Undervoltage DC Link" 519007 "DCU Node 2, Error, Overload" 519008 "DCU Node 2, Reset Error, Overload" 519009 "DCU Node 2, Error, Overload 02" 519010 "DCU Node 2, Error, Power Module Overheat" 519011 "DCU Node 2, Reset Error, Power Module Overheat" 519012 "DCU Node 2, Error, Internal Power Unit Overheat" 519013 "DCU Node 2, Reset Error, Internal Power Unit Overheat" 519014 "DCU Node 2, Error, Motor Protection" 519015 "DCU Node 2, Reset Error, Motor Protection" 519016 "DCU Node 2, Error, Drive Overheat" 519017 "DCU Node 2, Reset Error, Drive Overheat" 519018 "DCU Node 2, Error, Overspeed" 519019 "DCU Node 2, status not available" 519020 "DCU Node 2, Error, Drive Data" 519021 "DCU Node 2, Error, Motor Data Not Stored" 519022 "DCU Node 2, Error, Indentification" 519023 "DCU Node 2, Error, Speed Difference" 519024 "DCU Node 2, Error, Fieldbus Memory" 519025 "DCU Node 2, status not available" 519026 "DCU Node 2, status not available" 519027 "DCU Node 2, status not available" 519028 "DCU Node 2, status not available" 519029 "DCU Node 2, status not available" 519030 "DCU Node 2, status not available" 519031 "DCU Node 2, status not available" 519032 "DCU Node 2, status not available" 519033 "DCU Node 2, status not available" 519034 "DCU Node 2, status not available" 519035 "DCU Node 2, status not available" 519036 "DCU Node 2, status not available" 519037 "DCU Node 2, status not available" 519038 "DCU Node 2, Error, Memory Size" 519039 "DCU Node 2, Error, Power Unit Software Version" 519040 "DCU Node 2, Error, FPGA Config" 519041 "DCU Node 2, status not available" 519042 "DCU Node 2, status not available" 519043 "DCU Node 2, Error, Encoder Interface Communication" 519044 "DCU Node 2, Error, Invlid Data, Power Unit" 519045 "DCU Node 2, status not available" 519046 "DCU Node 2, status not available" 519047 "DCU Node 2, status not available" 519048 "DCU Node 2, status not available" 519049 "DCU Node 2, status not available" 519050 "DCU Node 2, status not available" 519051 "DCU Node 2, status not available" 519052 "DCU Node 2, Error, Phase Undervoltage" 519053 "DCU Node 2, Error, Rotor Detection Current" 519054 "DCU Node 2, status not available" 519055 "DCU Node 2, status not available" 519056 "DCU Node 2, Error, SW Switch Left" 519057 "DCU Node 2, Error, SW Switch Right" 519058 "DCU Node 2, Error, Fieldbus Watchdog Response" 519059 "DCU Node 2, Error, Prog. Input" 519060 "DCU Node 2, status not available" 519061 "DCU Node 2, status not available" 519062 "DCU Node 2, Error, Power Unit Changed" 519063 "DCU Node 2, Error, Encoder Interface Changed" 519064 "DCU Node 2, Error, Power Unit Type Changed" 519065 "DCU Node 2, Error, Invalid Ver., Encoder Interface" 519066 "DCU Node 2, Error, Overcurrent" 519067 "DCU Node 2, Error, Max Accel/Decel Setting Exceeded" 519068 "DCU Node 2, Error, Overcurrent Brake" 519069 "DCU Node 2, Error, Power Unit" 519070 "DCU Node 2, status not available" 519071 "DCU Node 2, status not available" 519072 "DCU Node 2, status not available" 519073 "DCU Node 2, status not available" 519074 "DCU Node 2, status not available" 519075 "DCU Node 2, status not available" 519076 "DCU Node 2, status not available" 519077 "DCU Node 2, status not available" 519078 "DCU Node 2, status not available" 519079 "DCU Node 2, status not available" 519080 "DCU Node 2, status not available" 519081 "DCU Node 2, Error, Rotor Detection, Five Step" 519082 "DCU Node 2, Error, Rotor Detection, Ld equal Lq" 519083 "DCU Node 2, Error, Limit Switch Forward" 519084 "DCU Node 2, Error, Limit Switch Reverse" 519085 "DCU Node 2, Error, Limit Switch Override Forward" 519086 "DCU Node 2, Error, Limit Switch Override Reverse" 519087 "DCU Node 2, Error Limit Switch" 519088 "DCU Node 2, Error, Power Off End" 519089 "DCU Node 2, Error, Encoder Type Change" 519090 "DCU Node 2, Error, Control Board Communication" 519091 "DCU Node 2, INIT, Encoder Interface" 519092 "DCU Node 2, status not available" 519093 "DCU Node 2, status not available" 519094 "DCU Node 2, status not available" 519095 "DCU Node 2, status not available" 519096 "DCU Node 2, Error, Encoder Missing" 519097 "DCU Node 2, Error, Overspeed (EMF)" 519098 "DCU Node 2, Error, Encoder A Changed" 519099 "DCU Node 2, Error, Encoder B Changed" 519100 "DCU Node 2, Error Overcurrent, Out 01" 519101 "DCU Node 2, Error Overcurrent, Out 02" 519102 "DCU Node 2, Error Overcurrent, Out 03" 519103 "DCU Node 2, Error Overcurrent, Out 04" 519104 "DCU Node 2, Error Overcurrent, Fan" 519105 "DCU Node 2, Error Overcurrent ,Encoder" 519106 "DCU Node 2, Error Overcurrent, 24V Supply" 519107 "DCU Node 2, Error, Overfrequency" 519108 "DCU Node 2, Error Reset, Internal Overheat Control Board" 519109 "DCU Node 2, Error, Internal Overheat, Control Board" 519110 "DCU Node 2, Error, Ramp OH" 519111 "DCU Node 2, Error, Ramp OHI" 519112 "DCU Node 2, Error 24V Supply Undervoltage" 519113 "DCU Node 2, Error STO signals" 519114 "DCU Node 2, Error Ext. 24V Supply Undervoltage" 519115 "DCU Node 2, Error GTR7 Always OFF" 519116 "DCU Node 2, Error GTR7 OC" 519117 "DCU Node 2, Error GTR7 Always ON" 519118 "DCU Node 2, OC at 5V Diagnostic" 519119 "DCU Node 2, Error, Extreme Overpotential" 519120 "DCU Node 2, Error, DC Capacitor Damaged" 519121 "DCU Node 2, status not available" 519122 "DCU Node 2, status not available" 519123 "DCU Node 2, status not available" 519124 "DCU Node 2, status not available" 519125 "DCU Node 2, status not available" 519126 "DCU Node 2, status not available" 519127 "DCU Node 2, status not available" 519128 "DCU Node 2, status not available" 519129 "DCU Node 2, status not available" 519130 "DCU Node 2, status not available" 519131 "DCU Node 2, status not available" 519132 "DCU Node 2, status not available" 519133 "DCU Node 2, status not available" 519134 "DCU Node 2, status not available" 519135 "DCU Node 2, status not available" 519300 "App Node 2, No error" 519301 "App Node 2, No axis" 519302 "App Node 2, Error reading mapping" 519303 "App Node 2, Error reading rated current" 519304 "App Node 2, Error rated current mismatch" 519305 "App Node 2, Error write pll offset" 519306 "App Node 2, Error auto mapping" 519307 "App Node 2, Error interlink communication" 519308 "App Node 2, Error overload parameter" 519309 "App Node 2, Incompatible default download" 519310 "App Node 2, Error downloading default download" 519311 "App Node 2, Default download not found" 519312 "App Node 2, Error CAN data timeout" 519313 "App Node 2, Error CAN data invalid" 519314 "App Node 2, Invalid license" 519315 "App Node 2, Error reinitializing app" 519319 "App Node 2, General application error" 520000 "DCU Node 3, No Error" 520001 "DCU Node 3, status not available" 520002 "DCU Node 3, status not available" 520003 "DCU Node 3, Error, Overcurrent Power Unit" 520004 "DCU Node 3, Error, Overcurrent Analog" 520005 "DCU Node 3, Error, Overvoltage DC Link" 520006 "DCU Node 3, Error, Undervoltage DC Link" 520007 "DCU Node 3, Error, Overload" 520008 "DCU Node 3, Reset Error, Overload" 520009 "DCU Node 3, Error, Overload 02" 520010 "DCU Node 3, Error, Power Module Overheat" 520011 "DCU Node 3, Reset Error, Power Module Overheat" 520012 "DCU Node 3, Error, Internal Power Unit Overheat" 520013 "DCU Node 3, Reset Error, Internal Power Unit Overheat" 520014 "DCU Node 3, Error, Motor Protection" 520015 "DCU Node 3, Reset Error, Motor Protection" 520016 "DCU Node 3, Error, Drive Overheat" 520017 "DCU Node 3, Reset Error, Drive Overheat" 520018 "DCU Node 3, Error, Overspeed" 520019 "DCU Node 3, status not available" 520020 "DCU Node 3, Error, Drive Data" 520021 "DCU Node 3, Error, Motor Data Not Stored" 520022 "DCU Node 3, Error, Indentification" 520023 "DCU Node 3, Error, Speed Difference" 520024 "DCU Node 3, Error, Fieldbus Memory" 520025 "DCU Node 3, status not available" 520026 "DCU Node 3, status not available" 520027 "DCU Node 3, status not available" 520028 "DCU Node 3, status not available" 520029 "DCU Node 3, status not available" 520030 "DCU Node 3, status not available" 520031 "DCU Node 3, status not available" 520032 "DCU Node 3, status not available" 520033 "DCU Node 3, status not available" 520034 "DCU Node 3, status not available" 520035 "DCU Node 3, status not available" 520036 "DCU Node 3, status not available" 520037 "DCU Node 3, status not available" 520038 "DCU Node 3, Error, Memory Size" 520039 "DCU Node 3, Error, Power Unit Software Version" 520040 "DCU Node 3, Error, FPGA Config" 520041 "DCU Node 3, status not available" 520042 "DCU Node 3, status not available" 520043 "DCU Node 3, Error, Encoder Interface Communication" 520044 "DCU Node 3, Error, Invlid Data, Power Unit" 520045 "DCU Node 3, status not available" 520046 "DCU Node 3, status not available" 520047 "DCU Node 3, status not available" 520048 "DCU Node 3, status not available" 520049 "DCU Node 3, status not available" 520050 "DCU Node 3, status not available" 520051 "DCU Node 3, status not available" 520052 "DCU Node 3, Error, Phase Undervoltage" 520053 "DCU Node 3, Error, Rotor Detection Current" 520054 "DCU Node 3, status not available" 520055 "DCU Node 3, status not available" 520056 "DCU Node 3, Error, SW Switch Left" 520057 "DCU Node 3, Error, SW Switch Right" 520058 "DCU Node 3, Error, Fieldbus Watchdog Response" 520059 "DCU Node 3, Error, Prog. Input" 520060 "DCU Node 3, status not available" 520061 "DCU Node 3, status not available" 520062 "DCU Node 3, Error, Power Unit Changed" 520063 "DCU Node 3, Error, Encoder Interface Changed" 520064 "DCU Node 3, Error, Power Unit Type Changed" 520065 "DCU Node 3, Error, Invalid Ver., Encoder Interface" 520066 "DCU Node 3, Error, Overcurrent" 520067 "DCU Node 3, Error, Max Accel/Decel Setting Exceeded" 520068 "DCU Node 3, Error, Overcurrent Brake" 520069 "DCU Node 3, Error, Power Unit" 520070 "DCU Node 3, status not available" 520071 "DCU Node 3, status not available" 520072 "DCU Node 3, status not available" 520073 "DCU Node 3, status not available" 520074 "DCU Node 3, status not available" 520075 "DCU Node 3, status not available" 520076 "DCU Node 3, status not available" 520077 "DCU Node 3, status not available" 520078 "DCU Node 3, status not available" 520079 "DCU Node 3, status not available" 520080 "DCU Node 3, status not available" 520081 "DCU Node 3, Error, Rotor Detection, Five Step" 520082 "DCU Node 3, Error, Rotor Detection, Ld equal Lq" 520083 "DCU Node 3, Error, Limit Switch Forward" 520084 "DCU Node 3, Error, Limit Switch Reverse" 520085 "DCU Node 3, Error, Limit Switch Override Forward" 520086 "DCU Node 3, Error, Limit Switch Override Reverse" 520087 "DCU Node 3, Error Limit Switch" 520088 "DCU Node 3, Error, Power Off End" 520089 "DCU Node 3, Error, Encoder Type Change" 520090 "DCU Node 3, Error, Control Board Communication" 520091 "DCU Node 3, INIT, Encoder Interface" 520092 "DCU Node 3, status not available" 520093 "DCU Node 3, status not available" 520094 "DCU Node 3, status not available" 520095 "DCU Node 3, status not available" 520096 "DCU Node 3, Error, Encoder Missing" 520097 "DCU Node 3, Error, Overspeed (EMF)" 520098 "DCU Node 3, Error, Encoder A Changed" 520099 "DCU Node 3, Error, Encoder B Changed" 520100 "DCU Node 3, Error Overcurrent, Out 01" 520101 "DCU Node 3, Error Overcurrent, Out 02" 520102 "DCU Node 3, Error Overcurrent, Out 03" 520103 "DCU Node 3, Error Overcurrent, Out 04" 520104 "DCU Node 3, Error Overcurrent, Fan" 520105 "DCU Node 3, Error Overcurrent ,Encoder" 520106 "DCU Node 3, Error Overcurrent, 24V Supply" 520107 "DCU Node 3, Error, Overfrequency" 520108 "DCU Node 3, Error Reset, Internal Overheat Control Board" 520109 "DCU Node 3, Error, Internal Overheat, Control Board" 520110 "DCU Node 3, Error, Ramp OH" 520111 "DCU Node 3, Error, Ramp OHI" 520112 "DCU Node 3, Error 24V Supply Undervoltage" 520113 "DCU Node 3, Error STO signals" 520114 "DCU Node 3, Error Ext. 24V Supply Undervoltage" 520115 "DCU Node 3, Error GTR7 Always OFF" 520116 "DCU Node 3, Error GTR7 OC" 520117 "DCU Node 3, Error GTR7 Always ON" 520118 "DCU Node 3, OC at 5V Diagnostic" 520119 "DCU Node 3, Error, Extreme Overpotential" 520120 "DCU Node 3, Error, DC Capacitor Damaged" 520121 "DCU Node 3, status not available" 520122 "DCU Node 3, status not available" 520123 "DCU Node 3, status not available" 520124 "DCU Node 3, status not available" 520125 "DCU Node 3, status not available" 520126 "DCU Node 3, status not available" 520127 "DCU Node 3, status not available" 520128 "DCU Node 3, status not available" 520129 "DCU Node 3, status not available" 520130 "DCU Node 3, status not available" 520131 "DCU Node 3, status not available" 520132 "DCU Node 3, status not available" 520133 "DCU Node 3, status not available" 520134 "DCU Node 3, status not available" 520135 "DCU Node 3, status not available" 520300 "App Node 3, No error" 520301 "App Node 3, No axis" 520302 "App Node 3, Error reading mapping" 520303 "App Node 3, Error reading rated current" 520304 "App Node 3, Error rated current mismatch" 520305 "App Node 3, Error write pll offset" 520306 "App Node 3, Error auto mapping" 520307 "App Node 3, Error interlink communication" 520308 "App Node 3, Error overload parameter" 520309 "App Node 3, Incompatible default download" 520310 "App Node 3, Error downloading default download" 520311 "App Node 3, Default download not found" 520312 "App Node 3, Error CAN data timeout" 520313 "App Node 3, Error CAN data invalid" 520314 "App Node 3, Invalid license" 520315 "App Node 3, Error reinitializing app" 520319 "App Node 3, General application error" 521000 "DCU Node 4, No Error" 521001 "DCU Node 4, status not available" 521002 "DCU Node 4, status not available" 521003 "DCU Node 4, Error, Overcurrent Power Unit" 521004 "DCU Node 4, Error, Overcurrent Analog" 521005 "DCU Node 4, Error, Overvoltage DC Link" 521006 "DCU Node 4, Error, Undervoltage DC Link" 521007 "DCU Node 4, Error, Overload" 521008 "DCU Node 4, Reset Error, Overload" 521009 "DCU Node 4, Error, Overload 02" 521010 "DCU Node 4, Error, Power Module Overheat" 521011 "DCU Node 4, Reset Error, Power Module Overheat" 521012 "DCU Node 4, Error, Internal Power Unit Overheat" 521013 "DCU Node 4, Reset Error, Internal Power Unit Overheat" 521014 "DCU Node 4, Error, Motor Protection" 521015 "DCU Node 4, Reset Error, Motor Protection" 521016 "DCU Node 4, Error, Drive Overheat" 521017 "DCU Node 4, Reset Error, Drive Overheat" 521018 "DCU Node 4, Error, Overspeed" 521019 "DCU Node 4, status not available" 521020 "DCU Node 4, Error, Drive Data" 521021 "DCU Node 4, Error, Motor Data Not Stored" 521022 "DCU Node 4, Error, Indentification" 521023 "DCU Node 4, Error, Speed Difference" 521024 "DCU Node 4, Error, Fieldbus Memory" 521025 "DCU Node 4, status not available" 521026 "DCU Node 4, status not available" 521027 "DCU Node 4, status not available" 521028 "DCU Node 4, status not available" 521029 "DCU Node 4, status not available" 521030 "DCU Node 4, status not available" 521031 "DCU Node 4, status not available" 521032 "DCU Node 4, status not available" 521033 "DCU Node 4, status not available" 521034 "DCU Node 4, status not available" 521035 "DCU Node 4, status not available" 521036 "DCU Node 4, status not available" 521037 "DCU Node 4, status not available" 521038 "DCU Node 4, Error, Memory Size" 521039 "DCU Node 4, Error, Power Unit Software Version" 521040 "DCU Node 4, Error, FPGA Config" 521041 "DCU Node 4, status not available" 521042 "DCU Node 4, status not available" 521043 "DCU Node 4, Error, Encoder Interface Communication" 521044 "DCU Node 4, Error, Invlid Data, Power Unit" 521045 "DCU Node 4, status not available" 521046 "DCU Node 4, status not available" 521047 "DCU Node 4, status not available" 521048 "DCU Node 4, status not available" 521049 "DCU Node 4, status not available" 521050 "DCU Node 4, status not available" 521051 "DCU Node 4, status not available" 521052 "DCU Node 4, Error, Phase Undervoltage" 521053 "DCU Node 4, Error, Rotor Detection Current" 521054 "DCU Node 4, status not available" 521055 "DCU Node 4, status not available" 521056 "DCU Node 4, Error, SW Switch Left" 521057 "DCU Node 4, Error, SW Switch Right" 521058 "DCU Node 4, Error, Fieldbus Watchdog Response" 521059 "DCU Node 4, Error, Prog. Input" 521060 "DCU Node 4, status not available" 521061 "DCU Node 4, status not available" 521062 "DCU Node 4, Error, Power Unit Changed" 521063 "DCU Node 4, Error, Encoder Interface Changed" 521064 "DCU Node 4, Error, Power Unit Type Changed" 521065 "DCU Node 4, Error, Invalid Ver., Encoder Interface" 521066 "DCU Node 4, Error, Overcurrent" 521067 "DCU Node 4, Error, Max Accel/Decel Setting Exceeded" 521068 "DCU Node 4, Error, Overcurrent Brake" 521069 "DCU Node 4, Error, Power Unit" 521070 "DCU Node 4, status not available" 521071 "DCU Node 4, status not available" 521072 "DCU Node 4, status not available" 521073 "DCU Node 4, status not available" 521074 "DCU Node 4, status not available" 521075 "DCU Node 4, status not available" 521076 "DCU Node 4, status not available" 521077 "DCU Node 4, status not available" 521078 "DCU Node 4, status not available" 521079 "DCU Node 4, status not available" 521080 "DCU Node 4, status not available" 521081 "DCU Node 4, Error, Rotor Detection, Five Step" 521082 "DCU Node 4, Error, Rotor Detection, Ld equal Lq" 521083 "DCU Node 4, Error, Limit Switch Forward" 521084 "DCU Node 4, Error, Limit Switch Reverse" 521085 "DCU Node 4, Error, Limit Switch Override Forward" 521086 "DCU Node 4, Error, Limit Switch Override Reverse" 521087 "DCU Node 4, Error Limit Switch" 521088 "DCU Node 4, Error, Power Off End" 521089 "DCU Node 4, Error, Encoder Type Change" 521090 "DCU Node 4, Error, Control Board Communication" 521091 "DCU Node 4, INIT, Encoder Interface" 521092 "DCU Node 4, status not available" 521093 "DCU Node 4, status not available" 521094 "DCU Node 4, status not available" 521095 "DCU Node 4, status not available" 521096 "DCU Node 4, Error, Encoder Missing" 521097 "DCU Node 4, Error, Overspeed (EMF)" 521098 "DCU Node 4, Error, Encoder A Changed" 521099 "DCU Node 4, Error, Encoder B Changed" 521100 "DCU Node 4, Error Overcurrent, Out 01" 521101 "DCU Node 4, Error Overcurrent, Out 02" 521102 "DCU Node 4, Error Overcurrent, Out 03" 521103 "DCU Node 4, Error Overcurrent, Out 04" 521104 "DCU Node 4, Error Overcurrent, Fan" 521105 "DCU Node 4, Error Overcurrent ,Encoder" 521106 "DCU Node 4, Error Overcurrent, 24V Supply" 521107 "DCU Node 4, Error, Overfrequency" 521108 "DCU Node 4, Error Reset, Internal Overheat Control Board" 521109 "DCU Node 4, Error, Internal Overheat, Control Board" 521110 "DCU Node 4, Error, Ramp OH" 521111 "DCU Node 4, Error, Ramp OHI" 521112 "DCU Node 4, Error 24V Supply Undervoltage" 521113 "DCU Node 4, Error STO signals" 521114 "DCU Node 4, Error Ext. 24V Supply Undervoltage" 521115 "DCU Node 4, Error GTR7 Always OFF" 521116 "DCU Node 4, Error GTR7 OC" 521117 "DCU Node 4, Error GTR7 Always ON" 521118 "DCU Node 4, OC at 5V Diagnostic" 521119 "DCU Node 4, Error, Extreme Overpotential" 521120 "DCU Node 4, Error, DC Capacitor Damaged" 521121 "DCU Node 4, status not available" 521122 "DCU Node 4, status not available" 521123 "DCU Node 4, status not available" 521124 "DCU Node 4, status not available" 521125 "DCU Node 4, status not available" 521126 "DCU Node 4, status not available" 521127 "DCU Node 4, status not available" 521128 "DCU Node 4, status not available" 521129 "DCU Node 4, status not available" 521130 "DCU Node 4, status not available" 521131 "DCU Node 4, status not available" 521132 "DCU Node 4, status not available" 521133 "DCU Node 4, status not available" 521134 "DCU Node 4, status not available" 521135 "DCU Node 4, status not available" 521300 "App Node 4, No error" 521301 "App Node 4, No axis" 521302 "App Node 4, Error reading mapping" 521303 "App Node 4, Error reading rated current" 521304 "App Node 4, Error rated current mismatch" 521305 "App Node 4, Error write pll offset" 521306 "App Node 4, Error auto mapping" 521307 "App Node 4, Error interlink communication" 521308 "App Node 4, Error overload parameter" 521309 "App Node 4, Incompatible default download" 521310 "App Node 4, Error downloading default download" 521311 "App Node 4, Default download not found" 521312 "App Node 4, Error CAN data timeout" 521313 "App Node 4, Error CAN data invalid" 521314 "App Node 4, Invalid license" 521315 "App Node 4, Error reinitializing app" 521319 "App Node 4, General application error" 522000 "DCU Node 5, No Error" 522001 "DCU Node 5, status not available" 522002 "DCU Node 5, status not available" 522003 "DCU Node 5, Error, Overcurrent Power Unit" 522004 "DCU Node 5, Error, Overcurrent Analog" 522005 "DCU Node 5, Error, Overvoltage DC Link" 522006 "DCU Node 5, Error, Undervoltage DC Link" 522007 "DCU Node 5, Error, Overload" 522008 "DCU Node 5, Reset Error, Overload" 522009 "DCU Node 5, Error, Overload 02" 522010 "DCU Node 5, Error, Power Module Overheat" 522011 "DCU Node 5, Reset Error, Power Module Overheat" 522012 "DCU Node 5, Error, Internal Power Unit Overheat" 522013 "DCU Node 5, Reset Error, Internal Power Unit Overheat" 522014 "DCU Node 5, Error, Motor Protection" 522015 "DCU Node 5, Reset Error, Motor Protection" 522016 "DCU Node 5, Error, Drive Overheat" 522017 "DCU Node 5, Reset Error, Drive Overheat" 522018 "DCU Node 5, Error, Overspeed" 522019 "DCU Node 5, status not available" 522020 "DCU Node 5, Error, Drive Data" 522021 "DCU Node 5, Error, Motor Data Not Stored" 522022 "DCU Node 5, Error, Indentification" 522023 "DCU Node 5, Error, Speed Difference" 522024 "DCU Node 5, Error, Fieldbus Memory" 522025 "DCU Node 5, status not available" 522026 "DCU Node 5, status not available" 522027 "DCU Node 5, status not available" 522028 "DCU Node 5, status not available" 522029 "DCU Node 5, status not available" 522030 "DCU Node 5, status not available" 522031 "DCU Node 5, status not available" 522032 "DCU Node 5, status not available" 522033 "DCU Node 5, status not available" 522034 "DCU Node 5, status not available" 522035 "DCU Node 5, status not available" 522036 "DCU Node 5, status not available" 522037 "DCU Node 5, status not available" 522038 "DCU Node 5, Error, Memory Size" 522039 "DCU Node 5, Error, Power Unit Software Version" 522040 "DCU Node 5, Error, FPGA Config" 522041 "DCU Node 5, status not available" 522042 "DCU Node 5, status not available" 522043 "DCU Node 5, Error, Encoder Interface Communication" 522044 "DCU Node 5, Error, Invlid Data, Power Unit" 522045 "DCU Node 5, status not available" 522046 "DCU Node 5, status not available" 522047 "DCU Node 5, status not available" 522048 "DCU Node 5, status not available" 522049 "DCU Node 5, status not available" 522050 "DCU Node 5, status not available" 522051 "DCU Node 5, status not available" 522052 "DCU Node 5, Error, Phase Undervoltage" 522053 "DCU Node 5, Error, Rotor Detection Current" 522054 "DCU Node 5, status not available" 522055 "DCU Node 5, status not available" 522056 "DCU Node 5, Error, SW Switch Left" 522057 "DCU Node 5, Error, SW Switch Right" 522058 "DCU Node 5, Error, Fieldbus Watchdog Response" 522059 "DCU Node 5, Error, Prog. Input" 522060 "DCU Node 5, status not available" 522061 "DCU Node 5, status not available" 522062 "DCU Node 5, Error, Power Unit Changed" 522063 "DCU Node 5, Error, Encoder Interface Changed" 522064 "DCU Node 5, Error, Power Unit Type Changed" 522065 "DCU Node 5, Error, Invalid Ver., Encoder Interface" 522066 "DCU Node 5, Error, Overcurrent" 522067 "DCU Node 5, Error, Max Accel/Decel Setting Exceeded" 522068 "DCU Node 5, Error, Overcurrent Brake" 522069 "DCU Node 5, Error, Power Unit" 522070 "DCU Node 5, status not available" 522071 "DCU Node 5, status not available" 522072 "DCU Node 5, status not available" 522073 "DCU Node 5, status not available" 522074 "DCU Node 5, status not available" 522075 "DCU Node 5, status not available" 522076 "DCU Node 5, status not available" 522077 "DCU Node 5, status not available" 522078 "DCU Node 5, status not available" 522079 "DCU Node 5, status not available" 522080 "DCU Node 5, status not available" 522081 "DCU Node 5, Error, Rotor Detection, Five Step" 522082 "DCU Node 5, Error, Rotor Detection, Ld equal Lq" 522083 "DCU Node 5, Error, Limit Switch Forward" 522084 "DCU Node 5, Error, Limit Switch Reverse" 522085 "DCU Node 5, Error, Limit Switch Override Forward" 522086 "DCU Node 5, Error, Limit Switch Override Reverse" 522087 "DCU Node 5, Error Limit Switch" 522088 "DCU Node 5, Error, Power Off End" 522089 "DCU Node 5, Error, Encoder Type Change" 522090 "DCU Node 5, Error, Control Board Communication" 522091 "DCU Node 5, INIT, Encoder Interface" 522092 "DCU Node 5, status not available" 522093 "DCU Node 5, status not available" 522094 "DCU Node 5, status not available" 522095 "DCU Node 5, status not available" 522096 "DCU Node 5, Error, Encoder Missing" 522097 "DCU Node 5, Error, Overspeed (EMF)" 522098 "DCU Node 5, Error, Encoder A Changed" 522099 "DCU Node 5, Error, Encoder B Changed" 522100 "DCU Node 5, Error Overcurrent, Out 01" 522101 "DCU Node 5, Error Overcurrent, Out 02" 522102 "DCU Node 5, Error Overcurrent, Out 03" 522103 "DCU Node 5, Error Overcurrent, Out 04" 522104 "DCU Node 5, Error Overcurrent, Fan" 522105 "DCU Node 5, Error Overcurrent ,Encoder" 522106 "DCU Node 5, Error Overcurrent, 24V Supply" 522107 "DCU Node 5, Error, Overfrequency" 522108 "DCU Node 5, Error Reset, Internal Overheat Control Board" 522109 "DCU Node 5, Error, Internal Overheat, Control Board" 522110 "DCU Node 5, Error, Ramp OH" 522111 "DCU Node 5, Error, Ramp OHI" 522112 "DCU Node 5, Error 24V Supply Undervoltage" 522113 "DCU Node 5, Error STO signals" 522114 "DCU Node 5, Error Ext. 24V Supply Undervoltage" 522115 "DCU Node 5, Error GTR7 Always OFF" 522116 "DCU Node 5, Error GTR7 OC" 522117 "DCU Node 5, Error GTR7 Always ON" 522118 "DCU Node 5, OC at 5V Diagnostic" 522119 "DCU Node 5, Error, Extreme Overpotential" 522120 "DCU Node 5, Error, DC Capacitor Damaged" 522121 "DCU Node 5, status not available" 522122 "DCU Node 5, status not available" 522123 "DCU Node 5, status not available" 522124 "DCU Node 5, status not available" 522125 "DCU Node 5, status not available" 522126 "DCU Node 5, status not available" 522127 "DCU Node 5, status not available" 522128 "DCU Node 5, status not available" 522129 "DCU Node 5, status not available" 522130 "DCU Node 5, status not available" 522131 "DCU Node 5, status not available" 522132 "DCU Node 5, status not available" 522133 "DCU Node 5, status not available" 522134 "DCU Node 5, status not available" 522135 "DCU Node 5, status not available" 522300 "App Node 5, No error" 522301 "App Node 5, No axis" 522302 "App Node 5, Error reading mapping" 522303 "App Node 5, Error reading rated current" 522304 "App Node 5, Error rated current mismatch" 522305 "App Node 5, Error write pll offset" 522306 "App Node 5, Error auto mapping" 522307 "App Node 5, Error interlink communication" 522308 "App Node 5, Error overload parameter" 522309 "App Node 5, Incompatible default download" 522310 "App Node 5, Error downloading default download" 522311 "App Node 5, Default download not found" 522312 "App Node 5, Error CAN data timeout" 522313 "App Node 5, Error CAN data invalid" 522314 "App Node 5, Invalid license" 522315 "App Node 5, Error reinitializing app" 522319 "App Node 5, General application error" 523000 "DCU Node 6, No Error" 523001 "DCU Node 6, status not available" 523002 "DCU Node 6, status not available" 523003 "DCU Node 6, Error, Overcurrent Power Unit" 523004 "DCU Node 6, Error, Overcurrent Analog" 523005 "DCU Node 6, Error, Overvoltage DC Link" 523006 "DCU Node 6, Error, Undervoltage DC Link" 523007 "DCU Node 6, Error, Overload" 523008 "DCU Node 6, Reset Error, Overload" 523009 "DCU Node 6, Error, Overload 02" 523010 "DCU Node 6, Error, Power Module Overheat" 523011 "DCU Node 6, Reset Error, Power Module Overheat" 523012 "DCU Node 6, Error, Internal Power Unit Overheat" 523013 "DCU Node 6, Reset Error, Internal Power Unit Overheat" 523014 "DCU Node 6, Error, Motor Protection" 523015 "DCU Node 6, Reset Error, Motor Protection" 523016 "DCU Node 6, Error, Drive Overheat" 523017 "DCU Node 6, Reset Error, Drive Overheat" 523018 "DCU Node 6, Error, Overspeed" 523019 "DCU Node 6, status not available" 523020 "DCU Node 6, Error, Drive Data" 523021 "DCU Node 6, Error, Motor Data Not Stored" 523022 "DCU Node 6, Error, Indentification" 523023 "DCU Node 6, Error, Speed Difference" 523024 "DCU Node 6, Error, Fieldbus Memory" 523025 "DCU Node 6, status not available" 523026 "DCU Node 6, status not available" 523027 "DCU Node 6, status not available" 523028 "DCU Node 6, status not available" 523029 "DCU Node 6, status not available" 523030 "DCU Node 6, status not available" 523031 "DCU Node 6, status not available" 523032 "DCU Node 6, status not available" 523033 "DCU Node 6, status not available" 523034 "DCU Node 6, status not available" 523035 "DCU Node 6, status not available" 523036 "DCU Node 6, status not available" 523037 "DCU Node 6, status not available" 523038 "DCU Node 6, Error, Memory Size" 523039 "DCU Node 6, Error, Power Unit Software Version" 523040 "DCU Node 6, Error, FPGA Config" 523041 "DCU Node 6, status not available" 523042 "DCU Node 6, status not available" 523043 "DCU Node 6, Error, Encoder Interface Communication" 523044 "DCU Node 6, Error, Invlid Data, Power Unit" 523045 "DCU Node 6, status not available" 523046 "DCU Node 6, status not available" 523047 "DCU Node 6, status not available" 523048 "DCU Node 6, status not available" 523049 "DCU Node 6, status not available" 523050 "DCU Node 6, status not available" 523051 "DCU Node 6, status not available" 523052 "DCU Node 6, Error, Phase Undervoltage" 523053 "DCU Node 6, Error, Rotor Detection Current" 523054 "DCU Node 6, status not available" 523055 "DCU Node 6, status not available" 523056 "DCU Node 6, Error, SW Switch Left" 523057 "DCU Node 6, Error, SW Switch Right" 523058 "DCU Node 6, Error, Fieldbus Watchdog Response" 523059 "DCU Node 6, Error, Prog. Input" 523060 "DCU Node 6, status not available" 523061 "DCU Node 6, status not available" 523062 "DCU Node 6, Error, Power Unit Changed" 523063 "DCU Node 6, Error, Encoder Interface Changed" 523064 "DCU Node 6, Error, Power Unit Type Changed" 523065 "DCU Node 6, Error, Invalid Ver., Encoder Interface" 523066 "DCU Node 6, Error, Overcurrent" 523067 "DCU Node 6, Error, Max Accel/Decel Setting Exceeded" 523068 "DCU Node 6, Error, Overcurrent Brake" 523069 "DCU Node 6, Error, Power Unit" 523070 "DCU Node 6, status not available" 523071 "DCU Node 6, status not available" 523072 "DCU Node 6, status not available" 523073 "DCU Node 6, status not available" 523074 "DCU Node 6, status not available" 523075 "DCU Node 6, status not available" 523076 "DCU Node 6, status not available" 523077 "DCU Node 6, status not available" 523078 "DCU Node 6, status not available" 523079 "DCU Node 6, status not available" 523080 "DCU Node 6, status not available" 523081 "DCU Node 6, Error, Rotor Detection, Five Step" 523082 "DCU Node 6, Error, Rotor Detection, Ld equal Lq" 523083 "DCU Node 6, Error, Limit Switch Forward" 523084 "DCU Node 6, Error, Limit Switch Reverse" 523085 "DCU Node 6, Error, Limit Switch Override Forward" 523086 "DCU Node 6, Error, Limit Switch Override Reverse" 523087 "DCU Node 6, Error Limit Switch" 523088 "DCU Node 6, Error, Power Off End" 523089 "DCU Node 6, Error, Encoder Type Change" 523090 "DCU Node 6, Error, Control Board Communication" 523091 "DCU Node 6, INIT, Encoder Interface" 523092 "DCU Node 6, status not available" 523093 "DCU Node 6, status not available" 523094 "DCU Node 6, status not available" 523095 "DCU Node 6, status not available" 523096 "DCU Node 6, Error, Encoder Missing" 523097 "DCU Node 6, Error, Overspeed (EMF)" 523098 "DCU Node 6, Error, Encoder A Changed" 523099 "DCU Node 6, Error, Encoder B Changed" 523100 "DCU Node 6, Error Overcurrent, Out 01" 523101 "DCU Node 6, Error Overcurrent, Out 02" 523102 "DCU Node 6, Error Overcurrent, Out 03" 523103 "DCU Node 6, Error Overcurrent, Out 04" 523104 "DCU Node 6, Error Overcurrent, Fan" 523105 "DCU Node 6, Error Overcurrent ,Encoder" 523106 "DCU Node 6, Error Overcurrent, 24V Supply" 523107 "DCU Node 6, Error, Overfrequency" 523108 "DCU Node 6, Error Reset, Internal Overheat Control Board" 523109 "DCU Node 6, Error, Internal Overheat, Control Board" 523110 "DCU Node 6, Error, Ramp OH" 523111 "DCU Node 6, Error, Ramp OHI" 523112 "DCU Node 6, Error 24V Supply Undervoltage" 523113 "DCU Node 6, Error STO signals" 523114 "DCU Node 6, Error Ext. 24V Supply Undervoltage" 523115 "DCU Node 6, Error GTR7 Always OFF" 523116 "DCU Node 6, Error GTR7 OC" 523117 "DCU Node 6, Error GTR7 Always ON" 523118 "DCU Node 6, OC at 5V Diagnostic" 523119 "DCU Node 6, Error, Extreme Overpotential" 523120 "DCU Node 6, Error, DC Capacitor Damaged" 523121 "DCU Node 6, status not available" 523122 "DCU Node 6, status not available" 523123 "DCU Node 6, status not available" 523124 "DCU Node 6, status not available" 523125 "DCU Node 6, status not available" 523126 "DCU Node 6, status not available" 523127 "DCU Node 6, status not available" 523128 "DCU Node 6, status not available" 523129 "DCU Node 6, status not available" 523130 "DCU Node 6, status not available" 523131 "DCU Node 6, status not available" 523132 "DCU Node 6, status not available" 523133 "DCU Node 6, status not available" 523134 "DCU Node 6, status not available" 523135 "DCU Node 6, status not available" 523300 "App Node 6, No error" 523301 "App Node 6, No axis" 523302 "App Node 6, Error reading mapping" 523303 "App Node 6, Error reading rated current" 523304 "App Node 6, Error rated current mismatch" 523305 "App Node 6, Error write pll offset" 523306 "App Node 6, Error auto mapping" 523307 "App Node 6, Error interlink communication" 523308 "App Node 6, Error overload parameter" 523309 "App Node 6, Incompatible default download" 523310 "App Node 6, Error downloading default download" 523311 "App Node 6, Default download not found" 523312 "App Node 6, Error CAN data timeout" 523313 "App Node 6, Error CAN data invalid" 523314 "App Node 6, Invalid license" 523315 "App Node 6, Error reinitializing app" 523319 "App Node 6, General application error" ;
VAL_ 2566834768 FlashAmberWarningLamp 3 "Unavailable / Do Not Flash" 2 "Class C DTC  " 1 "Fast Flash" 0 "Slow Flash" ;
VAL_ 2566834768 AmberWarningLamp 3 "Not available" 2 "Reserved" 1 "Lamp On" 0 "Lamp Off" ;
VAL_ 2566834768 FMI_DTC1 22 "Data Drifted Low" 21 "Data Drifted High" 20 "Received Network Data In Error" 0 "Above normal (most severe)" 1 "Below normal (most severe)" 2 "Data erratic" 3 "Voltage above normal" 4 "Voltage below normal" 5 "Current below normal" 6 "Current above normal" 7 "Mechanical system not responding" 8 "Abnormal frequency" 9 "Abnormal update rate" 10 "Abnormal rate of change" 11 "Root cause not known" 12 "Bad intelligent device" 13 "Out of calibration" 14 "Special intstructions" 15 "Above normal (least severe)" 16 "Above normal (moderately severe)" 17 "Below normal (least severe)" 18 "Below normal (moderately severe)" 19 "Received network data in error" 31 "Condition Exists" ;
VAL_ 2566834768 SPN_DTC1 0 "No Error" 517290 "MCU Node 0, No Error" 517291 "MCU Node 0, No configuration file found" 517292 "MCU Node 0, Invalid J1939 license" 517293 "MCU Node 0, Error downloading configuration file" 517294 "MCU Node 0, Overload protection active" 517295 "MCU Node 0, Invalid app selection" 517296 "MCU Node 0, Overload warning active" 518000 "DCU Node 1, No Error" 518001 "DCU Node 1, status not available" 518002 "DCU Node 1, status not available" 518003 "DCU Node 1, Error, Overcurrent Power Unit" 518004 "DCU Node 1, Error, Overcurrent Analog" 518005 "DCU Node 1, Error, Overvoltage DC Link" 518006 "DCU Node 1, Error, Undervoltage DC Link" 518007 "DCU Node 1, Error, Overload" 518008 "DCU Node 1, Reset Error, Overload" 518009 "DCU Node 1, Error, Overload 02" 518010 "DCU Node 1, Error, Power Module Overheat" 518011 "DCU Node 1, Reset Error, Power Module Overheat" 518012 "DCU Node 1, Error, Internal Power Unit Overheat" 518013 "DCU Node 1, Reset Error, Internal Power Unit Overheat" 518014 "DCU Node 1, Error, Motor Protection" 518015 "DCU Node 1, Reset Error, Motor Protection" 518016 "DCU Node 1, Error, Drive Overheat" 518017 "DCU Node 1, Reset Error, Drive Overheat" 518018 "DCU Node 1, Error, Overspeed" 518019 "DCU Node 1, status not available" 518020 "DCU Node 1, Error, Drive Data" 518021 "DCU Node 1, Error, Motor Data Not Stored" 518022 "DCU Node 1, Error, Indentification" 518023 "DCU Node 1, Error, Speed Difference" 518024 "DCU Node 1, Error, Fieldbus Memory" 518025 "DCU Node 1, status not available" 518026 "DCU Node 1, status not available" 518027 "DCU Node 1, status not available" 518028 "DCU Node 1, status not available" 518029 "DCU Node 1, status not available" 518030 "DCU Node 1, status not available" 518031 "DCU Node 1, status not available" 518032 "DCU Node 1, status not available" 518033 "DCU Node 1, status not available" 518034 "DCU Node 1, status not available" 518035 "DCU Node 1, status not available" 518036 "DCU Node 1, status not available" 518037 "DCU Node 1, status not available" 518038 "DCU Node 1, Error, Memory Size" 518039 "DCU Node 1, Error, Power Unit Software Version" 518040 "DCU Node 1, Error, FPGA Config" 518041 "DCU Node 1, status not available" 518042 "DCU Node 1, status not available" 518043 "DCU Node 1, Error, Encoder Interface Communication" 518044 "DCU Node 1, Error, Invlid Data, Power Unit" 518045 "DCU Node 1, status not available" 518046 "DCU Node 1, status not available" 518047 "DCU Node 1, status not available" 518048 "DCU Node 1, status not available" 518049 "DCU Node 1, status not available" 518050 "DCU Node 1, status not available" 518051 "DCU Node 1, status not available" 518052 "DCU Node 1, Error, Phase Undervoltage" 518053 "DCU Node 1, Error, Rotor Detection Current" 518054 "DCU Node 1, status not available" 518055 "DCU Node 1, status not available" 518056 "DCU Node 1, Error, SW Switch Left" 518057 "DCU Node 1, Error, SW Switch Right" 518058 "DCU Node 1, Error, Fieldbus Watchdog Response" 518059 "DCU Node 1, Error, Prog. Input" 518060 "DCU Node 1, status not available" 518061 "DCU Node 1, status not available" 518062 "DCU Node 1, Error, Power Unit Changed" 518063 "DCU Node 1, Error, Encoder Interface Changed" 518064 "DCU Node 1, Error, Power Unit Type Changed" 518065 "DCU Node 1, Error, Invalid Ver., Encoder Interface" 518066 "DCU Node 1, Error, Overcurrent" 518067 "DCU Node 1, Error, Max Accel/Decel Setting Exceeded" 518068 "DCU Node 1, Error, Overcurrent Brake" 518069 "DCU Node 1, Error, Power Unit" 518070 "DCU Node 1, status not available" 518071 "DCU Node 1, status not available" 518072 "DCU Node 1, status not available" 518073 "DCU Node 1, status not available" 518074 "DCU Node 1, status not available" 518075 "DCU Node 1, status not available" 518076 "DCU Node 1, status not available" 518077 "DCU Node 1, status not available" 518078 "DCU Node 1, status not available" 518079 "DCU Node 1, status not available" 518080 "DCU Node 1, status not available" 518081 "DCU Node 1, Error, Rotor Detection, Five Step" 518082 "DCU Node 1, Error, Rotor Detection, Ld equal Lq" 518083 "DCU Node 1, Error, Limit Switch Forward" 518084 "DCU Node 1, Error, Limit Switch Reverse" 518085 "DCU Node 1, Error, Limit Switch Override Forward" 518086 "DCU Node 1, Error, Limit Switch Override Reverse" 518087 "DCU Node 1, Error Limit Switch" 518088 "DCU Node 1, Error, Power Off End" 518089 "DCU Node 1, Error, Encoder Type Change" 518090 "DCU Node 1, Error, Control Board Communication" 518091 "DCU Node 1, INIT, Encoder Interface" 518092 "DCU Node 1, status not available" 518093 "DCU Node 1, status not available" 518094 "DCU Node 1, status not available" 518095 "DCU Node 1, status not available" 518096 "DCU Node 1, Error, Encoder Missing" 518097 "DCU Node 1, Error, Overspeed (EMF)" 518098 "DCU Node 1, Error, Encoder A Changed" 518099 "DCU Node 1, Error, Encoder B Changed" 518100 "DCU Node 1, Error Overcurrent, Out 01" 518101 "DCU Node 1, Error Overcurrent, Out 02" 518102 "DCU Node 1, Error Overcurrent, Out 03" 518103 "DCU Node 1, Error Overcurrent, Out 04" 518104 "DCU Node 1, Error Overcurrent, Fan" 518105 "DCU Node 1, Error Overcurrent ,Encoder" 518106 "DCU Node 1, Error Overcurrent, 24V Supply" 518107 "DCU Node 1, Error, Overfrequency" 518108 "DCU Node 1, Error Reset, Internal Overheat Control Board" 518109 "DCU Node 1, Error, Internal Overheat, Control Board" 518110 "DCU Node 1, Error, Ramp OH" 518111 "DCU Node 1, Error, Ramp OHI" 518112 "DCU Node 1, Error 24V Supply Undervoltage" 518113 "DCU Node 1, Error STO signals" 518114 "DCU Node 1, Error Ext. 24V Supply Undervoltage" 518115 "DCU Node 1, Error GTR7 Always OFF" 518116 "DCU Node 1, Error GTR7 OC" 518117 "DCU Node 1, Error GTR7 Always ON" 518118 "DCU Node 1, OC at 5V Diagnostic" 518119 "DCU Node 1, Error, Extreme Overpotential" 518120 "DCU Node 1, Error, DC Capacitor Damaged" 518121 "DCU Node 1, status not available" 518122 "DCU Node 1, status not available" 518123 "DCU Node 1, status not available" 518124 "DCU Node 1, status not available" 518125 "DCU Node 1, status not available" 518126 "DCU Node 1, status not available" 518127 "DCU Node 1, status not available" 518128 "DCU Node 1, status not available" 518129 "DCU Node 1, status not available" 518130 "DCU Node 1, status not available" 518131 "DCU Node 1, status not available" 518132 "DCU Node 1, status not available" 518133 "DCU Node 1, status not available" 518134 "DCU Node 1, status not available" 518135 "DCU Node 1, status not available" 518300 "App Node 1, No error" 518301 "App Node 1, No axis" 518302 "App Node 1, Error reading mapping" 518303 "App Node 1, Error reading rated current" 518304 "App Node 1, Error rated current mismatch" 518305 "App Node 1, Error write pll offset" 518306 "App Node 1, Error auto mapping" 518307 "App Node 1, Error interlink communication" 518308 "App Node 1, Error overload parameter" 518309 "App Node 1, Incompatible default download" 518310 "App Node 1, Error downloading default download" 518311 "App Node 1, Default download not found" 518312 "App Node 1, Error CAN data timeout" 518313 "App Node 1, Error CAN data invalid" 518314 "App Node 1, Invalid license" 518315 "App Node 1, Error reinitializing app" 518319 "App Node 1, General application error" 519000 "DCU Node 2, No Error" 519001 "DCU Node 2, status not available" 519002 "DCU Node 2, status not available" 519003 "DCU Node 2, Error, Overcurrent Power Unit" 519004 "DCU Node 2, Error, Overcurrent Analog" 519005 "DCU Node 2, Error, Overvoltage DC Link" 519006 "DCU Node 2, Error, Undervoltage DC Link" 519007 "DCU Node 2, Error, Overload" 519008 "DCU Node 2, Reset Error, Overload" 519009 "DCU Node 2, Error, Overload 02" 519010 "DCU Node 2, Error, Power Module Overheat" 519011 "DCU Node 2, Reset Error, Power Module Overheat" 519012 "DCU Node 2, Error, Internal Power Unit Overheat" 519013 "DCU Node 2, Reset Error, Internal Power Unit Overheat" 519014 "DCU Node 2, Error, Motor Protection" 519015 "DCU Node 2, Reset Error, Motor Protection" 519016 "DCU Node 2, Error, Drive Overheat" 519017 "DCU Node 2, Reset Error, Drive Overheat" 519018 "DCU Node 2, Error, Overspeed" 519019 "DCU Node 2, status not available" 519020 "DCU Node 2, Error, Drive Data" 519021 "DCU Node 2, Error, Motor Data Not Stored" 519022 "DCU Node 2, Error, Indentification" 519023 "DCU Node 2, Error, Speed Difference" 519024 "DCU Node 2, Error, Fieldbus Memory" 519025 "DCU Node 2, status not available" 519026 "DCU Node 2, status not available" 519027 "DCU Node 2, status not available" 519028 "DCU Node 2, status not available" 519029 "DCU Node 2, status not available" 519030 "DCU Node 2, status not available" 519031 "DCU Node 2, status not available" 519032 "DCU Node 2, status not available" 519033 "DCU Node 2, status not available" 519034 "DCU Node 2, status not available" 519035 "DCU Node 2, status not available" 519036 "DCU Node 2, status not available" 519037 "DCU Node 2, status not available" 519038 "DCU Node 2, Error, Memory Size" 519039 "DCU Node 2, Error, Power Unit Software Version" 519040 "DCU Node 2, Error, FPGA Config" 519041 "DCU Node 2, status not available" 519042 "DCU Node 2, status not available" 519043 "DCU Node 2, Error, Encoder Interface Communication" 519044 "DCU Node 2, Error, Invlid Data, Power Unit" 519045 "DCU Node 2, status not available" 519046 "DCU Node 2, status not available" 519047 "DCU Node 2, status not available" 519048 "DCU Node 2, status not available" 519049 "DCU Node 2, status not available" 519050 "DCU Node 2, status not available" 519051 "DCU Node 2, status not available" 519052 "DCU Node 2, Error, Phase Undervoltage" 519053 "DCU Node 2, Error, Rotor Detection Current" 519054 "DCU Node 2, status not available" 519055 "DCU Node 2, status not available" 519056 "DCU Node 2, Error, SW Switch Left" 519057 "DCU Node 2, Error, SW Switch Right" 519058 "DCU Node 2, Error, Fieldbus Watchdog Response" 519059 "DCU Node 2, Error, Prog. Input" 519060 "DCU Node 2, status not available" 519061 "DCU Node 2, status not available" 519062 "DCU Node 2, Error, Power Unit Changed" 519063 "DCU Node 2, Error, Encoder Interface Changed" 519064 "DCU Node 2, Error, Power Unit Type Changed" 519065 "DCU Node 2, Error, Invalid Ver., Encoder Interface" 519066 "DCU Node 2, Error, Overcurrent" 519067 "DCU Node 2, Error, Max Accel/Decel Setting Exceeded" 519068 "DCU Node 2, Error, Overcurrent Brake" 519069 "DCU Node 2, Error, Power Unit" 519070 "DCU Node 2, status not available" 519071 "DCU Node 2, status not available" 519072 "DCU Node 2, status not available" 519073 "DCU Node 2, status not available" 519074 "DCU Node 2, status not available" 519075 "DCU Node 2, status not available" 519076 "DCU Node 2, status not available" 519077 "DCU Node 2, status not available" 519078 "DCU Node 2, status not available" 519079 "DCU Node 2, status not available" 519080 "DCU Node 2, status not available" 519081 "DCU Node 2, Error, Rotor Detection, Five Step" 519082 "DCU Node 2, Error, Rotor Detection, Ld equal Lq" 519083 "DCU Node 2, Error, Limit Switch Forward" 519084 "DCU Node 2, Error, Limit Switch Reverse" 519085 "DCU Node 2, Error, Limit Switch Override Forward" 519086 "DCU Node 2, Error, Limit Switch Override Reverse" 519087 "DCU Node 2, Error Limit Switch" 519088 "DCU Node 2, Error, Power Off End" 519089 "DCU Node 2, Error, Encoder Type Change" 519090 "DCU Node 2, Error, Control Board Communication" 519091 "DCU Node 2, INIT, Encoder Interface" 519092 "DCU Node 2, status not available" 519093 "DCU Node 2, status not available" 519094 "DCU Node 2, status not available" 519095 "DCU Node 2, status not available" 519096 "DCU Node 2, Error, Encoder Missing" 519097 "DCU Node 2, Error, Overspeed (EMF)" 519098 "DCU Node 2, Error, Encoder A Changed" 519099 "DCU Node 2, Error, Encoder B Changed" 519100 "DCU Node 2, Error Overcurrent, Out 01" 519101 "DCU Node 2, Error Overcurrent, Out 02" 519102 "DCU Node 2, Error Overcurrent, Out 03" 519103 "DCU Node 2, Error Overcurrent, Out 04" 519104 "DCU Node 2, Error Overcurrent, Fan" 519105 "DCU Node 2, Error Overcurrent ,Encoder" 519106 "DCU Node 2, Error Overcurrent, 24V Supply" 519107 "DCU Node 2, Error, Overfrequency" 519108 "DCU Node 2, Error Reset, Internal Overheat Control Board" 519109 "DCU Node 2, Error, Internal Overheat, Control Board" 519110 "DCU Node 2, Error, Ramp OH" 519111 "DCU Node 2, Error, Ramp OHI" 519112 "DCU Node 2, Error 24V Supply Undervoltage" 519113 "DCU Node 2, Error STO signals" 519114 "DCU Node 2, Error Ext. 24V Supply Undervoltage" 519115 "DCU Node 2, Error GTR7 Always OFF" 519116 "DCU Node 2, Error GTR7 OC" 519117 "DCU Node 2, Error GTR7 Always ON" 519118 "DCU Node 2, OC at 5V Diagnostic" 519119 "DCU Node 2, Error, Extreme Overpotential" 519120 "DCU Node 2, Error, DC Capacitor Damaged" 519121 "DCU Node 2, status not available" 519122 "DCU Node 2, status not available" 519123 "DCU Node 2, status not available" 519124 "DCU Node 2, status not available" 519125 "DCU Node 2, status not available" 519126 "DCU Node 2, status not available" 519127 "DCU Node 2, status not available" 519128 "DCU Node 2, status not available" 519129 "DCU Node 2, status not available" 519130 "DCU Node 2, status not available" 519131 "DCU Node 2, status not available" 519132 "DCU Node 2, status not available" 519133 "DCU Node 2, status not available" 519134 "DCU Node 2, status not available" 519135 "DCU Node 2, status not available" 519300 "App Node 2, No error" 519301 "App Node 2, No axis" 519302 "App Node 2, Error reading mapping" 519303 "App Node 2, Error reading rated current" 519304 "App Node 2, Error rated current mismatch" 519305 "App Node 2, Error write pll offset" 519306 "App Node 2, Error auto mapping" 519307 "App Node 2, Error interlink communication" 519308 "App Node 2, Error overload parameter" 519309 "App Node 2, Incompatible default download" 519310 "App Node 2, Error downloading default download" 519311 "App Node 2, Default download not found" 519312 "App Node 2, Error CAN data timeout" 519313 "App Node 2, Error CAN data invalid" 519314 "App Node 2, Invalid license" 519315 "App Node 2, Error reinitializing app" 519319 "App Node 2, General application error" 520000 "DCU Node 3, No Error" 520001 "DCU Node 3, status not available" 520002 "DCU Node 3, status not available" 520003 "DCU Node 3, Error, Overcurrent Power Unit" 520004 "DCU Node 3, Error, Overcurrent Analog" 520005 "DCU Node 3, Error, Overvoltage DC Link" 520006 "DCU Node 3, Error, Undervoltage DC Link" 520007 "DCU Node 3, Error, Overload" 520008 "DCU Node 3, Reset Error, Overload" 520009 "DCU Node 3, Error, Overload 02" 520010 "DCU Node 3, Error, Power Module Overheat" 520011 "DCU Node 3, Reset Error, Power Module Overheat" 520012 "DCU Node 3, Error, Internal Power Unit Overheat" 520013 "DCU Node 3, Reset Error, Internal Power Unit Overheat" 520014 "DCU Node 3, Error, Motor Protection" 520015 "DCU Node 3, Reset Error, Motor Protection" 520016 "DCU Node 3, Error, Drive Overheat" 520017 "DCU Node 3, Reset Error, Drive Overheat" 520018 "DCU Node 3, Error, Overspeed" 520019 "DCU Node 3, status not available" 520020 "DCU Node 3, Error, Drive Data" 520021 "DCU Node 3, Error, Motor Data Not Stored" 520022 "DCU Node 3, Error, Indentification" 520023 "DCU Node 3, Error, Speed Difference" 520024 "DCU Node 3, Error, Fieldbus Memory" 520025 "DCU Node 3, status not available" 520026 "DCU Node 3, status not available" 520027 "DCU Node 3, status not available" 520028 "DCU Node 3, status not available" 520029 "DCU Node 3, status not available" 520030 "DCU Node 3, status not available" 520031 "DCU Node 3, status not available" 520032 "DCU Node 3, status not available" 520033 "DCU Node 3, status not available" 520034 "DCU Node 3, status not available" 520035 "DCU Node 3, status not available" 520036 "DCU Node 3, status not available" 520037 "DCU Node 3, status not available" 520038 "DCU Node 3, Error, Memory Size" 520039 "DCU Node 3, Error, Power Unit Software Version" 520040 "DCU Node 3, Error, FPGA Config" 520041 "DCU Node 3, status not available" 520042 "DCU Node 3, status not available" 520043 "DCU Node 3, Error, Encoder Interface Communication" 520044 "DCU Node 3, Error, Invlid Data, Power Unit" 520045 "DCU Node 3, status not available" 520046 "DCU Node 3, status not available" 520047 "DCU Node 3, status not available" 520048 "DCU Node 3, status not available" 520049 "DCU Node 3, status not available" 520050 "DCU Node 3, status not available" 520051 "DCU Node 3, status not available" 520052 "DCU Node 3, Error, Phase Undervoltage" 520053 "DCU Node 3, Error, Rotor Detection Current" 520054 "DCU Node 3, status not available" 520055 "DCU Node 3, status not available" 520056 "DCU Node 3, Error, SW Switch Left" 520057 "DCU Node 3, Error, SW Switch Right" 520058 "DCU Node 3, Error, Fieldbus Watchdog Response" 520059 "DCU Node 3, Error, Prog. Input" 520060 "DCU Node 3, status not available" 520061 "DCU Node 3, status not available" 520062 "DCU Node 3, Error, Power Unit Changed" 520063 "DCU Node 3, Error, Encoder Interface Changed" 520064 "DCU Node 3, Error, Power Unit Type Changed" 520065 "DCU Node 3, Error, Invalid Ver., Encoder Interface" 520066 "DCU Node 3, Error, Overcurrent" 520067 "DCU Node 3, Error, Max Accel/Decel Setting Exceeded" 520068 "DCU Node 3, Error, Overcurrent Brake" 520069 "DCU Node 3, Error, Power Unit" 520070 "DCU Node 3, status not available" 520071 "DCU Node 3, status not available" 520072 "DCU Node 3, status not available" 520073 "DCU Node 3, status not available" 520074 "DCU Node 3, status not available" 520075 "DCU Node 3, status not available" 520076 "DCU Node 3, status not available" 520077 "DCU Node 3, status not available" 520078 "DCU Node 3, status not available" 520079 "DCU Node 3, status not available" 520080 "DCU Node 3, status not available" 520081 "DCU Node 3, Error, Rotor Detection, Five Step" 520082 "DCU Node 3, Error, Rotor Detection, Ld equal Lq" 520083 "DCU Node 3, Error, Limit Switch Forward" 520084 "DCU Node 3, Error, Limit Switch Reverse" 520085 "DCU Node 3, Error, Limit Switch Override Forward" 520086 "DCU Node 3, Error, Limit Switch Override Reverse" 520087 "DCU Node 3, Error Limit Switch" 520088 "DCU Node 3, Error, Power Off End" 520089 "DCU Node 3, Error, Encoder Type Change" 520090 "DCU Node 3, Error, Control Board Communication" 520091 "DCU Node 3, INIT, Encoder Interface" 520092 "DCU Node 3, status not available" 520093 "DCU Node 3, status not available" 520094 "DCU Node 3, status not available" 520095 "DCU Node 3, status not available" 520096 "DCU Node 3, Error, Encoder Missing" 520097 "DCU Node 3, Error, Overspeed (EMF)" 520098 "DCU Node 3, Error, Encoder A Changed" 520099 "DCU Node 3, Error, Encoder B Changed" 520100 "DCU Node 3, Error Overcurrent, Out 01" 520101 "DCU Node 3, Error Overcurrent, Out 02" 520102 "DCU Node 3, Error Overcurrent, Out 03" 520103 "DCU Node 3, Error Overcurrent, Out 04" 520104 "DCU Node 3, Error Overcurrent, Fan" 520105 "DCU Node 3, Error Overcurrent ,Encoder" 520106 "DCU Node 3, Error Overcurrent, 24V Supply" 520107 "DCU Node 3, Error, Overfrequency" 520108 "DCU Node 3, Error Reset, Internal Overheat Control Board" 520109 "DCU Node 3, Error, Internal Overheat, Control Board" 520110 "DCU Node 3, Error, Ramp OH" 520111 "DCU Node 3, Error, Ramp OHI" 520112 "DCU Node 3, Error 24V Supply Undervoltage" 520113 "DCU Node 3, Error STO signals" 520114 "DCU Node 3, Error Ext. 24V Supply Undervoltage" 520115 "DCU Node 3, Error GTR7 Always OFF" 520116 "DCU Node 3, Error GTR7 OC" 520117 "DCU Node 3, Error GTR7 Always ON" 520118 "DCU Node 3, OC at 5V Diagnostic" 520119 "DCU Node 3, Error, Extreme Overpotential" 520120 "DCU Node 3, Error, DC Capacitor Damaged" 520121 "DCU Node 3, status not available" 520122 "DCU Node 3, status not available" 520123 "DCU Node 3, status not available" 520124 "DCU Node 3, status not available" 520125 "DCU Node 3, status not available" 520126 "DCU Node 3, status not available" 520127 "DCU Node 3, status not available" 520128 "DCU Node 3, status not available" 520129 "DCU Node 3, status not available" 520130 "DCU Node 3, status not available" 520131 "DCU Node 3, status not available" 520132 "DCU Node 3, status not available" 520133 "DCU Node 3, status not available" 520134 "DCU Node 3, status not available" 520135 "DCU Node 3, status not available" 520300 "App Node 3, No error" 520301 "App Node 3, No axis" 520302 "App Node 3, Error reading mapping" 520303 "App Node 3, Error reading rated current" 520304 "App Node 3, Error rated current mismatch" 520305 "App Node 3, Error write pll offset" 520306 "App Node 3, Error auto mapping" 520307 "App Node 3, Error interlink communication" 520308 "App Node 3, Error overload parameter" 520309 "App Node 3, Incompatible default download" 520310 "App Node 3, Error downloading default download" 520311 "App Node 3, Default download not found" 520312 "App Node 3, Error CAN data timeout" 520313 "App Node 3, Error CAN data invalid" 520314 "App Node 3, Invalid license" 520315 "App Node 3, Error reinitializing app" 520319 "App Node 3, General application error" 521000 "DCU Node 4, No Error" 521001 "DCU Node 4, status not available" 521002 "DCU Node 4, status not available" 521003 "DCU Node 4, Error, Overcurrent Power Unit" 521004 "DCU Node 4, Error, Overcurrent Analog" 521005 "DCU Node 4, Error, Overvoltage DC Link" 521006 "DCU Node 4, Error, Undervoltage DC Link" 521007 "DCU Node 4, Error, Overload" 521008 "DCU Node 4, Reset Error, Overload" 521009 "DCU Node 4, Error, Overload 02" 521010 "DCU Node 4, Error, Power Module Overheat" 521011 "DCU Node 4, Reset Error, Power Module Overheat" 521012 "DCU Node 4, Error, Internal Power Unit Overheat" 521013 "DCU Node 4, Reset Error, Internal Power Unit Overheat" 521014 "DCU Node 4, Error, Motor Protection" 521015 "DCU Node 4, Reset Error, Motor Protection" 521016 "DCU Node 4, Error, Drive Overheat" 521017 "DCU Node 4, Reset Error, Drive Overheat" 521018 "DCU Node 4, Error, Overspeed" 521019 "DCU Node 4, status not available" 521020 "DCU Node 4, Error, Drive Data" 521021 "DCU Node 4, Error, Motor Data Not Stored" 521022 "DCU Node 4, Error, Indentification" 521023 "DCU Node 4, Error, Speed Difference" 521024 "DCU Node 4, Error, Fieldbus Memory" 521025 "DCU Node 4, status not available" 521026 "DCU Node 4, status not available" 521027 "DCU Node 4, status not available" 521028 "DCU Node 4, status not available" 521029 "DCU Node 4, status not available" 521030 "DCU Node 4, status not available" 521031 "DCU Node 4, status not available" 521032 "DCU Node 4, status not available" 521033 "DCU Node 4, status not available" 521034 "DCU Node 4, status not available" 521035 "DCU Node 4, status not available" 521036 "DCU Node 4, status not available" 521037 "DCU Node 4, status not available" 521038 "DCU Node 4, Error, Memory Size" 521039 "DCU Node 4, Error, Power Unit Software Version" 521040 "DCU Node 4, Error, FPGA Config" 521041 "DCU Node 4, status not available" 521042 "DCU Node 4, status not available" 521043 "DCU Node 4, Error, Encoder Interface Communication" 521044 "DCU Node 4, Error, Invlid Data, Power Unit" 521045 "DCU Node 4, status not available" 521046 "DCU Node 4, status not available" 521047 "DCU Node 4, status not available" 521048 "DCU Node 4, status not available" 521049 "DCU Node 4, status not available" 521050 "DCU Node 4, status not available" 521051 "DCU Node 4, status not available" 521052 "DCU Node 4, Error, Phase Undervoltage" 521053 "DCU Node 4, Error, Rotor Detection Current" 521054 "DCU Node 4, status not available" 521055 "DCU Node 4, status not available" 521056 "DCU Node 4, Error, SW Switch Left" 521057 "DCU Node 4, Error, SW Switch Right" 521058 "DCU Node 4, Error, Fieldbus Watchdog Response" 521059 "DCU Node 4, Error, Prog. Input" 521060 "DCU Node 4, status not available" 521061 "DCU Node 4, status not available" 521062 "DCU Node 4, Error, Power Unit Changed" 521063 "DCU Node 4, Error, Encoder Interface Changed" 521064 "DCU Node 4, Error, Power Unit Type Changed" 521065 "DCU Node 4, Error, Invalid Ver., Encoder Interface" 521066 "DCU Node 4, Error, Overcurrent" 521067 "DCU Node 4, Error, Max Accel/Decel Setting Exceeded" 521068 "DCU Node 4, Error, Overcurrent Brake" 521069 "DCU Node 4, Error, Power Unit" 521070 "DCU Node 4, status not available" 521071 "DCU Node 4, status not available" 521072 "DCU Node 4, status not available" 521073 "DCU Node 4, status not available" 521074 "DCU Node 4, status not available" 521075 "DCU Node 4, status not available" 521076 "DCU Node 4, status not available" 521077 "DCU Node 4, status not available" 521078 "DCU Node 4, status not available" 521079 "DCU Node 4, status not available" 521080 "DCU Node 4, status not available" 521081 "DCU Node 4, Error, Rotor Detection, Five Step" 521082 "DCU Node 4, Error, Rotor Detection, Ld equal Lq" 521083 "DCU Node 4, Error, Limit Switch Forward" 521084 "DCU Node 4, Error, Limit Switch Reverse" 521085 "DCU Node 4, Error, Limit Switch Override Forward" 521086 "DCU Node 4, Error, Limit Switch Override Reverse" 521087 "DCU Node 4, Error Limit Switch" 521088 "DCU Node 4, Error, Power Off End" 521089 "DCU Node 4, Error, Encoder Type Change" 521090 "DCU Node 4, Error, Control Board Communication" 521091 "DCU Node 4, INIT, Encoder Interface" 521092 "DCU Node 4, status not available" 521093 "DCU Node 4, status not available" 521094 "DCU Node 4, status not available" 521095 "DCU Node 4, status not available" 521096 "DCU Node 4, Error, Encoder Missing" 521097 "DCU Node 4, Error, Overspeed (EMF)" 521098 "DCU Node 4, Error, Encoder A Changed" 521099 "DCU Node 4, Error, Encoder B Changed" 521100 "DCU Node 4, Error Overcurrent, Out 01" 521101 "DCU Node 4, Error Overcurrent, Out 02" 521102 "DCU Node 4, Error Overcurrent, Out 03" 521103 "DCU Node 4, Error Overcurrent, Out 04" 521104 "DCU Node 4, Error Overcurrent, Fan" 521105 "DCU Node 4, Error Overcurrent ,Encoder" 521106 "DCU Node 4, Error Overcurrent, 24V Supply" 521107 "DCU Node 4, Error, Overfrequency" 521108 "DCU Node 4, Error Reset, Internal Overheat Control Board" 521109 "DCU Node 4, Error, Internal Overheat, Control Board" 521110 "DCU Node 4, Error, Ramp OH" 521111 "DCU Node 4, Error, Ramp OHI" 521112 "DCU Node 4, Error 24V Supply Undervoltage" 521113 "DCU Node 4, Error STO signals" 521114 "DCU Node 4, Error Ext. 24V Supply Undervoltage" 521115 "DCU Node 4, Error GTR7 Always OFF" 521116 "DCU Node 4, Error GTR7 OC" 521117 "DCU Node 4, Error GTR7 Always ON" 521118 "DCU Node 4, OC at 5V Diagnostic" 521119 "DCU Node 4, Error, Extreme Overpotential" 521120 "DCU Node 4, Error, DC Capacitor Damaged" 521121 "DCU Node 4, status not available" 521122 "DCU Node 4, status not available" 521123 "DCU Node 4, status not available" 521124 "DCU Node 4, status not available" 521125 "DCU Node 4, status not available" 521126 "DCU Node 4, status not available" 521127 "DCU Node 4, status not available" 521128 "DCU Node 4, status not available" 521129 "DCU Node 4, status not available" 521130 "DCU Node 4, status not available" 521131 "DCU Node 4, status not available" 521132 "DCU Node 4, status not available" 521133 "DCU Node 4, status not available" 521134 "DCU Node 4, status not available" 521135 "DCU Node 4, status not available" 521300 "App Node 4, No error" 521301 "App Node 4, No axis" 521302 "App Node 4, Error reading mapping" 521303 "App Node 4, Error reading rated current" 521304 "App Node 4, Error rated current mismatch" 521305 "App Node 4, Error write pll offset" 521306 "App Node 4, Error auto mapping" 521307 "App Node 4, Error interlink communication" 521308 "App Node 4, Error overload parameter" 521309 "App Node 4, Incompatible default download" 521310 "App Node 4, Error downloading default download" 521311 "App Node 4, Default download not found" 521312 "App Node 4, Error CAN data timeout" 521313 "App Node 4, Error CAN data invalid" 521314 "App Node 4, Invalid license" 521315 "App Node 4, Error reinitializing app" 521319 "App Node 4, General application error" 522000 "DCU Node 5, No Error" 522001 "DCU Node 5, status not available" 522002 "DCU Node 5, status not available" 522003 "DCU Node 5, Error, Overcurrent Power Unit" 522004 "DCU Node 5, Error, Overcurrent Analog" 522005 "DCU Node 5, Error, Overvoltage DC Link" 522006 "DCU Node 5, Error, Undervoltage DC Link" 522007 "DCU Node 5, Error, Overload" 522008 "DCU Node 5, Reset Error, Overload" 522009 "DCU Node 5, Error, Overload 02" 522010 "DCU Node 5, Error, Power Module Overheat" 522011 "DCU Node 5, Reset Error, Power Module Overheat" 522012 "DCU Node 5, Error, Internal Power Unit Overheat" 522013 "DCU Node 5, Reset Error, Internal Power Unit Overheat" 522014 "DCU Node 5, Error, Motor Protection" 522015 "DCU Node 5, Reset Error, Motor Protection" 522016 "DCU Node 5, Error, Drive Overheat" 522017 "DCU Node 5, Reset Error, Drive Overheat" 522018 "DCU Node 5, Error, Overspeed" 522019 "DCU Node 5, status not available" 522020 "DCU Node 5, Error, Drive Data" 522021 "DCU Node 5, Error, Motor Data Not Stored" 522022 "DCU Node 5, Error, Indentification" 522023 "DCU Node 5, Error, Speed Difference" 522024 "DCU Node 5, Error, Fieldbus Memory" 522025 "DCU Node 5, status not available" 522026 "DCU Node 5, status not available" 522027 "DCU Node 5, status not available" 522028 "DCU Node 5, status not available" 522029 "DCU Node 5, status not available" 522030 "DCU Node 5, status not available" 522031 "DCU Node 5, status not available" 522032 "DCU Node 5, status not available" 522033 "DCU Node 5, status not available" 522034 "DCU Node 5, status not available" 522035 "DCU Node 5, status not available" 522036 "DCU Node 5, status not available" 522037 "DCU Node 5, status not available" 522038 "DCU Node 5, Error, Memory Size" 522039 "DCU Node 5, Error, Power Unit Software Version" 522040 "DCU Node 5, Error, FPGA Config" 522041 "DCU Node 5, status not available" 522042 "DCU Node 5, status not available" 522043 "DCU Node 5, Error, Encoder Interface Communication" 522044 "DCU Node 5, Error, Invlid Data, Power Unit" 522045 "DCU Node 5, status not available" 522046 "DCU Node 5, status not available" 522047 "DCU Node 5, status not available" 522048 "DCU Node 5, status not available" 522049 "DCU Node 5, status not available" 522050 "DCU Node 5, status not available" 522051 "DCU Node 5, status not available" 522052 "DCU Node 5, Error, Phase Undervoltage" 522053 "DCU Node 5, Error, Rotor Detection Current" 522054 "DCU Node 5, status not available" 522055 "DCU Node 5, status not available" 522056 "DCU Node 5, Error, SW Switch Left" 522057 "DCU Node 5, Error, SW Switch Right" 522058 "DCU Node 5, Error, Fieldbus Watchdog Response" 522059 "DCU Node 5, Error, Prog. Input" 522060 "DCU Node 5, status not available" 522061 "DCU Node 5, status not available" 522062 "DCU Node 5, Error, Power Unit Changed" 522063 "DCU Node 5, Error, Encoder Interface Changed" 522064 "DCU Node 5, Error, Power Unit Type Changed" 522065 "DCU Node 5, Error, Invalid Ver., Encoder Interface" 522066 "DCU Node 5, Error, Overcurrent" 522067 "DCU Node 5, Error, Max Accel/Decel Setting Exceeded" 522068 "DCU Node 5, Error, Overcurrent Brake" 522069 "DCU Node 5, Error, Power Unit" 522070 "DCU Node 5, status not available" 522071 "DCU Node 5, status not available" 522072 "DCU Node 5, status not available" 522073 "DCU Node 5, status not available" 522074 "DCU Node 5, status not available" 522075 "DCU Node 5, status not available" 522076 "DCU Node 5, status not available" 522077 "DCU Node 5, status not available" 522078 "DCU Node 5, status not available" 522079 "DCU Node 5, status not available" 522080 "DCU Node 5, status not available" 522081 "DCU Node 5, Error, Rotor Detection, Five Step" 522082 "DCU Node 5, Error, Rotor Detection, Ld equal Lq" 522083 "DCU Node 5, Error, Limit Switch Forward" 522084 "DCU Node 5, Error, Limit Switch Reverse" 522085 "DCU Node 5, Error, Limit Switch Override Forward" 522086 "DCU Node 5, Error, Limit Switch Override Reverse" 522087 "DCU Node 5, Error Limit Switch" 522088 "DCU Node 5, Error, Power Off End" 522089 "DCU Node 5, Error, Encoder Type Change" 522090 "DCU Node 5, Error, Control Board Communication" 522091 "DCU Node 5, INIT, Encoder Interface" 522092 "DCU Node 5, status not available" 522093 "DCU Node 5, status not available" 522094 "DCU Node 5, status not available" 522095 "DCU Node 5, status not available" 522096 "DCU Node 5, Error, Encoder Missing" 522097 "DCU Node 5, Error, Overspeed (EMF)" 522098 "DCU Node 5, Error, Encoder A Changed" 522099 "DCU Node 5, Error, Encoder B Changed" 522100 "DCU Node 5, Error Overcurrent, Out 01" 522101 "DCU Node 5, Error Overcurrent, Out 02" 522102 "DCU Node 5, Error Overcurrent, Out 03" 522103 "DCU Node 5, Error Overcurrent, Out 04" 522104 "DCU Node 5, Error Overcurrent, Fan" 522105 "DCU Node 5, Error Overcurrent ,Encoder" 522106 "DCU Node 5, Error Overcurrent, 24V Supply" 522107 "DCU Node 5, Error, Overfrequency" 522108 "DCU Node 5, Error Reset, Internal Overheat Control Board" 522109 "DCU Node 5, Error, Internal Overheat, Control Board" 522110 "DCU Node 5, Error, Ramp OH" 522111 "DCU Node 5, Error, Ramp OHI" 522112 "DCU Node 5, Error 24V Supply Undervoltage" 522113 "DCU Node 5, Error STO signals" 522114 "DCU Node 5, Error Ext. 24V Supply Undervoltage" 522115 "DCU Node 5, Error GTR7 Always OFF" 522116 "DCU Node 5, Error GTR7 OC" 522117 "DCU Node 5, Error GTR7 Always ON" 522118 "DCU Node 5, OC at 5V Diagnostic" 522119 "DCU Node 5, Error, Extreme Overpotential" 522120 "DCU Node 5, Error, DC Capacitor Damaged" 522121 "DCU Node 5, status not available" 522122 "DCU Node 5, status not available" 522123 "DCU Node 5, status not available" 522124 "DCU Node 5, status not available" 522125 "DCU Node 5, status not available" 522126 "DCU Node 5, status not available" 522127 "DCU Node 5, status not available" 522128 "DCU Node 5, status not available" 522129 "DCU Node 5, status not available" 522130 "DCU Node 5, status not available" 522131 "DCU Node 5, status not available" 522132 "DCU Node 5, status not available" 522133 "DCU Node 5, status not available" 522134 "DCU Node 5, status not available" 522135 "DCU Node 5, status not available" 522300 "App Node 5, No error" 522301 "App Node 5, No axis" 522302 "App Node 5, Error reading mapping" 522303 "App Node 5, Error reading rated current" 522304 "App Node 5, Error rated current mismatch" 522305 "App Node 5, Error write pll offset" 522306 "App Node 5, Error auto mapping" 522307 "App Node 5, Error interlink communication" 522308 "App Node 5, Error overload parameter" 522309 "App Node 5, Incompatible default download" 522310 "App Node 5, Error downloading default download" 522311 "App Node 5, Default download not found" 522312 "App Node 5, Error CAN data timeout" 522313 "App Node 5, Error CAN data invalid" 522314 "App Node 5, Invalid license" 522315 "App Node 5, Error reinitializing app" 522319 "App Node 5, General application error" 523000 "DCU Node 6, No Error" 523001 "DCU Node 6, status not available" 523002 "DCU Node 6, status not available" 523003 "DCU Node 6, Error, Overcurrent Power Unit" 523004 "DCU Node 6, Error, Overcurrent Analog" 523005 "DCU Node 6, Error, Overvoltage DC Link" 523006 "DCU Node 6, Error, Undervoltage DC Link" 523007 "DCU Node 6, Error, Overload" 523008 "DCU Node 6, Reset Error, Overload" 523009 "DCU Node 6, Error, Overload 02" 523010 "DCU Node 6, Error, Power Module Overheat" 523011 "DCU Node 6, Reset Error, Power Module Overheat" 523012 "DCU Node 6, Error, Internal Power Unit Overheat" 523013 "DCU Node 6, Reset Error, Internal Power Unit Overheat" 523014 "DCU Node 6, Error, Motor Protection" 523015 "DCU Node 6, Reset Error, Motor Protection" 523016 "DCU Node 6, Error, Drive Overheat" 523017 "DCU Node 6, Reset Error, Drive Overheat" 523018 "DCU Node 6, Error, Overspeed" 523019 "DCU Node 6, status not available" 523020 "DCU Node 6, Error, Drive Data" 523021 "DCU Node 6, Error, Motor Data Not Stored" 523022 "DCU Node 6, Error, Indentification" 523023 "DCU Node 6, Error, Speed Difference" 523024 "DCU Node 6, Error, Fieldbus Memory" 523025 "DCU Node 6, status not available" 523026 "DCU Node 6, status not available" 523027 "DCU Node 6, status not available" 523028 "DCU Node 6, status not available" 523029 "DCU Node 6, status not available" 523030 "DCU Node 6, status not available" 523031 "DCU Node 6, status not available" 523032 "DCU Node 6, status not available" 523033 "DCU Node 6, status not available" 523034 "DCU Node 6, status not available" 523035 "DCU Node 6, status not available" 523036 "DCU Node 6, status not available" 523037 "DCU Node 6, status not available" 523038 "DCU Node 6, Error, Memory Size" 523039 "DCU Node 6, Error, Power Unit Software Version" 523040 "DCU Node 6, Error, FPGA Config" 523041 "DCU Node 6, status not available" 523042 "DCU Node 6, status not available" 523043 "DCU Node 6, Error, Encoder Interface Communication" 523044 "DCU Node 6, Error, Invlid Data, Power Unit" 523045 "DCU Node 6, status not available" 523046 "DCU Node 6, status not available" 523047 "DCU Node 6, status not available" 523048 "DCU Node 6, status not available" 523049 "DCU Node 6, status not available" 523050 "DCU Node 6, status not available" 523051 "DCU Node 6, status not available" 523052 "DCU Node 6, Error, Phase Undervoltage" 523053 "DCU Node 6, Error, Rotor Detection Current" 523054 "DCU Node 6, status not available" 523055 "DCU Node 6, status not available" 523056 "DCU Node 6, Error, SW Switch Left" 523057 "DCU Node 6, Error, SW Switch Right" 523058 "DCU Node 6, Error, Fieldbus Watchdog Response" 523059 "DCU Node 6, Error, Prog. Input" 523060 "DCU Node 6, status not available" 523061 "DCU Node 6, status not available" 523062 "DCU Node 6, Error, Power Unit Changed" 523063 "DCU Node 6, Error, Encoder Interface Changed" 523064 "DCU Node 6, Error, Power Unit Type Changed" 523065 "DCU Node 6, Error, Invalid Ver., Encoder Interface" 523066 "DCU Node 6, Error, Overcurrent" 523067 "DCU Node 6, Error, Max Accel/Decel Setting Exceeded" 523068 "DCU Node 6, Error, Overcurrent Brake" 523069 "DCU Node 6, Error, Power Unit" 523070 "DCU Node 6, status not available" 523071 "DCU Node 6, status not available" 523072 "DCU Node 6, status not available" 523073 "DCU Node 6, status not available" 523074 "DCU Node 6, status not available" 523075 "DCU Node 6, status not available" 523076 "DCU Node 6, status not available" 523077 "DCU Node 6, status not available" 523078 "DCU Node 6, status not available" 523079 "DCU Node 6, status not available" 523080 "DCU Node 6, status not available" 523081 "DCU Node 6, Error, Rotor Detection, Five Step" 523082 "DCU Node 6, Error, Rotor Detection, Ld equal Lq" 523083 "DCU Node 6, Error, Limit Switch Forward" 523084 "DCU Node 6, Error, Limit Switch Reverse" 523085 "DCU Node 6, Error, Limit Switch Override Forward" 523086 "DCU Node 6, Error, Limit Switch Override Reverse" 523087 "DCU Node 6, Error Limit Switch" 523088 "DCU Node 6, Error, Power Off End" 523089 "DCU Node 6, Error, Encoder Type Change" 523090 "DCU Node 6, Error, Control Board Communication" 523091 "DCU Node 6, INIT, Encoder Interface" 523092 "DCU Node 6, status not available" 523093 "DCU Node 6, status not available" 523094 "DCU Node 6, status not available" 523095 "DCU Node 6, status not available" 523096 "DCU Node 6, Error, Encoder Missing" 523097 "DCU Node 6, Error, Overspeed (EMF)" 523098 "DCU Node 6, Error, Encoder A Changed" 523099 "DCU Node 6, Error, Encoder B Changed" 523100 "DCU Node 6, Error Overcurrent, Out 01" 523101 "DCU Node 6, Error Overcurrent, Out 02" 523102 "DCU Node 6, Error Overcurrent, Out 03" 523103 "DCU Node 6, Error Overcurrent, Out 04" 523104 "DCU Node 6, Error Overcurrent, Fan" 523105 "DCU Node 6, Error Overcurrent ,Encoder" 523106 "DCU Node 6, Error Overcurrent, 24V Supply" 523107 "DCU Node 6, Error, Overfrequency" 523108 "DCU Node 6, Error Reset, Internal Overheat Control Board" 523109 "DCU Node 6, Error, Internal Overheat, Control Board" 523110 "DCU Node 6, Error, Ramp OH" 523111 "DCU Node 6, Error, Ramp OHI" 523112 "DCU Node 6, Error 24V Supply Undervoltage" 523113 "DCU Node 6, Error STO signals" 523114 "DCU Node 6, Error Ext. 24V Supply Undervoltage" 523115 "DCU Node 6, Error GTR7 Always OFF" 523116 "DCU Node 6, Error GTR7 OC" 523117 "DCU Node 6, Error GTR7 Always ON" 523118 "DCU Node 6, OC at 5V Diagnostic" 523119 "DCU Node 6, Error, Extreme Overpotential" 523120 "DCU Node 6, Error, DC Capacitor Damaged" 523121 "DCU Node 6, status not available" 523122 "DCU Node 6, status not available" 523123 "DCU Node 6, status not available" 523124 "DCU Node 6, status not available" 523125 "DCU Node 6, status not available" 523126 "DCU Node 6, status not available" 523127 "DCU Node 6, status not available" 523128 "DCU Node 6, status not available" 523129 "DCU Node 6, status not available" 523130 "DCU Node 6, status not available" 523131 "DCU Node 6, status not available" 523132 "DCU Node 6, status not available" 523133 "DCU Node 6, status not available" 523134 "DCU Node 6, status not available" 523135 "DCU Node 6, status not available" 523300 "App Node 6, No error" 523301 "App Node 6, No axis" 523302 "App Node 6, Error reading mapping" 523303 "App Node 6, Error reading rated current" 523304 "App Node 6, Error rated current mismatch" 523305 "App Node 6, Error write pll offset" 523306 "App Node 6, Error auto mapping" 523307 "App Node 6, Error interlink communication" 523308 "App Node 6, Error overload parameter" 523309 "App Node 6, Incompatible default download" 523310 "App Node 6, Error downloading default download" 523311 "App Node 6, Default download not found" 523312 "App Node 6, Error CAN data timeout" 523313 "App Node 6, Error CAN data invalid" 523314 "App Node 6, Invalid license" 523315 "App Node 6, Error reinitializing app" 523319 "App Node 6, General application error" ;
VAL_ 2566834768 FlashRedStopLamp 3 "Unavailable / Do Not Flash" 2 "Class C DTC  " 1 "Fast Flash" 0 "Slow Flash" ;
VAL_ 2566834768 FlashProtectLamp 3 "Unavailable / Do Not Flash" 2 "Class C DTC  " 1 "Fast Flash" 0 "Slow Flash" ;
VAL_ 2566834768 FlashMalfuncIndicatorLamp 3 "Unavailable / Do Not Flash" 2 "Class C DTC  " 1 "Fast Flash" 0 "Slow Flash" ;
VAL_ 2566834768 RedStopLampState 3 "Not available" 2 "Reserved" 1 "Lamp On" 0 "Lamp Off" ;
VAL_ 2566834768 ProtectLampStatus 3 "Not available" 2 "Reserved" 1 "Lamp On" 0 "Lamp Off" ;
VAL_ 2565799504 IndustryGroup 6 "Reserved for SAE" 7 "Reserved for SAE" 5 "IndustrialProcessCtrlStationary" 4 "Marine" 3 "Construction" 2 "Agricultural and Forestry" 1 "On-Highway" 0 "Global" ;
VAL_ 2565799504 Function 127 "Reserved" 126 "Reserved" 125 "Reserved" 124 "Reserved" 123 "Reserved" 122 "Reserved" 121 "Reserved" 120 "Reserved" 119 "Reserved" 118 "Reserved" 117 "Reserved" 116 "Reserved" 115 "Reserved" 114 "Reserved" 113 "Reserved" 112 "Reserved" 111 "Reserved" 110 "Reserved" 109 "Reserved" 108 "Reserved" 107 "Reserved" 106 "Reserved" 105 "Reserved" 104 "Reserved" 103 "Reserved" 102 "Reserved" 101 "Reserved" 42 "Water Pump Control" 41 "Lighting - Operator Controls" 40 "Seat Control" 39 "Ignition Control Module" 38 "Tire Pressure Control" 37 "Cab Controller" 36 "Pneumatic - System Controller" 35 "Suspension - System Controller" 34 "Hydraulic Pump Controller" 33 "System Monitor" 32 "Headway Controller" 31 "Propulsion Battery Charger" 30 "Management Computer" 29 "Virtual Terminal (in cab)" 28 "Off Vehicle Gateway" 27 "Power TakeOff (Secondary or Front)" 26 "Body Controller" 25 "Network Interconnect ECU" 24 "Vehicle Security" 23 "Vehicle Navigation" 22 "Aerodynamic Control" 21 "Cab Climate Control" 20 "Trip Recorder" 19 "Instrument Cluster" 18 "Suspension - Drive Axle" 17 "Suspension - Steer Axle" 16 "Steering Controller" 15 "Fuel System" 14 "Cruise Control" 13 "Retarder - Driveline" 12 "Retarder - Engine" 11 "Brakes - Drive Axle" 10 "Brakes - Steer Axle" 9 "Brakes - System Controller" 8 "Axle - Drive" 7 "Axle - Steering" 6 "Power TakeOff - (Main or Rear)" 5 "Shift Control/Console" 4 "Battery Pack Monitor" 3 "Transmission" 2 "Electric Propulsion Control" 1 "Auxiliary Power Unit (APU)" 0 "Engine" 100 "Reserved" 99 "Reserved" 98 "Reserved" 97 "Reserved" 96 "Reserved" 95 "Reserved" 94 "Reserved" 93 "Reserved" 92 "Reserved" 91 "Reserved" 90 "Reserved" 89 "Reserved" 88 "Reserved" 87 "Reserved" 86 "Reserved" 85 "Reserved" 84 "Reserved" 83 "Reserved" 82 "Reserved" 81 "Reserved" 80 "Reserved" 79 "Reserved" 78 "Fire Suppression System" 77 "Fuel Properties Sensor" 76 "Temperature Sensor" 75 "Supplemental Fan" 74 "Lubrication System" 73 "Rollover Detection Control" 72 "Coolant Valve Controller" 71 "Transfer Case Control" 70 "Auxiliary Regeneration Device" 69 "Engine Emission Aftertreatement System" 68 "Aftertreatment system gas measurement" 67 "Electrical System Controller" 66 "I/O Controller" 65 "Gas Flow Measurement" 64 "Endurance Braking" 63 "Engine Valve Controller" 62 "On-Board Diagnostic Unit" 61 "File Server/Printer" 60 "Cab Display" 59 "Starter" 58 "Fan Drive Control" 57 "Steering Column Unit" 56 "Communications Unit, Radio" 55 "Communications Unit, Satellite" 54 "Communications Unit, Cellular" 53 "Alternator/Charging System" 52 "Chassis Controller" 51 "Forward-Looking Collision Warning System" 50 "Auxiliary Heater" 49 "Clutch/Converter Control" 48 "Ramp Control" 47 "Information System Controller" 46 "Oil Sensor Unit" 45 "Vehicle Dynamic Stability Control" 44 "Exhaust Emission Control" 43 "Transmission Display" ;
VAL_ 2565799504 ManufacturerCode 454 "NGK Spark Plug Co. Ltd" 453 "Cooper Bussmann" 452 "WIKA Alexander Wiegand SE & Co. KG" 451 "Parker Hannifin Corp" 450 "Dycor Technologies Ltd." 449 "Polaris Industries Inc" 448 "Stanadyne Corporation, Electronics Systems" 447 "Great Plains Mfg." 446 "CertTech, L.L.C." 445 "KAT MECHATRONIC, Electronic Product Division" 444 "ITT Power Solutions" 443 "SignalQuest, Inc." 442 "Horsch Maschinen GmbH" 441 "PTG Reifendruckregelsysteme GmbH" 440 "Cummins Power Generation" 439 "Hyundai Heavy Industries" 438 "Comar Systems Ltd" 437 "Digital Yacht Limited" 436 "Kinze Manufacturing" 435 "Zunhammer GmbH" 434 "Stored Energy Systems" 433 "Rowe Electronics" 432 "S&A Systems, Inc." 431 "Tohatsu Corporation" 430 "Auteq Telematica S.A." 520 "Trapeze" 519 "Peeters Landbouwmachines b.v." 518 "Transas USA Inc." 517 "Noland Engineering" 516 "AVAT Automation GmbH" 515 "GINAF Trucks Nederland B.V." 514 "DISTek Integration, Inc." 513 "FarmscanAg" 512 "Inpower LLC" 511 "Sulky" 510 "Marinesoft Co. Ltd" 509 "MOTORTECH GmbH" 508 "Transtech Innovations" 507 "Test Center ISOBUS" 506 "IHI STAR Machinery Corporation" 505 "Yetter Farm Equipment" 504 "Vesper Marine" 503 "Naviop S.R.L." 502 "Attwood Corporation" 501 "Agrotronix S.A." 500 "Oxbo International Corporation" 499 "LCJ Capteurs" 498 "Innovative Design Solutions, Inc" 497 "SENTRON Sistemas Embarcados" 496 "W. Gessmann GmbH" 495 "HOLMER Maschinenbau GmbH" 494 "Synerject" 493 "Watcheye" 492 "Inergy Automotive Systems" 491 "Penny and Giles Ltd" 490 "QuikQ" 489 "Appareo Systems" 488 "The Charles Machine Works, Inc." 487 "DSE Test Solutions A/S" 486 "Westport Innovations Inc." 485 "MATT automotive" 484 "Headsight Inc." 483 "Valeo" 482 "Tricon Electronics" 481 "Chetco Digital Instruments" 480 "EnerDel, Inc." 479 "Vapor Bus International" 478 "OceanSat BV" 477 "OilQuick AB" 476 "Hummingbird Marine Electronics" 475 "GME" 474 "Persen Technologies Inc." 473 "Boss Industries, Inc." 472 "Tenneco Inc." 471 "Sea Cross Marine AB" 470 "SI-TEX Marine Electronics" 469 "RA Consulting GmbH" 468 "Tyco Fire Protection Products" 467 "Lely Industries N.V." 466 "Veethree Electronics and Marine LLC" 465 "Ashcroft Inc" 464 "Leach International Corporation" 463 "PROBOTIQ" 462 "IHI Shibaura Machinery Corporation" 461 "HAWE Hydraulik SE" 460 "San Giorgio S.E.I.N." 459 "Alltek Marine Electronics Corp" 458 "Control Solutions, Inc." 457 "RUSELPROM-ElectricDrive Ltd" 456 "General Kinetics" 455 "ADZ NAGANO GmbH" 429 "Rota Engineering Ltd." 428 "Mfg_428" 427 "em-trak Marine Electronics Ltd" 426 "Egersund Marine Electronics AS" 425 "Methode Electronics Inc, MDI" 424 "Odyne LLC" 423 "BSM Wireless, Inc." 422 "True Heading AB" 421 "Vertex Standard Co, Ltd" 420 "Vermeer Corporation, ACS Group" 419 "Fusion Electronics Ltd" 418 "Intellistick Inc" 417 "KZValve" 416 "Kubota Corporation" 415 "Valid Manufacturing Ltd." 414 "Cattron Group International" 413 "Datapross Nijbroek bv" 412 "WebTech Wireless Inc." 411 "Hy-Drive Technologies Ltd." 410 "COBO S.p.A. Divisione 3B6" 409 "Transfluid S.r.L." 408 "Corvus Energy Ltd." 407 "Comtech Mobile Datacom" 406 "Vecima Networks Inc." 405 "Wema System AS" 404 "Com Nav Marine Ltd" 403 "Trackwell ADS, Inc." 402 "Simma Software, Inc." 401 "Torqeedo GmbH" 400 "Livorsi Marine" 399 "ISEKI & Co., Ltd." 398 "Hilite International" 397 "Sanyo-kiki Co Ltd." 396 "Beyond Measure" 395 "GENTEC S.R.L." 394 "Capi 2 Nederland BV" 393 "Harvest Tec, Inc" 392 "Tianyuan Technology Co Ltd." 391 "Electronic Design for Industry, Inc" 390 "Partech Inc." 389 "Benchmark Electronics, Minnesota Division" 388 "Innomatix, LLC" 387 "Orscheln Products, LLC" 386 "JLG Automation BVBA" 385 "Johnson Outdoor Marine Electronics" 384 "Camano Light" 383 "MCL Industries" 382 "National Agricultural and Food Research Organization" 380 "Suntech International Ltd." 379 "Yamabiko Corporation" 378 "Glendinning Marine Products" 377 "ifm electronic gmbh" 376 "Quake Global" 375 "Williams Controls Inc." 372 "Delphi" 381 "B&G" 374 "Northern Lights, Inc." 373 "Electronic Design Inc." 371 "Heinzmann GmbH & Co. KG" 370 "Rolls-Royce Marine AS" 369 "Power Torque Engineering Ltd" 368 "HANSENHOF_electronic" 367 "Fliegl Agrartechnik" 366 "Viewnyx Corp." 365 "Digi-Star, LLC" 364 "OEM Controls Inc." 363 "BEI Duncan" 362 "Alois Poettinger Maschinenfabrik GmbH" 361 "InMach" 360 "HJS Emission Technology GmbH & Co KG" 359 "Ludwig Bergmann GmbH" 358 "Victron Energy BV" 357 "Hardi International A/S" 356 "Fischer Panda Generators, Inc" 355 "Mastervolt International B.V." 354 "Junkkari OY" 353 "Hegemon Electronics, Inc." 352 "SAME DEUTZ-FAHR" 351 "Thrane & Thrane" 350 "Noris Marine Systems GmbH & Co KG" 349 "Suonentiet" 348 "Amazonen Werke H. Dreyer" 347 "Honeywell" 346 "Control Solutions" 345 "Korean Maritime University" 344 "Parvus Corporation" 343 "Baumer Group" 342 "THOMAS MAGNETE GmbH" 341 "Boning GmbH & Co" 340 "Continental AG" 339 "Competence Center ISOBUS e.V." 338 "GRAF-SYTECO" 337 "Carraro S.p.A." 336 "APE s.r.o." 335 "Evo Electric Ltd" 334 "Takata-Petri AG" 333 "Hadley Products Corporation" 332 "HWH Corporation" 331 "Horton, Inc." 330 "Kidde Aerospace and Defense" 329 "Deif A/S" 328 "Qwerty Electronik AB" 252 "Sensor-Technik Wiedemann GmbH" 251 "German Agricultural Society" 250 "Kuhn Group" 249 "Schaltbau GmbH" 233 "Yacht Monitoring Solutions Inc." 232 "TSD Integrated Controls" 1863 "Thomas G. Faria Co." 1862 "Sanshin" 1861 "Vector CANtech" 1860 "MMP" 1859 "Kvasar AB" 1858 "Litton" 1857 "Simrad" 1856 "Trimble" 1855 "Furuno USA" 1854 "Northstar Technologies" 1853 "Japan Radio Co." 1852 "Navionics" 1851 "Raymarine" 1850 "Teleflex" 222 "Generac Power Systems, Inc." 221 "SiE" 220 "Beede Electrical Instrument Company, Inc." 219 "Cat OEM Solutions" 218 "Gits Manufacturing Company" 217 "RM Michaelides Software & Elektronik GmbH" 216 "Paneltronics Inc." 215 "Aetna Engineering/Fireboy-Xintex" 214 "MC elettronica Srl" 213 "CNH Belgium N.V." 212 "Sure Power Industries, Inc." 211 "DNA Group" 210 "Iteris, Inc." 209 "Bell Equip. Co. SA (PTY) LTD" 208 "Drew Technologies, Inc." 207 "Otto Engineering" 206 "port GmbH" 205 "SmarTire Systems Inc" 204 "The Morey Corporation" 203 "MILtronik GmbH" 202 "Curtis Instruments, Inc." 201 "Disenos y Tecnologia S.A." 200 "MGM Brakes" 199 "Actia Corp." 198 "Mystic Valley Communications" 197 "Mechron Power Systems" 196 "LEMKEN GmbH & Co. KG" 195 "General Engine Products" 194 "TriMark Corporation" 193 "Nobletec" 192 "Floscan" 191 "XRS Corporation" 190 "Hella KGaA Hueck & Co." 189 "QUALCOMM" 188 "EMP Corp." 187 "Air-Weigh" 186 "Altronic, Inc." 185 "Beede Electrical Instrument Company" 184 "EIA Electronics" 183 "KDS Controls, Inc." 182 "Vehicle Systems Engineering B.V." 181 "Coretronics, Inc." 180 "Smart Power Systems" 179 "TeeJet Technologies Denmark" 178 "Siemens VDO Automotive AG" 177 "Diagnostic System Associates" 176 "Moritz Aerospace" 175 "Veris Technologies, Inc." 174 "AB Volvo Penta" 173 "Ryeso, Inc." 172 "Yanmar Marine USA" 171 "Wachendorff Elektronik GmbH & Co. KG" 170 "Computronics Corporation Ltd." 169 "Marlin Technologies Inc." 168 "Xantrex" 167 "JLG Industries Inc." 166 "Phoenix International" 165 "CPAC Systems AB" 164 "DaimlerChrysler Off-Highway" 163 "BRP Inc." 162 "Axiomatic Technologies" 161 "Offshore Systems (UK) Limited" 160 "Nido" 159 "NTech Industries Inc." 158 "Firestone Industrial Products Company" 157 "ISSPRO Inc." 156 "ITT Industries - Cannon" 155 "Vetronix Corporation" 154 "Westerbeke Corporation" 153 "Woodward, Industrial Controls Division" 152 "elobau GmbH & Co. KG" 151 "Raven Industries Inc. - Flow Controls Division" 150 "Fleetguard" 149 "Holset" 148 "Blue Water Data, Inc." 147 "Nautibus Electronic GmbH" 146 "Maxima Technologies" 145 "MurCal Controls" 144 "Mercury Marine" 143 "W. Gmeiner GmbH & Co." 142 "TRW Automotive (Commercial Steering Systems)" 141 "Thales Navigation Ltd." 140 "Lowrance Electronics, Inc." 139 "Caterpillar Trimble Control Technologies (CTCT), LLC" 138 "Georg Fritzmeier GmbH & Co. KG" 137 "Maretron" 136 "Komatsu Ltd." 135 "Airmar Technology Corporation" 134 "Iris Technology Ltd." 133 "Bucher Schoerling GmbH" 132 "Mulag-Fahrzeugwerk" 131 "ITT Industries" 130 "Nido - Universal Machines B.V." 129 "OMNEX Control Systems, Inc." 128 "Gerhard Duecker GmbH & Co. KG" 127 "Holland USA" 126 "Driver Tech" 125 "Nevada Automotive Test Center" 124 "Hydac Electronic" 123 "Basler Electric" 122 "FG Wilson (Engineering) Limited" 121 "HED (Hydro Electronic Devices, Inc.)" 120 "RDS Technology Ltd." 119 "IntegriNautics" 118 "Intron GmbH" 117 "HUSCO International" 116 "BEELINE Technologies" 115 "NACCO Materials Handling Group, Inc." 114 "EControls, Inc." 113 "Stress-Tek, Inc." 112 "MECALAC" 111 "Maschinenfabrik Bernard Krone GmbH" 110 "EPIQ Sensor-Nite" 109 "TeeJet Technologies Denmark" 108 "WTK-Elecktronik GmbH" 107 "Grimme Landmaschinen GmbH & Co. KG" 106 "BAE Systems Controls, Inc." 105 "Kiepe Elektrik GmbH & Co. KG" 104 "Claas Selbstfahrende Erntemaschinen GmbH" 103 "CLAAS Agrosystems GmbH & Co. KG" 102 "AGCO GmbH & Co." 101 "Sensoria" 100 "VDO Technik AG" 99 "International Transmissions Ltd (ITL)" 98 "Mueller-Elektronik GmbH & Co." 97 "Ag Leader Technology, Inc." 96 "Mech@tronic IT GmbH" 95 "Pacific Insight Electronics Corp." 94 "CNH Global N.V." 93 "Perkins Engines Company Ltd." 92 "Ag-Chem Equipment Co., Inc." 91 "BSG Bodensee Steuergeraete GmbH" 90 "Knorr-Bremse SfN GmbH" 89 "Kverneland Group, Electronics Division" 88 "Satloc Precision GPS" 87 "J.C. Bamford Excavators Ltd (JCB)" 86 "C.E. Niehoff & Company" 85 "Kohler Co." 84 "New Holland UK Limited" 83 "Bendix VORAD Technologies" 82 "Bobcat/Ingersoll-Rand" 81 "Fire Research Corp" 80 "Twin Disc, Inc." 79 "Daimler Benz AG - Engine Division (PBM)" 78 "Frank W. Murphy Manufacturing, Inc." 77 "Deere Power Systems Group" 76 "unused" 75 "Deere & Co. Agricultural Division" 74 "Eaton Axle-Brake Division" 73 "LeTourneau, Inc." 72 "Sisu Corporation" 71 "Vansco Electronics Ltd." 70 "Flex-Coil Limited" 69 "Trimble Navigation" 68 "Scania" 67 "Funk Manufacturing Company" 66 "John Deere Construction Equipment Division" 65 "MAN Nutzfahrzeuge AG" 64 "unused" 63 "ZF Industries Inc." 62 "Wabco" 61 "Volvo Truck Corp." 60 "Volvo Trucks North America Inc." 59 "VES Inc." 58 "SPX Corporation, OTC Division" 57 "Sauer-Danfoss Co." 56 "SAIC" 55 "Ryder System Inc." 54 "Meritor Wabco" 53 "Continental Automotive Systems US, Inc." 52 "Meritor Automotive, Inc." 51 "Robert Bosch GmbH" 50 "Robert Bosch Corp" 49 "RE America Inc." 48 "Pollak Alphabet" 47 "Phillips Semiconductor" 46 "Noregon Systems, Inc" 45 "PACCAR" 44 "Nippondenso Co. Ltd." 43 "International Truck and Engine Corp. Vehicle Electronics" 42 "International Truck and Engine Corp. Engine Electronics" 41 "Motorola Inc." 40 "Motorola AIEG Inc." 39 "Microfirm Inc." 38 "Micro Processor Systems Inc." 37 "Mack Trucks Inc." 36 "Lucas Ltd." 35 "Kenworth Truck Co." 34 "Kelsey Hayes Co." 33 "John Deere" 32 "Jacobs Vehicle Systems" 31 "J Pollak Corp." 30 "Isuzu Motors Ltd." 29 "Hino Motors Ltd." 28 "Grote Ind. Inc." 27 "GMC" 26 "General Motors Corp., Service Technology Group" 25 "Daimler Trucks North America LLC" 24 "Ford Motor Co., Vehicle Controls" 23 "Ford Motor Co., Heavy Truck" 22 "Ford Motor Co., Electronic Concepts $ Systems" 21 "Echilin Inc., Midland Brake Inc." 20 "Eaton Ltd" 19 "Eaton Corp. Trucking Info Services" 18 "Eaton Corp, Transmission Division" 17 "Eaton Corp. Res & Dev" 16 "Eaton Corp." 15 "Dickey-John Corp." 14 "Detroit Diesel Corporation" 13 "Delco Electronics" 12 "Deere & Company, Precision Farming" 11 "Dearborn Group Inc." 10 "Cummins Engine Co." 9 "Chrysler Corp." 8 "Caterpillar Inc." 7 "Case Corp." 6 "Berifors Electronics AB" 5 "AMP Inc." 4 "Ametek-Dixson" 3 "Ametek, US Gauge Division" 2 "Allison Transmission, GMC" 1 "Allied Signal Inc." 0 "Reserved" 231 "Topcon Positioning Systems, Inc." 230 "Saucon Technologies" 229 "Garmin International Inc." 228 "ZF Marine Electronics" 227 "Lykketronic A/S" 226 "Monaco Coach Corporation" 225 "SKF" 224 "EMMI Network, S.L." 223 "Vaueo Retarder Co., Ltd." 263 "IMMI" 262 "HydraForce, Inc" 261 "Red Dot Corporation" 260 "Reichhardt GmbH" 259 "Jetter AG" 258 "ARAG" 257 "Honda Motor Co., Ltd" 256 "Tyco Electronics AMP" 255 "MEAS France" 254 "GE Sensing" 253 "Mobile Control Systems" 298 "Holley Performance" 297 "Zonar Systems Inc" 296 "micro dynamics GmbH" 295 "BEP Marine" 294 "Grayhill Inc." 293 "Spyder Controls Corp." 292 "IKUSI - Angel Iglesias S.A." 291 "Groeneveld Transport Efficiency BV" 290 "Kuebler GmbH" 289 "Watlow" 288 "Mitsubishi FUSO Truck & Bus Corp." 287 "NTech Industries, Inc" 286 "Coelmo srl" 285 "Sea Recovery Corp" 284 "Mobile Tech Chile" 283 "CWF Hamilton & Co Ltd" 282 "Medallion Instrumentation Systems" 281 "Precision Governors LLC" 311 "Patrick Power Products" 310 "TECNORD srl" 309 "Krauss-Maffei Wegmann GmbH & Co. KG" 308 "Cyntrx" 307 "MBW Technologies" 306 "Sleipner Motor AB" 305 "NovAtel Inc" 304 "EmpirBus AB" 303 "CTS Corporation" 302 "Nissin Kogyo Co., LTD" 301 "Parker Hannifin (UK) Ltd FDE group" 300 "Systron Donner Automotive" 299 "Rauch Landmaschinen GmbH" 280 "Leica Geosystems Pty Ltd" 279 "Geometris LP" 278 "Takata Electronics" 277 "LHP Telematics" 276 "Aqua-Hot Heating Systems" 275 "Navico Egersund AS" 274 "LTW Technology Co., LTD" 273 "Active Research Limited" 272 "Gross Mechanical Laboratories, Inc" 327 "Sonceboz SA" 326 "Akron Brass Company" 325 "ASM Automation Sensorik Messtechnik GmbH" 324 "Snap-on Diagnostics" 323 "Mobileye Vision Technologies Ltd." 322 "MICHENKA s.r.o." 321 "Ultra Electronics, Electrics" 320 "Miedema Landbouwwerktuigenfabriek B.V." 319 "Cadec Global" 318 "SAT Plan" 317 "Navtronics Bvba" 316 "ITT Flow Control" 315 "Icom Incorporated" 314 "CSM GmbH" 313 "Ilmor Engineering, Inc" 312 "Lectronix, Inc." 271 "Cole Hersee" 270 "Tennant" 269 "Saft America Inc.,  Space & Defense Division" 268 "Accurate Technologies" 267 "Red Lion Controls, Inc" 266 "International Thermal Research Ltd" 265 "MTS Sensor Technologie GmbH" 264 "Autolync" 248 "Cooper Standard Automotive Active Systems Group" 247 "ePULSE" 246 "Class 1, Inc" 245 "Capstan Ag Systems, Inc." 244 "Techno-Matic" 243 "eRide, Inc." 242 "Kokusandenki Co. Ltd" 241 "Schneider Automation SAS " 240 "Vanair Mfg" 239 "May & Scofield Ltd" 238 "ZF Friedrichshafen AG" 237 "Agtron Enterprises Inc" 236 "Norac Systems International Inc" 235 "SailorMade Marine Telemetry - Tetra Technology Ltd." 234 "Mondial electronic GmbH" ;
VAL_ 2565799504 VehicleSystem 0 "Non-specific System" 127 "Not Available" ;
VAL_ 2565799504 VehicleSystem5 127 "Not Available" 0 "Ind. Process Control Stationary" ;
VAL_ 2565799504 VehicleSystem4 125 "Entertainment" 120 "Display" 85 "External Environment" 75 "Sensor Communication Interface" 35 "Electrical Generation" 100 "Deck, Cargo and Fishing Equipment" 90 "Internal Environment" 80 "Instrumentation/General Systems (deprecate)" 70 "Communications" 60 "Navigation" 50 "Propulsion" 40 "Steering and Control Surfaces" 30 "Electrical Distribution" 25 "Inter/Intranetwork Device" 20 "Safety Systems" 10 "System Tools" 127 "Not Available" 0 "Non-specific System" ;
VAL_ 2565799504 VehicleSystem3 8 "Grader" 7 "Four Wheel Drive Loader" 6 "Forklift" 5 "Excavator" 4 "Crawler" 3 "Backhoe" 2 "Articulated Dump Truck" 1 "Skid Steer Loader" 127 "Not Available" 0 "Non-specific System" ;
VAL_ 2565799504 VehicleSystem2 25 "Slurry Applicators" 24 "Utility Vehicles" 23 "Mulchers" 22 "Timber Processing Machines" 21 "Timber loaders" 20 "Forwarders" 19 "Timber Harvesters" 17 "Sensor Systems" 16 "Skidder" 15 "Earth Work" 14 "Special Crops" 13 "Powered Auxiliary Device" 12 "Farm Yard Operations" 11 "Transport/Trailer" 10 "Irrigation" 9 "Forage" 8 "Root Harvesters" 7 "Harvesters" 6 "Sprayers" 5 "Fertilizers" 4 "Planters/Seeders" 3 "Secondary Tillage" 2 "Tillage" 1 "Tractor" 127 "Not Available" 0 "Non-specific System" ;
VAL_ 2565799504 VehicleSystem1 2 "Trailer" 1 "Tractor" 127 "Not Available" 0 "Non-specific System" ;
VAL_ 2565668432 PGNumber 255 "NotAvailable" ;
