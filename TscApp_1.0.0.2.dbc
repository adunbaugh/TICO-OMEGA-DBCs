VERSION ""

NS_ :

BS_:

BU_: SampleEcu T6APD

BO_ 2566835024 DM02: 26 T6APD
 SG_ SPN_DTC1 : 16|19@1+ (1,0) [0|0] "" Vector__XXX
 SG_ RedStopLampState : 4|2@1+ (1,0) [0|3] "" Vector__XXX
 SG_ ProtectLampStatus : 0|2@1+ (1,0) [0|3] "" Vector__XXX
 SG_ FlashRedStopLamp : 12|2@1+ (1,0) [0|3] "" Vector__XXX
 SG_ FlashProtectLamp : 8|2@1+ (1,0) [0|3] "" Vector__XXX
 SG_ FlashMalfuncIndicatorLamp : 14|2@1+ (1,0) [0|3] "" Vector__XXX

BO_ 2566834768 DM01: 26 T6APD
 SG_ OC_DTC6 : 200|7@1+ (1,0) [0|0] "" Vector__XXX
 SG_ OC_DTC5 : 168|7@1+ (1,0) [0|0] "" Vector__XXX
 SG_ OC_DTC4 : 136|7@1+ (1,0) [0|0] "" Vector__XXX
 SG_ OC_DTC3 : 104|7@1+ (1,0) [0|0] "" Vector__XXX
 SG_ OC_DTC2 : 72|7@1+ (1,0) [0|0] "" Vector__XXX
 SG_ FMI_DTC6 : 195|5@1+ (1,0) [0|0] "" Vector__XXX
 SG_ FMI_DTC5 : 163|5@1+ (1,0) [0|0] "" Vector__XXX
 SG_ FMI_DTC4 : 131|5@1+ (1,0) [0|0] "" Vector__XXX
 SG_ FMI_DTC3 : 99|5@1+ (1,0) [0|0] "" Vector__XXX
 SG_ FMI_DTC2 : 67|5@1+ (1,0) [0|0] "" Vector__XXX
 SG_ SPN_DTC6 : 176|19@1+ (1,0) [0|0] "" Vector__XXX
 SG_ SPN_DTC5 : 144|19@1+ (1,0) [0|0] "" Vector__XXX
 SG_ SPN_DTC4 : 112|19@1+ (1,0) [0|0] "" Vector__XXX

CM_ SG_ 2566835024 RedStopLampState "This lamp is used to relay trouble code information that is of a severe enough condition that it warrants stopping the vehicle.

00     Lamp Off
01     Lamp On
10     Reserved
11     Not available";
CM_ SG_ 2566835024 ProtectLampStatus "This lamp is used to relay trouble code information that is reporting a problem with a vehicle system that is most probably not electronic subsystem related. For instance, engine coolant temperature is exceeding its prescribed temperature range.
00 ...";
CM_ SG_ 2566835024 FlashRedStopLamp "This parameter provides the capability to flash the RSL


00 - Slow Flash (1 Hz, 50 % duty cycle)
01 - Fast Flash (2 Hz or faster, 50% duty cycle)
10 - Reserved
11 - Unavailable / Do Not Flash";
CM_ SG_ 2566835024 FlashProtectLamp "This parameter provides the capability to flash the engine protect lamp


00 - Slow Flash (1 Hz, 50 % duty cycle)
01 - Fast Flash (2 Hz or faster, 50% duty cycle)
10 - Reserved
11 - Unavailable / Do Not Flash";
CM_ SG_ 2566835024 FlashMalfuncIndicatorLamp "This parameter provides the capability to flash the MIL
00 - Slow Flash (1 Hz, 50 % duty cycle)
01 - Fast Flash (2 Hz or faster, 50% duty cycle)
10 - Class C DTC
11 - Unavailable / Do Not Flash
Note:  State 10 is for WWH OBD discriminatory ...";
CM_ BO_ 2566834768 "Active Diagnostic Trouble Codes
Active Diagnostic Trouble Codes";
BA_DEF_ SG_  "SigType" ENUM  "Default","Range","RangeSigned","ASCII","Discrete","Control","ReferencePGN","DTC","StringDelimiter","StringLength","StringLengthControl","MessageCounter","MessageChecksum";
BA_DEF_ SG_  "GenSigStartValue" INT 0 2147483647;
BA_DEF_ SG_  "GenSigSendType" ENUM  "Cyclic","OnWrite","OnWriteWithRepetition","OnChange","OnChangeWithRepetition","IfActive","IfActiveWithRepetition","NoSigSendType";
BA_DEF_ SG_  "GenSigILSupport" ENUM  "No","Yes";
BA_DEF_ SG_  "GenSigEVName" STRING ;
BA_DEF_ SG_  "SPN" INT 0 524287;
BA_DEF_ BO_  "TpJ1939VarDlc" ENUM  "No","Yes";
BA_DEF_ BO_  "GenMsgILSupport" ENUM  "No","Yes";
BA_DEF_ BO_  "GenMsgRequestable" INT 0 1;
BA_DEF_ BO_  "GenMsgSendType" ENUM  "cyclic","NotUsed","NotUsed","NotUsed","NotUsed","NotUsed","NotUsed","IfActive","noMsgSendType";
BA_DEF_ BO_  "VFrameFormat" ENUM  "StandardCAN","ExtendedCAN","reserved","J1939PG";
BA_DEF_ BO_  "GenMsgCycleTime" INT 0 3600000;
BA_DEF_DEF_  "SigType" "Default";
BA_DEF_DEF_  "GenSigStartValue" 0;
BA_DEF_DEF_  "GenSigSendType" "NoSigSendType";
BA_DEF_DEF_  "GenSigILSupport" "Yes";
BA_DEF_DEF_  "GenSigEVName" "Env@Nodename_@Signame";
BA_DEF_DEF_  "SPN" 0;
BA_DEF_DEF_  "TpJ1939VarDlc" "No";
BA_DEF_DEF_  "GenMsgILSupport" "Yes";
BA_DEF_DEF_  "GenMsgRequestable" 1;
BA_DEF_DEF_  "GenMsgSendType" "noMsgSendType";
BA_DEF_DEF_  "VFrameFormat" "J1939PG";
BA_DEF_DEF_  "GenMsgCycleTime" 0;
BA_ "TpJ1939VarDlc" BO_ 2566834768 1;
BA_ "SPN" SG_ 2566835024 RedStopLampState 623;
BA_ "SigType" SG_ 2566835024 RedStopLampState 4;
BA_ "SPN" SG_ 2566835024 ProtectLampStatus 987;
BA_ "SigType" SG_ 2566835024 ProtectLampStatus 5;
BA_ "SPN" SG_ 2566835024 FlashRedStopLamp 3039;
BA_ "SigType" SG_ 2566835024 FlashRedStopLamp 5;
BA_ "SPN" SG_ 2566835024 FlashProtectLamp 3041;
BA_ "SigType" SG_ 2566835024 FlashProtectLamp 5;
BA_ "SPN" SG_ 2566835024 FlashMalfuncIndicatorLamp 3038;
BA_ "SigType" SG_ 2566835024 FlashMalfuncIndicatorLamp 5;
VAL_ 2566835024 SPN_DTC1 0 "No Error" 517290 "MCU Node 0, No Error" 517291 "MCU Node 0, No configuration file found" 517292 "MCU Node 0, Invalid J1939 license" 517293 "MCU Node 0, Error downloading configuration file" 517294 "MCU Node 0, Overload protection active" 517295 "MCU Node 0, Invalid app selection" 517296 "MCU Node 0, Overload warning active" 518000 "DCU Node 1, No Error" 518001 "DCU Node 1, status not available" 518002 "DCU Node 1, status not available" 518003 "DCU Node 1, Error, Overcurrent Power Unit" 518004 "DCU Node 1, Error, Overcurrent Analog" 518005 "DCU Node 1, Error, Overvoltage DC Link" 518006 "DCU Node 1, Error, Undervoltage DC Link" 518007 "DCU Node 1, Error, Overload" 518008 "DCU Node 1, Reset Error, Overload" 518009 "DCU Node 1, Error, Overload 02" 518010 "DCU Node 1, Error, Power Module Overheat" 518011 "DCU Node 1, Reset Error, Power Module Overheat" 518012 "DCU Node 1, Error, Internal Power Unit Overheat" 518013 "DCU Node 1, Reset Error, Internal Power Unit Overheat" 518014 "DCU Node 1, Error, Motor Protection" 518015 "DCU Node 1, Reset Error, Motor Protection" 518016 "DCU Node 1, Error, Drive Overheat" 518017 "DCU Node 1, Reset Error, Drive Overheat" 518018 "DCU Node 1, Error, Overspeed" 518019 "DCU Node 1, status not available" 518020 "DCU Node 1, Error, Drive Data" 518021 "DCU Node 1, Error, Motor Data Not Stored" 518022 "DCU Node 1, Error, Indentification" 518023 "DCU Node 1, Error, Speed Difference" 518024 "DCU Node 1, Error, Fieldbus Memory" 518025 "DCU Node 1, status not available" 518026 "DCU Node 1, status not available" 518027 "DCU Node 1, status not available" 518028 "DCU Node 1, status not available" 518029 "DCU Node 1, status not available" 518030 "DCU Node 1, status not available" 518031 "DCU Node 1, status not available" 518032 "DCU Node 1, status not available" 518033 "DCU Node 1, status not available" 518034 "DCU Node 1, status not available" 518035 "DCU Node 1, status not available" 518036 "DCU Node 1, status not available" 518037 "DCU Node 1, status not available" 518038 "DCU Node 1, Error, Memory Size" 518039 "DCU Node 1, Error, Power Unit Software Version" 518040 "DCU Node 1, Error, FPGA Config" 518041 "DCU Node 1, status not available" 518042 "DCU Node 1, status not available" 518043 "DCU Node 1, Error, Encoder Interface Communication" 518044 "DCU Node 1, Error, Invlid Data, Power Unit" 518045 "DCU Node 1, status not available" 518046 "DCU Node 1, status not available" 518047 "DCU Node 1, status not available" 518048 "DCU Node 1, status not available" 518049 "DCU Node 1, status not available" 518050 "DCU Node 1, status not available" 518051 "DCU Node 1, status not available" 518052 "DCU Node 1, Error, Phase Undervoltage" 518053 "DCU Node 1, Error, Rotor Detection Current" 518054 "DCU Node 1, status not available" 518055 "DCU Node 1, status not available" 518056 "DCU Node 1, Error, SW Switch Left" 518057 "DCU Node 1, Error, SW Switch Right" 518058 "DCU Node 1, Error, Fieldbus Watchdog Response" 518059 "DCU Node 1, Error, Prog. Input" 518060 "DCU Node 1, status not available" 518061 "DCU Node 1, status not available" 518062 "DCU Node 1, Error, Power Unit Changed" 518063 "DCU Node 1, Error, Encoder Interface Changed" 518064 "DCU Node 1, Error, Power Unit Type Changed" 518065 "DCU Node 1, Error, Invalid Ver., Encoder Interface" 518066 "DCU Node 1, Error, Overcurrent" 518067 "DCU Node 1, Error, Max Accel/Decel Setting Exceeded" 518068 "DCU Node 1, Error, Overcurrent Brake" 518069 "DCU Node 1, Error, Power Unit" 518070 "DCU Node 1, status not available" 518071 "DCU Node 1, status not available" 518072 "DCU Node 1, status not available" 518073 "DCU Node 1, status not available" 518074 "DCU Node 1, status not available" 518075 "DCU Node 1, status not available" 518076 "DCU Node 1, status not available" 518077 "DCU Node 1, status not available" 518078 "DCU Node 1, status not available" 518079 "DCU Node 1, status not available" 518080 "DCU Node 1, status not available" 518081 "DCU Node 1, Error, Rotor Detection, Five Step" 518082 "DCU Node 1, Error, Rotor Detection, Ld equal Lq" 518083 "DCU Node 1, Error, Limit Switch Forward" 518084 "DCU Node 1, Error, Limit Switch Reverse" 518085 "DCU Node 1, Error, Limit Switch Override Forward" 518086 "DCU Node 1, Error, Limit Switch Override Reverse" 518087 "DCU Node 1, Error Limit Switch" 518088 "DCU Node 1, Error, Power Off End" 518089 "DCU Node 1, Error, Encoder Type Change" 518090 "DCU Node 1, Error, Control Board Communication" 518091 "DCU Node 1, INIT, Encoder Interface" 518092 "DCU Node 1, status not available" 518093 "DCU Node 1, status not available" 518094 "DCU Node 1, status not available" 518095 "DCU Node 1, status not available" 518096 "DCU Node 1, Error, Encoder Missing" 518097 "DCU Node 1, Error, Overspeed (EMF)" 518098 "DCU Node 1, Error, Encoder A Changed" 518099 "DCU Node 1, Error, Encoder B Changed" 518100 "DCU Node 1, Error Overcurrent, Out 01" 518101 "DCU Node 1, Error Overcurrent, Out 02" 518102 "DCU Node 1, Error Overcurrent, Out 03" 518103 "DCU Node 1, Error Overcurrent, Out 04" 518104 "DCU Node 1, Error Overcurrent, Fan" 518105 "DCU Node 1, Error Overcurrent ,Encoder" 518106 "DCU Node 1, Error Overcurrent, 24V Supply" 518107 "DCU Node 1, Error, Overfrequency" 518108 "DCU Node 1, Error Reset, Internal Overheat Control Board" 518109 "DCU Node 1, Error, Internal Overheat, Control Board" 518110 "DCU Node 1, Error, Ramp OH" 518111 "DCU Node 1, Error, Ramp OHI" 518112 "DCU Node 1, Error 24V Supply Undervoltage" 518113 "DCU Node 1, Error STO signals" 518114 "DCU Node 1, Error Ext. 24V Supply Undervoltage" 518115 "DCU Node 1, Error GTR7 Always OFF" 518116 "DCU Node 1, Error GTR7 OC" 518117 "DCU Node 1, Error GTR7 Always ON" 518118 "DCU Node 1, OC at 5V Diagnostic" 518119 "DCU Node 1, Error, Extreme Overpotential" 518120 "DCU Node 1, Error, DC Capacitor Damaged" 518121 "DCU Node 1, status not available" 518122 "DCU Node 1, status not available" 518123 "DCU Node 1, status not available" 518124 "DCU Node 1, status not available" 518125 "DCU Node 1, status not available" 518126 "DCU Node 1, status not available" 518127 "DCU Node 1, status not available" 518128 "DCU Node 1, status not available" 518129 "DCU Node 1, status not available" 518130 "DCU Node 1, status not available" 518131 "DCU Node 1, status not available" 518132 "DCU Node 1, status not available" 518133 "DCU Node 1, status not available" 518134 "DCU Node 1, status not available" 518135 "DCU Node 1, status not available" 518300 "App Node 1, No error" 518301 "App Node 1, No axis" 518302 "App Node 1, Error reading mapping" 518303 "App Node 1, Error reading rated current" 518304 "App Node 1, Error rated current mismatch" 518305 "App Node 1, Error write pll offset" 518306 "App Node 1, Error auto mapping" 518307 "App Node 1, Error interlink communication" 518308 "App Node 1, Error overload parameter" 518309 "App Node 1, Incompatible default download" 518310 "App Node 1, Error downloading default download" 518311 "App Node 1, Default download not found" 518312 "App Node 1, Error CAN data timeout" 518313 "App Node 1, Error CAN data invalid" 518314 "App Node 1, Invalid license" 518315 "App Node 1, Error reinitializing app" 518319 "App Node 1, General application error" 519000 "DCU Node 2, No Error" 519001 "DCU Node 2, status not available" 519002 "DCU Node 2, status not available" 519003 "DCU Node 2, Error, Overcurrent Power Unit" 519004 "DCU Node 2, Error, Overcurrent Analog" 519005 "DCU Node 2, Error, Overvoltage DC Link" 519006 "DCU Node 2, Error, Undervoltage DC Link" 519007 "DCU Node 2, Error, Overload" 519008 "DCU Node 2, Reset Error, Overload" 519009 "DCU Node 2, Error, Overload 02" 519010 "DCU Node 2, Error, Power Module Overheat" 519011 "DCU Node 2, Reset Error, Power Module Overheat" 519012 "DCU Node 2, Error, Internal Power Unit Overheat" 519013 "DCU Node 2, Reset Error, Internal Power Unit Overheat" 519014 "DCU Node 2, Error, Motor Protection" 519015 "DCU Node 2, Reset Error, Motor Protection" 519016 "DCU Node 2, Error, Drive Overheat" 519017 "DCU Node 2, Reset Error, Drive Overheat" 519018 "DCU Node 2, Error, Overspeed" 519019 "DCU Node 2, status not available" 519020 "DCU Node 2, Error, Drive Data" 519021 "DCU Node 2, Error, Motor Data Not Stored" 519022 "DCU Node 2, Error, Indentification" 519023 "DCU Node 2, Error, Speed Difference" 519024 "DCU Node 2, Error, Fieldbus Memory" 519025 "DCU Node 2, status not available" 519026 "DCU Node 2, status not available" 519027 "DCU Node 2, status not available" 519028 "DCU Node 2, status not available" 519029 "DCU Node 2, status not available" 519030 "DCU Node 2, status not available" 519031 "DCU Node 2, status not available" 519032 "DCU Node 2, status not available" 519033 "DCU Node 2, status not available" 519034 "DCU Node 2, status not available" 519035 "DCU Node 2, status not available" 519036 "DCU Node 2, status not available" 519037 "DCU Node 2, status not available" 519038 "DCU Node 2, Error, Memory Size" 519039 "DCU Node 2, Error, Power Unit Software Version" 519040 "DCU Node 2, Error, FPGA Config" 519041 "DCU Node 2, status not available" 519042 "DCU Node 2, status not available" 519043 "DCU Node 2, Error, Encoder Interface Communication" 519044 "DCU Node 2, Error, Invlid Data, Power Unit" 519045 "DCU Node 2, status not available" 519046 "DCU Node 2, status not available" 519047 "DCU Node 2, status not available" 519048 "DCU Node 2, status not available" 519049 "DCU Node 2, status not available" 519050 "DCU Node 2, status not available" 519051 "DCU Node 2, status not available" 519052 "DCU Node 2, Error, Phase Undervoltage" 519053 "DCU Node 2, Error, Rotor Detection Current" 519054 "DCU Node 2, status not available" 519055 "DCU Node 2, status not available" 519056 "DCU Node 2, Error, SW Switch Left" 519057 "DCU Node 2, Error, SW Switch Right" 519058 "DCU Node 2, Error, Fieldbus Watchdog Response" 519059 "DCU Node 2, Error, Prog. Input" 519060 "DCU Node 2, status not available" 519061 "DCU Node 2, status not available" 519062 "DCU Node 2, Error, Power Unit Changed" 519063 "DCU Node 2, Error, Encoder Interface Changed" 519064 "DCU Node 2, Error, Power Unit Type Changed" 519065 "DCU Node 2, Error, Invalid Ver., Encoder Interface" 519066 "DCU Node 2, Error, Overcurrent" 519067 "DCU Node 2, Error, Max Accel/Decel Setting Exceeded" 519068 "DCU Node 2, Error, Overcurrent Brake" 519069 "DCU Node 2, Error, Power Unit" 519070 "DCU Node 2, status not available" 519071 "DCU Node 2, status not available" 519072 "DCU Node 2, status not available" 519073 "DCU Node 2, status not available" 519074 "DCU Node 2, status not available" 519075 "DCU Node 2, status not available" 519076 "DCU Node 2, status not available" 519077 "DCU Node 2, status not available" 519078 "DCU Node 2, status not available" 519079 "DCU Node 2, status not available" 519080 "DCU Node 2, status not available" 519081 "DCU Node 2, Error, Rotor Detection, Five Step" 519082 "DCU Node 2, Error, Rotor Detection, Ld equal Lq" 519083 "DCU Node 2, Error, Limit Switch Forward" 519084 "DCU Node 2, Error, Limit Switch Reverse" 519085 "DCU Node 2, Error, Limit Switch Override Forward" 519086 "DCU Node 2, Error, Limit Switch Override Reverse" 519087 "DCU Node 2, Error Limit Switch" 519088 "DCU Node 2, Error, Power Off End" 519089 "DCU Node 2, Error, Encoder Type Change" 519090 "DCU Node 2, Error, Control Board Communication" 519091 "DCU Node 2, INIT, Encoder Interface" 519092 "DCU Node 2, status not available" 519093 "DCU Node 2, status not available" 519094 "DCU Node 2, status not available" 519095 "DCU Node 2, status not available" 519096 "DCU Node 2, Error, Encoder Missing" 519097 "DCU Node 2, Error, Overspeed (EMF)" 519098 "DCU Node 2, Error, Encoder A Changed" 519099 "DCU Node 2, Error, Encoder B Changed" 519100 "DCU Node 2, Error Overcurrent, Out 01" 519101 "DCU Node 2, Error Overcurrent, Out 02" 519102 "DCU Node 2, Error Overcurrent, Out 03" 519103 "DCU Node 2, Error Overcurrent, Out 04" 519104 "DCU Node 2, Error Overcurrent, Fan" 519105 "DCU Node 2, Error Overcurrent ,Encoder" 519106 "DCU Node 2, Error Overcurrent, 24V Supply" 519107 "DCU Node 2, Error, Overfrequency" 519108 "DCU Node 2, Error Reset, Internal Overheat Control Board" 519109 "DCU Node 2, Error, Internal Overheat, Control Board" 519110 "DCU Node 2, Error, Ramp OH" 519111 "DCU Node 2, Error, Ramp OHI" 519112 "DCU Node 2, Error 24V Supply Undervoltage" 519113 "DCU Node 2, Error STO signals" 519114 "DCU Node 2, Error Ext. 24V Supply Undervoltage" 519115 "DCU Node 2, Error GTR7 Always OFF" 519116 "DCU Node 2, Error GTR7 OC" 519117 "DCU Node 2, Error GTR7 Always ON" 519118 "DCU Node 2, OC at 5V Diagnostic" 519119 "DCU Node 2, Error, Extreme Overpotential" 519120 "DCU Node 2, Error, DC Capacitor Damaged" 519121 "DCU Node 2, status not available" 519122 "DCU Node 2, status not available" 519123 "DCU Node 2, status not available" 519124 "DCU Node 2, status not available" 519125 "DCU Node 2, status not available" 519126 "DCU Node 2, status not available" 519127 "DCU Node 2, status not available" 519128 "DCU Node 2, status not available" 519129 "DCU Node 2, status not available" 519130 "DCU Node 2, status not available" 519131 "DCU Node 2, status not available" 519132 "DCU Node 2, status not available" 519133 "DCU Node 2, status not available" 519134 "DCU Node 2, status not available" 519135 "DCU Node 2, status not available" 519300 "App Node 2, No error" 519301 "App Node 2, No axis" 519302 "App Node 2, Error reading mapping" 519303 "App Node 2, Error reading rated current" 519304 "App Node 2, Error rated current mismatch" 519305 "App Node 2, Error write pll offset" 519306 "App Node 2, Error auto mapping" 519307 "App Node 2, Error interlink communication" 519308 "App Node 2, Error overload parameter" 519309 "App Node 2, Incompatible default download" 519310 "App Node 2, Error downloading default download" 519311 "App Node 2, Default download not found" 519312 "App Node 2, Error CAN data timeout" 519313 "App Node 2, Error CAN data invalid" 519314 "App Node 2, Invalid license" 519315 "App Node 2, Error reinitializing app" 519319 "App Node 2, General application error" 520000 "DCU Node 3, No Error" 520001 "DCU Node 3, status not available" 520002 "DCU Node 3, status not available" 520003 "DCU Node 3, Error, Overcurrent Power Unit" 520004 "DCU Node 3, Error, Overcurrent Analog" 520005 "DCU Node 3, Error, Overvoltage DC Link" 520006 "DCU Node 3, Error, Undervoltage DC Link" 520007 "DCU Node 3, Error, Overload" 520008 "DCU Node 3, Reset Error, Overload" 520009 "DCU Node 3, Error, Overload 02" 520010 "DCU Node 3, Error, Power Module Overheat" 520011 "DCU Node 3, Reset Error, Power Module Overheat" 520012 "DCU Node 3, Error, Internal Power Unit Overheat" 520013 "DCU Node 3, Reset Error, Internal Power Unit Overheat" 520014 "DCU Node 3, Error, Motor Protection" 520015 "DCU Node 3, Reset Error, Motor Protection" 520016 "DCU Node 3, Error, Drive Overheat" 520017 "DCU Node 3, Reset Error, Drive Overheat" 520018 "DCU Node 3, Error, Overspeed" 520019 "DCU Node 3, status not available" 520020 "DCU Node 3, Error, Drive Data" 520021 "DCU Node 3, Error, Motor Data Not Stored" 520022 "DCU Node 3, Error, Indentification" 520023 "DCU Node 3, Error, Speed Difference" 520024 "DCU Node 3, Error, Fieldbus Memory" 520025 "DCU Node 3, status not available" 520026 "DCU Node 3, status not available" 520027 "DCU Node 3, status not available" 520028 "DCU Node 3, status not available" 520029 "DCU Node 3, status not available" 520030 "DCU Node 3, status not available" 520031 "DCU Node 3, status not available" 520032 "DCU Node 3, status not available" 520033 "DCU Node 3, status not available" 520034 "DCU Node 3, status not available" 520035 "DCU Node 3, status not available" 520036 "DCU Node 3, status not available" 520037 "DCU Node 3, status not available" 520038 "DCU Node 3, Error, Memory Size" 520039 "DCU Node 3, Error, Power Unit Software Version" 520040 "DCU Node 3, Error, FPGA Config" 520041 "DCU Node 3, status not available" 520042 "DCU Node 3, status not available" 520043 "DCU Node 3, Error, Encoder Interface Communication" 520044 "DCU Node 3, Error, Invlid Data, Power Unit" 520045 "DCU Node 3, status not available" 520046 "DCU Node 3, status not available" 520047 "DCU Node 3, status not available" 520048 "DCU Node 3, status not available" 520049 "DCU Node 3, status not available" 520050 "DCU Node 3, status not available" 520051 "DCU Node 3, status not available" 520052 "DCU Node 3, Error, Phase Undervoltage" 520053 "DCU Node 3, Error, Rotor Detection Current" 520054 "DCU Node 3, status not available" 520055 "DCU Node 3, status not available" 520056 "DCU Node 3, Error, SW Switch Left" 520057 "DCU Node 3, Error, SW Switch Right" 520058 "DCU Node 3, Error, Fieldbus Watchdog Response" 520059 "DCU Node 3, Error, Prog. Input" 520060 "DCU Node 3, status not available" 520061 "DCU Node 3, status not available" 520062 "DCU Node 3, Error, Power Unit Changed" 520063 "DCU Node 3, Error, Encoder Interface Changed" 520064 "DCU Node 3, Error, Power Unit Type Changed" 520065 "DCU Node 3, Error, Invalid Ver., Encoder Interface" 520066 "DCU Node 3, Error, Overcurrent" 520067 "DCU Node 3, Error, Max Accel/Decel Setting Exceeded" 520068 "DCU Node 3, Error, Overcurrent Brake" 520069 "DCU Node 3, Error, Power Unit" 520070 "DCU Node 3, status not available" 520071 "DCU Node 3, status not available" 520072 "DCU Node 3, status not available" 520073 "DCU Node 3, status not available" 520074 "DCU Node 3, status not available" 520075 "DCU Node 3, status not available" 520076 "DCU Node 3, status not available" 520077 "DCU Node 3, status not available" 520078 "DCU Node 3, status not available" 520079 "DCU Node 3, status not available" 520080 "DCU Node 3, status not available" 520081 "DCU Node 3, Error, Rotor Detection, Five Step" 520082 "DCU Node 3, Error, Rotor Detection, Ld equal Lq" 520083 "DCU Node 3, Error, Limit Switch Forward" 520084 "DCU Node 3, Error, Limit Switch Reverse" 520085 "DCU Node 3, Error, Limit Switch Override Forward" 520086 "DCU Node 3, Error, Limit Switch Override Reverse" 520087 "DCU Node 3, Error Limit Switch" 520088 "DCU Node 3, Error, Power Off End" 520089 "DCU Node 3, Error, Encoder Type Change" 520090 "DCU Node 3, Error, Control Board Communication" 520091 "DCU Node 3, INIT, Encoder Interface" 520092 "DCU Node 3, status not available" 520093 "DCU Node 3, status not available" 520094 "DCU Node 3, status not available" 520095 "DCU Node 3, status not available" 520096 "DCU Node 3, Error, Encoder Missing" 520097 "DCU Node 3, Error, Overspeed (EMF)" 520098 "DCU Node 3, Error, Encoder A Changed" 520099 "DCU Node 3, Error, Encoder B Changed" 520100 "DCU Node 3, Error Overcurrent, Out 01" 520101 "DCU Node 3, Error Overcurrent, Out 02" 520102 "DCU Node 3, Error Overcurrent, Out 03" 520103 "DCU Node 3, Error Overcurrent, Out 04" 520104 "DCU Node 3, Error Overcurrent, Fan" 520105 "DCU Node 3, Error Overcurrent ,Encoder" 520106 "DCU Node 3, Error Overcurrent, 24V Supply" 520107 "DCU Node 3, Error, Overfrequency" 520108 "DCU Node 3, Error Reset, Internal Overheat Control Board" 520109 "DCU Node 3, Error, Internal Overheat, Control Board" 520110 "DCU Node 3, Error, Ramp OH" 520111 "DCU Node 3, Error, Ramp OHI" 520112 "DCU Node 3, Error 24V Supply Undervoltage" 520113 "DCU Node 3, Error STO signals" 520114 "DCU Node 3, Error Ext. 24V Supply Undervoltage" 520115 "DCU Node 3, Error GTR7 Always OFF" 520116 "DCU Node 3, Error GTR7 OC" 520117 "DCU Node 3, Error GTR7 Always ON" 520118 "DCU Node 3, OC at 5V Diagnostic" 520119 "DCU Node 3, Error, Extreme Overpotential" 520120 "DCU Node 3, Error, DC Capacitor Damaged" 520121 "DCU Node 3, status not available" 520122 "DCU Node 3, status not available" 520123 "DCU Node 3, status not available" 520124 "DCU Node 3, status not available" 520125 "DCU Node 3, status not available" 520126 "DCU Node 3, status not available" 520127 "DCU Node 3, status not available" 520128 "DCU Node 3, status not available" 520129 "DCU Node 3, status not available" 520130 "DCU Node 3, status not available" 520131 "DCU Node 3, status not available" 520132 "DCU Node 3, status not available" 520133 "DCU Node 3, status not available" 520134 "DCU Node 3, status not available" 520135 "DCU Node 3, status not available" 520300 "App Node 3, No error" 520301 "App Node 3, No axis" 520302 "App Node 3, Error reading mapping" 520303 "App Node 3, Error reading rated current" 520304 "App Node 3, Error rated current mismatch" 520305 "App Node 3, Error write pll offset" 520306 "App Node 3, Error auto mapping" 520307 "App Node 3, Error interlink communication" 520308 "App Node 3, Error overload parameter" 520309 "App Node 3, Incompatible default download" 520310 "App Node 3, Error downloading default download" 520311 "App Node 3, Default download not found" 520312 "App Node 3, Error CAN data timeout" 520313 "App Node 3, Error CAN data invalid" 520314 "App Node 3, Invalid license" 520315 "App Node 3, Error reinitializing app" 520319 "App Node 3, General application error" 521000 "DCU Node 4, No Error" 521001 "DCU Node 4, status not available" 521002 "DCU Node 4, status not available" 521003 "DCU Node 4, Error, Overcurrent Power Unit" 521004 "DCU Node 4, Error, Overcurrent Analog" 521005 "DCU Node 4, Error, Overvoltage DC Link" 521006 "DCU Node 4, Error, Undervoltage DC Link" 521007 "DCU Node 4, Error, Overload" 521008 "DCU Node 4, Reset Error, Overload" 521009 "DCU Node 4, Error, Overload 02" 521010 "DCU Node 4, Error, Power Module Overheat" 521011 "DCU Node 4, Reset Error, Power Module Overheat" 521012 "DCU Node 4, Error, Internal Power Unit Overheat" 521013 "DCU Node 4, Reset Error, Internal Power Unit Overheat" 521014 "DCU Node 4, Error, Motor Protection" 521015 "DCU Node 4, Reset Error, Motor Protection" 521016 "DCU Node 4, Error, Drive Overheat" 521017 "DCU Node 4, Reset Error, Drive Overheat" 521018 "DCU Node 4, Error, Overspeed" 521019 "DCU Node 4, status not available" 521020 "DCU Node 4, Error, Drive Data" 521021 "DCU Node 4, Error, Motor Data Not Stored" 521022 "DCU Node 4, Error, Indentification" 521023 "DCU Node 4, Error, Speed Difference" 521024 "DCU Node 4, Error, Fieldbus Memory" 521025 "DCU Node 4, status not available" 521026 "DCU Node 4, status not available" 521027 "DCU Node 4, status not available" 521028 "DCU Node 4, status not available" 521029 "DCU Node 4, status not available" 521030 "DCU Node 4, status not available" 521031 "DCU Node 4, status not available" 521032 "DCU Node 4, status not available" 521033 "DCU Node 4, status not available" 521034 "DCU Node 4, status not available" 521035 "DCU Node 4, status not available" 521036 "DCU Node 4, status not available" 521037 "DCU Node 4, status not available" 521038 "DCU Node 4, Error, Memory Size" 521039 "DCU Node 4, Error, Power Unit Software Version" 521040 "DCU Node 4, Error, FPGA Config" 521041 "DCU Node 4, status not available" 521042 "DCU Node 4, status not available" 521043 "DCU Node 4, Error, Encoder Interface Communication" 521044 "DCU Node 4, Error, Invlid Data, Power Unit" 521045 "DCU Node 4, status not available" 521046 "DCU Node 4, status not available" 521047 "DCU Node 4, status not available" 521048 "DCU Node 4, status not available" 521049 "DCU Node 4, status not available" 521050 "DCU Node 4, status not available" 521051 "DCU Node 4, status not available" 521052 "DCU Node 4, Error, Phase Undervoltage" 521053 "DCU Node 4, Error, Rotor Detection Current" 521054 "DCU Node 4, status not available" 521055 "DCU Node 4, status not available" 521056 "DCU Node 4, Error, SW Switch Left" 521057 "DCU Node 4, Error, SW Switch Right" 521058 "DCU Node 4, Error, Fieldbus Watchdog Response" 521059 "DCU Node 4, Error, Prog. Input" 521060 "DCU Node 4, status not available" 521061 "DCU Node 4, status not available" 521062 "DCU Node 4, Error, Power Unit Changed" 521063 "DCU Node 4, Error, Encoder Interface Changed" 521064 "DCU Node 4, Error, Power Unit Type Changed" 521065 "DCU Node 4, Error, Invalid Ver., Encoder Interface" 521066 "DCU Node 4, Error, Overcurrent" 521067 "DCU Node 4, Error, Max Accel/Decel Setting Exceeded" 521068 "DCU Node 4, Error, Overcurrent Brake" 521069 "DCU Node 4, Error, Power Unit" 521070 "DCU Node 4, status not available" 521071 "DCU Node 4, status not available" 521072 "DCU Node 4, status not available" 521073 "DCU Node 4, status not available" 521074 "DCU Node 4, status not available" 521075 "DCU Node 4, status not available" 521076 "DCU Node 4, status not available" 521077 "DCU Node 4, status not available" 521078 "DCU Node 4, status not available" 521079 "DCU Node 4, status not available" 521080 "DCU Node 4, status not available" 521081 "DCU Node 4, Error, Rotor Detection, Five Step" 521082 "DCU Node 4, Error, Rotor Detection, Ld equal Lq" 521083 "DCU Node 4, Error, Limit Switch Forward" 521084 "DCU Node 4, Error, Limit Switch Reverse" 521085 "DCU Node 4, Error, Limit Switch Override Forward" 521086 "DCU Node 4, Error, Limit Switch Override Reverse" 521087 "DCU Node 4, Error Limit Switch" 521088 "DCU Node 4, Error, Power Off End" 521089 "DCU Node 4, Error, Encoder Type Change" 521090 "DCU Node 4, Error, Control Board Communication" 521091 "DCU Node 4, INIT, Encoder Interface" 521092 "DCU Node 4, status not available" 521093 "DCU Node 4, status not available" 521094 "DCU Node 4, status not available" 521095 "DCU Node 4, status not available" 521096 "DCU Node 4, Error, Encoder Missing" 521097 "DCU Node 4, Error, Overspeed (EMF)" 521098 "DCU Node 4, Error, Encoder A Changed" 521099 "DCU Node 4, Error, Encoder B Changed" 521100 "DCU Node 4, Error Overcurrent, Out 01" 521101 "DCU Node 4, Error Overcurrent, Out 02" 521102 "DCU Node 4, Error Overcurrent, Out 03" 521103 "DCU Node 4, Error Overcurrent, Out 04" 521104 "DCU Node 4, Error Overcurrent, Fan" 521105 "DCU Node 4, Error Overcurrent ,Encoder" 521106 "DCU Node 4, Error Overcurrent, 24V Supply" 521107 "DCU Node 4, Error, Overfrequency" 521108 "DCU Node 4, Error Reset, Internal Overheat Control Board" 521109 "DCU Node 4, Error, Internal Overheat, Control Board" 521110 "DCU Node 4, Error, Ramp OH" 521111 "DCU Node 4, Error, Ramp OHI" 521112 "DCU Node 4, Error 24V Supply Undervoltage" 521113 "DCU Node 4, Error STO signals" 521114 "DCU Node 4, Error Ext. 24V Supply Undervoltage" 521115 "DCU Node 4, Error GTR7 Always OFF" 521116 "DCU Node 4, Error GTR7 OC" 521117 "DCU Node 4, Error GTR7 Always ON" 521118 "DCU Node 4, OC at 5V Diagnostic" 521119 "DCU Node 4, Error, Extreme Overpotential" 521120 "DCU Node 4, Error, DC Capacitor Damaged" 521121 "DCU Node 4, status not available" 521122 "DCU Node 4, status not available" 521123 "DCU Node 4, status not available" 521124 "DCU Node 4, status not available" 521125 "DCU Node 4, status not available" 521126 "DCU Node 4, status not available" 521127 "DCU Node 4, status not available" 521128 "DCU Node 4, status not available" 521129 "DCU Node 4, status not available" 521130 "DCU Node 4, status not available" 521131 "DCU Node 4, status not available" 521132 "DCU Node 4, status not available" 521133 "DCU Node 4, status not available" 521134 "DCU Node 4, status not available" 521135 "DCU Node 4, status not available" 521300 "App Node 4, No error" 521301 "App Node 4, No axis" 521302 "App Node 4, Error reading mapping" 521303 "App Node 4, Error reading rated current" 521304 "App Node 4, Error rated current mismatch" 521305 "App Node 4, Error write pll offset" 521306 "App Node 4, Error auto mapping" 521307 "App Node 4, Error interlink communication" 521308 "App Node 4, Error overload parameter" 521309 "App Node 4, Incompatible default download" 521310 "App Node 4, Error downloading default download" 521311 "App Node 4, Default download not found" 521312 "App Node 4, Error CAN data timeout" 521313 "App Node 4, Error CAN data invalid" 521314 "App Node 4, Invalid license" 521315 "App Node 4, Error reinitializing app" 521319 "App Node 4, General application error" 522000 "DCU Node 5, No Error" 522001 "DCU Node 5, status not available" 522002 "DCU Node 5, status not available" 522003 "DCU Node 5, Error, Overcurrent Power Unit" 522004 "DCU Node 5, Error, Overcurrent Analog" 522005 "DCU Node 5, Error, Overvoltage DC Link" 522006 "DCU Node 5, Error, Undervoltage DC Link" 522007 "DCU Node 5, Error, Overload" 522008 "DCU Node 5, Reset Error, Overload" 522009 "DCU Node 5, Error, Overload 02" 522010 "DCU Node 5, Error, Power Module Overheat" 522011 "DCU Node 5, Reset Error, Power Module Overheat" 522012 "DCU Node 5, Error, Internal Power Unit Overheat" 522013 "DCU Node 5, Reset Error, Internal Power Unit Overheat" 522014 "DCU Node 5, Error, Motor Protection" 522015 "DCU Node 5, Reset Error, Motor Protection" 522016 "DCU Node 5, Error, Drive Overheat" 522017 "DCU Node 5, Reset Error, Drive Overheat" 522018 "DCU Node 5, Error, Overspeed" 522019 "DCU Node 5, status not available" 522020 "DCU Node 5, Error, Drive Data" 522021 "DCU Node 5, Error, Motor Data Not Stored" 522022 "DCU Node 5, Error, Indentification" 522023 "DCU Node 5, Error, Speed Difference" 522024 "DCU Node 5, Error, Fieldbus Memory" 522025 "DCU Node 5, status not available" 522026 "DCU Node 5, status not available" 522027 "DCU Node 5, status not available" 522028 "DCU Node 5, status not available" 522029 "DCU Node 5, status not available" 522030 "DCU Node 5, status not available" 522031 "DCU Node 5, status not available" 522032 "DCU Node 5, status not available" 522033 "DCU Node 5, status not available" 522034 "DCU Node 5, status not available" 522035 "DCU Node 5, status not available" 522036 "DCU Node 5, status not available" 522037 "DCU Node 5, status not available" 522038 "DCU Node 5, Error, Memory Size" 522039 "DCU Node 5, Error, Power Unit Software Version" 522040 "DCU Node 5, Error, FPGA Config" 522041 "DCU Node 5, status not available" 522042 "DCU Node 5, status not available" 522043 "DCU Node 5, Error, Encoder Interface Communication" 522044 "DCU Node 5, Error, Invlid Data, Power Unit" 522045 "DCU Node 5, status not available" 522046 "DCU Node 5, status not available" 522047 "DCU Node 5, status not available" 522048 "DCU Node 5, status not available" 522049 "DCU Node 5, status not available" 522050 "DCU Node 5, status not available" 522051 "DCU Node 5, status not available" 522052 "DCU Node 5, Error, Phase Undervoltage" 522053 "DCU Node 5, Error, Rotor Detection Current" 522054 "DCU Node 5, status not available" 522055 "DCU Node 5, status not available" 522056 "DCU Node 5, Error, SW Switch Left" 522057 "DCU Node 5, Error, SW Switch Right" 522058 "DCU Node 5, Error, Fieldbus Watchdog Response" 522059 "DCU Node 5, Error, Prog. Input" 522060 "DCU Node 5, status not available" 522061 "DCU Node 5, status not available" 522062 "DCU Node 5, Error, Power Unit Changed" 522063 "DCU Node 5, Error, Encoder Interface Changed" 522064 "DCU Node 5, Error, Power Unit Type Changed" 522065 "DCU Node 5, Error, Invalid Ver., Encoder Interface" 522066 "DCU Node 5, Error, Overcurrent" 522067 "DCU Node 5, Error, Max Accel/Decel Setting Exceeded" 522068 "DCU Node 5, Error, Overcurrent Brake" 522069 "DCU Node 5, Error, Power Unit" 522070 "DCU Node 5, status not available" 522071 "DCU Node 5, status not available" 522072 "DCU Node 5, status not available" 522073 "DCU Node 5, status not available" 522074 "DCU Node 5, status not available" 522075 "DCU Node 5, status not available" 522076 "DCU Node 5, status not available" 522077 "DCU Node 5, status not available" 522078 "DCU Node 5, status not available" 522079 "DCU Node 5, status not available" 522080 "DCU Node 5, status not available" 522081 "DCU Node 5, Error, Rotor Detection, Five Step" 522082 "DCU Node 5, Error, Rotor Detection, Ld equal Lq" 522083 "DCU Node 5, Error, Limit Switch Forward" 522084 "DCU Node 5, Error, Limit Switch Reverse" 522085 "DCU Node 5, Error, Limit Switch Override Forward" 522086 "DCU Node 5, Error, Limit Switch Override Reverse" 522087 "DCU Node 5, Error Limit Switch" 522088 "DCU Node 5, Error, Power Off End" 522089 "DCU Node 5, Error, Encoder Type Change" 522090 "DCU Node 5, Error, Control Board Communication" 522091 "DCU Node 5, INIT, Encoder Interface" 522092 "DCU Node 5, status not available" 522093 "DCU Node 5, status not available" 522094 "DCU Node 5, status not available" 522095 "DCU Node 5, status not available" 522096 "DCU Node 5, Error, Encoder Missing" 522097 "DCU Node 5, Error, Overspeed (EMF)" 522098 "DCU Node 5, Error, Encoder A Changed" 522099 "DCU Node 5, Error, Encoder B Changed" 522100 "DCU Node 5, Error Overcurrent, Out 01" 522101 "DCU Node 5, Error Overcurrent, Out 02" 522102 "DCU Node 5, Error Overcurrent, Out 03" 522103 "DCU Node 5, Error Overcurrent, Out 04" 522104 "DCU Node 5, Error Overcurrent, Fan" 522105 "DCU Node 5, Error Overcurrent ,Encoder" 522106 "DCU Node 5, Error Overcurrent, 24V Supply" 522107 "DCU Node 5, Error, Overfrequency" 522108 "DCU Node 5, Error Reset, Internal Overheat Control Board" 522109 "DCU Node 5, Error, Internal Overheat, Control Board" 522110 "DCU Node 5, Error, Ramp OH" 522111 "DCU Node 5, Error, Ramp OHI" 522112 "DCU Node 5, Error 24V Supply Undervoltage" 522113 "DCU Node 5, Error STO signals" 522114 "DCU Node 5, Error Ext. 24V Supply Undervoltage" 522115 "DCU Node 5, Error GTR7 Always OFF" 522116 "DCU Node 5, Error GTR7 OC" 522117 "DCU Node 5, Error GTR7 Always ON" 522118 "DCU Node 5, OC at 5V Diagnostic" 522119 "DCU Node 5, Error, Extreme Overpotential" 522120 "DCU Node 5, Error, DC Capacitor Damaged" 522121 "DCU Node 5, status not available" 522122 "DCU Node 5, status not available" 522123 "DCU Node 5, status not available" 522124 "DCU Node 5, status not available" 522125 "DCU Node 5, status not available" 522126 "DCU Node 5, status not available" 522127 "DCU Node 5, status not available" 522128 "DCU Node 5, status not available" 522129 "DCU Node 5, status not available" 522130 "DCU Node 5, status not available" 522131 "DCU Node 5, status not available" 522132 "DCU Node 5, status not available" 522133 "DCU Node 5, status not available" 522134 "DCU Node 5, status not available" 522135 "DCU Node 5, status not available" 522300 "App Node 5, No error" 522301 "App Node 5, No axis" 522302 "App Node 5, Error reading mapping" 522303 "App Node 5, Error reading rated current" 522304 "App Node 5, Error rated current mismatch" 522305 "App Node 5, Error write pll offset" 522306 "App Node 5, Error auto mapping" 522307 "App Node 5, Error interlink communication" 522308 "App Node 5, Error overload parameter" 522309 "App Node 5, Incompatible default download" 522310 "App Node 5, Error downloading default download" 522311 "App Node 5, Default download not found" 522312 "App Node 5, Error CAN data timeout" 522313 "App Node 5, Error CAN data invalid" 522314 "App Node 5, Invalid license" 522315 "App Node 5, Error reinitializing app" 522319 "App Node 5, General application error" 523000 "DCU Node 6, No Error" 523001 "DCU Node 6, status not available" 523002 "DCU Node 6, status not available" 523003 "DCU Node 6, Error, Overcurrent Power Unit" 523004 "DCU Node 6, Error, Overcurrent Analog" 523005 "DCU Node 6, Error, Overvoltage DC Link" 523006 "DCU Node 6, Error, Undervoltage DC Link" 523007 "DCU Node 6, Error, Overload" 523008 "DCU Node 6, Reset Error, Overload" 523009 "DCU Node 6, Error, Overload 02" 523010 "DCU Node 6, Error, Power Module Overheat" 523011 "DCU Node 6, Reset Error, Power Module Overheat" 523012 "DCU Node 6, Error, Internal Power Unit Overheat" 523013 "DCU Node 6, Reset Error, Internal Power Unit Overheat" 523014 "DCU Node 6, Error, Motor Protection" 523015 "DCU Node 6, Reset Error, Motor Protection" 523016 "DCU Node 6, Error, Drive Overheat" 523017 "DCU Node 6, Reset Error, Drive Overheat" 523018 "DCU Node 6, Error, Overspeed" 523019 "DCU Node 6, status not available" 523020 "DCU Node 6, Error, Drive Data" 523021 "DCU Node 6, Error, Motor Data Not Stored" 523022 "DCU Node 6, Error, Indentification" 523023 "DCU Node 6, Error, Speed Difference" 523024 "DCU Node 6, Error, Fieldbus Memory" 523025 "DCU Node 6, status not available" 523026 "DCU Node 6, status not available" 523027 "DCU Node 6, status not available" 523028 "DCU Node 6, status not available" 523029 "DCU Node 6, status not available" 523030 "DCU Node 6, status not available" 523031 "DCU Node 6, status not available" 523032 "DCU Node 6, status not available" 523033 "DCU Node 6, status not available" 523034 "DCU Node 6, status not available" 523035 "DCU Node 6, status not available" 523036 "DCU Node 6, status not available" 523037 "DCU Node 6, status not available" 523038 "DCU Node 6, Error, Memory Size" 523039 "DCU Node 6, Error, Power Unit Software Version" 523040 "DCU Node 6, Error, FPGA Config" 523041 "DCU Node 6, status not available" 523042 "DCU Node 6, status not available" 523043 "DCU Node 6, Error, Encoder Interface Communication" 523044 "DCU Node 6, Error, Invlid Data, Power Unit" 523045 "DCU Node 6, status not available" 523046 "DCU Node 6, status not available" 523047 "DCU Node 6, status not available" 523048 "DCU Node 6, status not available" 523049 "DCU Node 6, status not available" 523050 "DCU Node 6, status not available" 523051 "DCU Node 6, status not available" 523052 "DCU Node 6, Error, Phase Undervoltage" 523053 "DCU Node 6, Error, Rotor Detection Current" 523054 "DCU Node 6, status not available" 523055 "DCU Node 6, status not available" 523056 "DCU Node 6, Error, SW Switch Left" 523057 "DCU Node 6, Error, SW Switch Right" 523058 "DCU Node 6, Error, Fieldbus Watchdog Response" 523059 "DCU Node 6, Error, Prog. Input" 523060 "DCU Node 6, status not available" 523061 "DCU Node 6, status not available" 523062 "DCU Node 6, Error, Power Unit Changed" 523063 "DCU Node 6, Error, Encoder Interface Changed" 523064 "DCU Node 6, Error, Power Unit Type Changed" 523065 "DCU Node 6, Error, Invalid Ver., Encoder Interface" 523066 "DCU Node 6, Error, Overcurrent" 523067 "DCU Node 6, Error, Max Accel/Decel Setting Exceeded" 523068 "DCU Node 6, Error, Overcurrent Brake" 523069 "DCU Node 6, Error, Power Unit" 523070 "DCU Node 6, status not available" 523071 "DCU Node 6, status not available" 523072 "DCU Node 6, status not available" 523073 "DCU Node 6, status not available" 523074 "DCU Node 6, status not available" 523075 "DCU Node 6, status not available" 523076 "DCU Node 6, status not available" 523077 "DCU Node 6, status not available" 523078 "DCU Node 6, status not available" 523079 "DCU Node 6, status not available" 523080 "DCU Node 6, status not available" 523081 "DCU Node 6, Error, Rotor Detection, Five Step" 523082 "DCU Node 6, Error, Rotor Detection, Ld equal Lq" 523083 "DCU Node 6, Error, Limit Switch Forward" 523084 "DCU Node 6, Error, Limit Switch Reverse" 523085 "DCU Node 6, Error, Limit Switch Override Forward" 523086 "DCU Node 6, Error, Limit Switch Override Reverse" 523087 "DCU Node 6, Error Limit Switch" 523088 "DCU Node 6, Error, Power Off End" 523089 "DCU Node 6, Error, Encoder Type Change" 523090 "DCU Node 6, Error, Control Board Communication" 523091 "DCU Node 6, INIT, Encoder Interface" 523092 "DCU Node 6, status not available" 523093 "DCU Node 6, status not available" 523094 "DCU Node 6, status not available" 523095 "DCU Node 6, status not available" 523096 "DCU Node 6, Error, Encoder Missing" 523097 "DCU Node 6, Error, Overspeed (EMF)" 523098 "DCU Node 6, Error, Encoder A Changed" 523099 "DCU Node 6, Error, Encoder B Changed" 523100 "DCU Node 6, Error Overcurrent, Out 01" 523101 "DCU Node 6, Error Overcurrent, Out 02" 523102 "DCU Node 6, Error Overcurrent, Out 03" 523103 "DCU Node 6, Error Overcurrent, Out 04" 523104 "DCU Node 6, Error Overcurrent, Fan" 523105 "DCU Node 6, Error Overcurrent ,Encoder" 523106 "DCU Node 6, Error Overcurrent, 24V Supply" 523107 "DCU Node 6, Error, Overfrequency" 523108 "DCU Node 6, Error Reset, Internal Overheat Control Board" 523109 "DCU Node 6, Error, Internal Overheat, Control Board" 523110 "DCU Node 6, Error, Ramp OH" 523111 "DCU Node 6, Error, Ramp OHI" 523112 "DCU Node 6, Error 24V Supply Undervoltage" 523113 "DCU Node 6, Error STO signals" 523114 "DCU Node 6, Error Ext. 24V Supply Undervoltage" 523115 "DCU Node 6, Error GTR7 Always OFF" 523116 "DCU Node 6, Error GTR7 OC" 523117 "DCU Node 6, Error GTR7 Always ON" 523118 "DCU Node 6, OC at 5V Diagnostic" 523119 "DCU Node 6, Error, Extreme Overpotential" 523120 "DCU Node 6, Error, DC Capacitor Damaged" 523121 "DCU Node 6, status not available" 523122 "DCU Node 6, status not available" 523123 "DCU Node 6, status not available" 523124 "DCU Node 6, status not available" 523125 "DCU Node 6, status not available" 523126 "DCU Node 6, status not available" 523127 "DCU Node 6, status not available" 523128 "DCU Node 6, status not available" 523129 "DCU Node 6, status not available" 523130 "DCU Node 6, status not available" 523131 "DCU Node 6, status not available" 523132 "DCU Node 6, status not available" 523133 "DCU Node 6, status not available" 523134 "DCU Node 6, status not available" 523135 "DCU Node 6, status not available" 523300 "App Node 6, No error" 523301 "App Node 6, No axis" 523302 "App Node 6, Error reading mapping" 523303 "App Node 6, Error reading rated current" 523304 "App Node 6, Error rated current mismatch" 523305 "App Node 6, Error write pll offset" 523306 "App Node 6, Error auto mapping" 523307 "App Node 6, Error interlink communication" 523308 "App Node 6, Error overload parameter" 523309 "App Node 6, Incompatible default download" 523310 "App Node 6, Error downloading default download" 523311 "App Node 6, Default download not found" 523312 "App Node 6, Error CAN data timeout" 523313 "App Node 6, Error CAN data invalid" 523314 "App Node 6, Invalid license" 523315 "App Node 6, Error reinitializing app" 523319 "App Node 6, General application error" ;
VAL_ 2566835024 RedStopLampState 3 "Not available" 2 "Reserved" 1 "Lamp On" 0 "Lamp Off" ;
VAL_ 2566835024 ProtectLampStatus 3 "Not available" 2 "Reserved" 1 "Lamp On" 0 "Lamp Off" ;
VAL_ 2566835024 FlashRedStopLamp 3 "Unavailable / Do Not Flash" 2 "Class C DTC  " 1 "Fast Flash" 0 "Slow Flash" ;
VAL_ 2566835024 FlashProtectLamp 3 "Unavailable / Do Not Flash" 2 "Class C DTC  " 1 "Fast Flash" 0 "Slow Flash" ;
VAL_ 2566835024 FlashMalfuncIndicatorLamp 3 "Unavailable / Do Not Flash" 2 "Class C DTC  " 1 "Fast Flash" 0 "Slow Flash" ;
VAL_ 2566834768 FMI_DTC6 22 "Data Drifted Low" 21 "Data Drifted High" 20 "Received Network Data In Error" 0 "Above normal (most severe)" 1 "Below normal (most severe)" 2 "Data erratic" 3 "Voltage above normal" 4 "Voltage below normal" 5 "Current below normal" 6 "Current above normal" 7 "Mechanical system not responding" 8 "Abnormal frequency" 9 "Abnormal update rate" 10 "Abnormal rate of change" 11 "Root cause not known" 12 "Bad intelligent device" 13 "Out of calibration" 14 "Special intstructions" 15 "Above normal (least severe)" 16 "Above normal (moderately severe)" 17 "Below normal (least severe)" 18 "Below normal (moderately severe)" 19 "Received network data in error" 31 "Condition Exists" ;
VAL_ 2566834768 FMI_DTC5 22 "Data Drifted Low" 21 "Data Drifted High" 20 "Received Network Data In Error" 0 "Above normal (most severe)" 1 "Below normal (most severe)" 2 "Data erratic" 3 "Voltage above normal" 4 "Voltage below normal" 5 "Current below normal" 6 "Current above normal" 7 "Mechanical system not responding" 8 "Abnormal frequency" 9 "Abnormal update rate" 10 "Abnormal rate of change" 11 "Root cause not known" 12 "Bad intelligent device" 13 "Out of calibration" 14 "Special intstructions" 15 "Above normal (least severe)" 16 "Above normal (moderately severe)" 17 "Below normal (least severe)" 18 "Below normal (moderately severe)" 19 "Received network data in error" 31 "Condition Exists" ;
VAL_ 2566834768 FMI_DTC4 22 "Data Drifted Low" 21 "Data Drifted High" 20 "Received Network Data In Error" 0 "Above normal (most severe)" 1 "Below normal (most severe)" 2 "Data erratic" 3 "Voltage above normal" 4 "Voltage below normal" 5 "Current below normal" 6 "Current above normal" 7 "Mechanical system not responding" 8 "Abnormal frequency" 9 "Abnormal update rate" 10 "Abnormal rate of change" 11 "Root cause not known" 12 "Bad intelligent device" 13 "Out of calibration" 14 "Special intstructions" 15 "Above normal (least severe)" 16 "Above normal (moderately severe)" 17 "Below normal (least severe)" 18 "Below normal (moderately severe)" 19 "Received network data in error" 31 "Condition Exists" ;
VAL_ 2566834768 FMI_DTC3 22 "Data Drifted Low" 21 "Data Drifted High" 20 "Received Network Data In Error" 0 "Above normal (most severe)" 1 "Below normal (most severe)" 2 "Data erratic" 3 "Voltage above normal" 4 "Voltage below normal" 5 "Current below normal" 6 "Current above normal" 7 "Mechanical system not responding" 8 "Abnormal frequency" 9 "Abnormal update rate" 10 "Abnormal rate of change" 11 "Root cause not known" 12 "Bad intelligent device" 13 "Out of calibration" 14 "Special intstructions" 15 "Above normal (least severe)" 16 "Above normal (moderately severe)" 17 "Below normal (least severe)" 18 "Below normal (moderately severe)" 19 "Received network data in error" 31 "Condition Exists" ;
VAL_ 2566834768 FMI_DTC2 22 "Data Drifted Low" 21 "Data Drifted High" 20 "Received Network Data In Error" 0 "Above normal (most severe)" 1 "Below normal (most severe)" 2 "Data erratic" 3 "Voltage above normal" 4 "Voltage below normal" 5 "Current below normal" 6 "Current above normal" 7 "Mechanical system not responding" 8 "Abnormal frequency" 9 "Abnormal update rate" 10 "Abnormal rate of change" 11 "Root cause not known" 12 "Bad intelligent device" 13 "Out of calibration" 14 "Special intstructions" 15 "Above normal (least severe)" 16 "Above normal (moderately severe)" 17 "Below normal (least severe)" 18 "Below normal (moderately severe)" 19 "Received network data in error" 31 "Condition Exists" ;
VAL_ 2566834768 SPN_DTC6 0 "No Error" 517290 "MCU Node 0, No Error" 517291 "MCU Node 0, No configuration file found" 517292 "MCU Node 0, Invalid J1939 license" 517293 "MCU Node 0, Error downloading configuration file" 517294 "MCU Node 0, Overload protection active" 517295 "MCU Node 0, Invalid app selection" 517296 "MCU Node 0, Overload warning active" 518000 "DCU Node 1, No Error" 518001 "DCU Node 1, status not available" 518002 "DCU Node 1, status not available" 518003 "DCU Node 1, Error, Overcurrent Power Unit" 518004 "DCU Node 1, Error, Overcurrent Analog" 518005 "DCU Node 1, Error, Overvoltage DC Link" 518006 "DCU Node 1, Error, Undervoltage DC Link" 518007 "DCU Node 1, Error, Overload" 518008 "DCU Node 1, Reset Error, Overload" 518009 "DCU Node 1, Error, Overload 02" 518010 "DCU Node 1, Error, Power Module Overheat" 518011 "DCU Node 1, Reset Error, Power Module Overheat" 518012 "DCU Node 1, Error, Internal Power Unit Overheat" 518013 "DCU Node 1, Reset Error, Internal Power Unit Overheat" 518014 "DCU Node 1, Error, Motor Protection" 518015 "DCU Node 1, Reset Error, Motor Protection" 518016 "DCU Node 1, Error, Drive Overheat" 518017 "DCU Node 1, Reset Error, Drive Overheat" 518018 "DCU Node 1, Error, Overspeed" 518019 "DCU Node 1, status not available" 518020 "DCU Node 1, Error, Drive Data" 518021 "DCU Node 1, Error, Motor Data Not Stored" 518022 "DCU Node 1, Error, Indentification" 518023 "DCU Node 1, Error, Speed Difference" 518024 "DCU Node 1, Error, Fieldbus Memory" 518025 "DCU Node 1, status not available" 518026 "DCU Node 1, status not available" 518027 "DCU Node 1, status not available" 518028 "DCU Node 1, status not available" 518029 "DCU Node 1, status not available" 518030 "DCU Node 1, status not available" 518031 "DCU Node 1, status not available" 518032 "DCU Node 1, status not available" 518033 "DCU Node 1, status not available" 518034 "DCU Node 1, status not available" 518035 "DCU Node 1, status not available" 518036 "DCU Node 1, status not available" 518037 "DCU Node 1, status not available" 518038 "DCU Node 1, Error, Memory Size" 518039 "DCU Node 1, Error, Power Unit Software Version" 518040 "DCU Node 1, Error, FPGA Config" 518041 "DCU Node 1, status not available" 518042 "DCU Node 1, status not available" 518043 "DCU Node 1, Error, Encoder Interface Communication" 518044 "DCU Node 1, Error, Invlid Data, Power Unit" 518045 "DCU Node 1, status not available" 518046 "DCU Node 1, status not available" 518047 "DCU Node 1, status not available" 518048 "DCU Node 1, status not available" 518049 "DCU Node 1, status not available" 518050 "DCU Node 1, status not available" 518051 "DCU Node 1, status not available" 518052 "DCU Node 1, Error, Phase Undervoltage" 518053 "DCU Node 1, Error, Rotor Detection Current" 518054 "DCU Node 1, status not available" 518055 "DCU Node 1, status not available" 518056 "DCU Node 1, Error, SW Switch Left" 518057 "DCU Node 1, Error, SW Switch Right" 518058 "DCU Node 1, Error, Fieldbus Watchdog Response" 518059 "DCU Node 1, Error, Prog. Input" 518060 "DCU Node 1, status not available" 518061 "DCU Node 1, status not available" 518062 "DCU Node 1, Error, Power Unit Changed" 518063 "DCU Node 1, Error, Encoder Interface Changed" 518064 "DCU Node 1, Error, Power Unit Type Changed" 518065 "DCU Node 1, Error, Invalid Ver., Encoder Interface" 518066 "DCU Node 1, Error, Overcurrent" 518067 "DCU Node 1, Error, Max Accel/Decel Setting Exceeded" 518068 "DCU Node 1, Error, Overcurrent Brake" 518069 "DCU Node 1, Error, Power Unit" 518070 "DCU Node 1, status not available" 518071 "DCU Node 1, status not available" 518072 "DCU Node 1, status not available" 518073 "DCU Node 1, status not available" 518074 "DCU Node 1, status not available" 518075 "DCU Node 1, status not available" 518076 "DCU Node 1, status not available" 518077 "DCU Node 1, status not available" 518078 "DCU Node 1, status not available" 518079 "DCU Node 1, status not available" 518080 "DCU Node 1, status not available" 518081 "DCU Node 1, Error, Rotor Detection, Five Step" 518082 "DCU Node 1, Error, Rotor Detection, Ld equal Lq" 518083 "DCU Node 1, Error, Limit Switch Forward" 518084 "DCU Node 1, Error, Limit Switch Reverse" 518085 "DCU Node 1, Error, Limit Switch Override Forward" 518086 "DCU Node 1, Error, Limit Switch Override Reverse" 518087 "DCU Node 1, Error Limit Switch" 518088 "DCU Node 1, Error, Power Off End" 518089 "DCU Node 1, Error, Encoder Type Change" 518090 "DCU Node 1, Error, Control Board Communication" 518091 "DCU Node 1, INIT, Encoder Interface" 518092 "DCU Node 1, status not available" 518093 "DCU Node 1, status not available" 518094 "DCU Node 1, status not available" 518095 "DCU Node 1, status not available" 518096 "DCU Node 1, Error, Encoder Missing" 518097 "DCU Node 1, Error, Overspeed (EMF)" 518098 "DCU Node 1, Error, Encoder A Changed" 518099 "DCU Node 1, Error, Encoder B Changed" 518100 "DCU Node 1, Error Overcurrent, Out 01" 518101 "DCU Node 1, Error Overcurrent, Out 02" 518102 "DCU Node 1, Error Overcurrent, Out 03" 518103 "DCU Node 1, Error Overcurrent, Out 04" 518104 "DCU Node 1, Error Overcurrent, Fan" 518105 "DCU Node 1, Error Overcurrent ,Encoder" 518106 "DCU Node 1, Error Overcurrent, 24V Supply" 518107 "DCU Node 1, Error, Overfrequency" 518108 "DCU Node 1, Error Reset, Internal Overheat Control Board" 518109 "DCU Node 1, Error, Internal Overheat, Control Board" 518110 "DCU Node 1, Error, Ramp OH" 518111 "DCU Node 1, Error, Ramp OHI" 518112 "DCU Node 1, Error 24V Supply Undervoltage" 518113 "DCU Node 1, Error STO signals" 518114 "DCU Node 1, Error Ext. 24V Supply Undervoltage" 518115 "DCU Node 1, Error GTR7 Always OFF" 518116 "DCU Node 1, Error GTR7 OC" 518117 "DCU Node 1, Error GTR7 Always ON" 518118 "DCU Node 1, OC at 5V Diagnostic" 518119 "DCU Node 1, Error, Extreme Overpotential" 518120 "DCU Node 1, Error, DC Capacitor Damaged" 518121 "DCU Node 1, status not available" 518122 "DCU Node 1, status not available" 518123 "DCU Node 1, status not available" 518124 "DCU Node 1, status not available" 518125 "DCU Node 1, status not available" 518126 "DCU Node 1, status not available" 518127 "DCU Node 1, status not available" 518128 "DCU Node 1, status not available" 518129 "DCU Node 1, status not available" 518130 "DCU Node 1, status not available" 518131 "DCU Node 1, status not available" 518132 "DCU Node 1, status not available" 518133 "DCU Node 1, status not available" 518134 "DCU Node 1, status not available" 518135 "DCU Node 1, status not available" 518300 "App Node 1, No error" 518301 "App Node 1, No axis" 518302 "App Node 1, Error reading mapping" 518303 "App Node 1, Error reading rated current" 518304 "App Node 1, Error rated current mismatch" 518305 "App Node 1, Error write pll offset" 518306 "App Node 1, Error auto mapping" 518307 "App Node 1, Error interlink communication" 518308 "App Node 1, Error overload parameter" 518309 "App Node 1, Incompatible default download" 518310 "App Node 1, Error downloading default download" 518311 "App Node 1, Default download not found" 518312 "App Node 1, Error CAN data timeout" 518313 "App Node 1, Error CAN data invalid" 518314 "App Node 1, Invalid license" 518315 "App Node 1, Error reinitializing app" 518319 "App Node 1, General application error" 519000 "DCU Node 2, No Error" 519001 "DCU Node 2, status not available" 519002 "DCU Node 2, status not available" 519003 "DCU Node 2, Error, Overcurrent Power Unit" 519004 "DCU Node 2, Error, Overcurrent Analog" 519005 "DCU Node 2, Error, Overvoltage DC Link" 519006 "DCU Node 2, Error, Undervoltage DC Link" 519007 "DCU Node 2, Error, Overload" 519008 "DCU Node 2, Reset Error, Overload" 519009 "DCU Node 2, Error, Overload 02" 519010 "DCU Node 2, Error, Power Module Overheat" 519011 "DCU Node 2, Reset Error, Power Module Overheat" 519012 "DCU Node 2, Error, Internal Power Unit Overheat" 519013 "DCU Node 2, Reset Error, Internal Power Unit Overheat" 519014 "DCU Node 2, Error, Motor Protection" 519015 "DCU Node 2, Reset Error, Motor Protection" 519016 "DCU Node 2, Error, Drive Overheat" 519017 "DCU Node 2, Reset Error, Drive Overheat" 519018 "DCU Node 2, Error, Overspeed" 519019 "DCU Node 2, status not available" 519020 "DCU Node 2, Error, Drive Data" 519021 "DCU Node 2, Error, Motor Data Not Stored" 519022 "DCU Node 2, Error, Indentification" 519023 "DCU Node 2, Error, Speed Difference" 519024 "DCU Node 2, Error, Fieldbus Memory" 519025 "DCU Node 2, status not available" 519026 "DCU Node 2, status not available" 519027 "DCU Node 2, status not available" 519028 "DCU Node 2, status not available" 519029 "DCU Node 2, status not available" 519030 "DCU Node 2, status not available" 519031 "DCU Node 2, status not available" 519032 "DCU Node 2, status not available" 519033 "DCU Node 2, status not available" 519034 "DCU Node 2, status not available" 519035 "DCU Node 2, status not available" 519036 "DCU Node 2, status not available" 519037 "DCU Node 2, status not available" 519038 "DCU Node 2, Error, Memory Size" 519039 "DCU Node 2, Error, Power Unit Software Version" 519040 "DCU Node 2, Error, FPGA Config" 519041 "DCU Node 2, status not available" 519042 "DCU Node 2, status not available" 519043 "DCU Node 2, Error, Encoder Interface Communication" 519044 "DCU Node 2, Error, Invlid Data, Power Unit" 519045 "DCU Node 2, status not available" 519046 "DCU Node 2, status not available" 519047 "DCU Node 2, status not available" 519048 "DCU Node 2, status not available" 519049 "DCU Node 2, status not available" 519050 "DCU Node 2, status not available" 519051 "DCU Node 2, status not available" 519052 "DCU Node 2, Error, Phase Undervoltage" 519053 "DCU Node 2, Error, Rotor Detection Current" 519054 "DCU Node 2, status not available" 519055 "DCU Node 2, status not available" 519056 "DCU Node 2, Error, SW Switch Left" 519057 "DCU Node 2, Error, SW Switch Right" 519058 "DCU Node 2, Error, Fieldbus Watchdog Response" 519059 "DCU Node 2, Error, Prog. Input" 519060 "DCU Node 2, status not available" 519061 "DCU Node 2, status not available" 519062 "DCU Node 2, Error, Power Unit Changed" 519063 "DCU Node 2, Error, Encoder Interface Changed" 519064 "DCU Node 2, Error, Power Unit Type Changed" 519065 "DCU Node 2, Error, Invalid Ver., Encoder Interface" 519066 "DCU Node 2, Error, Overcurrent" 519067 "DCU Node 2, Error, Max Accel/Decel Setting Exceeded" 519068 "DCU Node 2, Error, Overcurrent Brake" 519069 "DCU Node 2, Error, Power Unit" 519070 "DCU Node 2, status not available" 519071 "DCU Node 2, status not available" 519072 "DCU Node 2, status not available" 519073 "DCU Node 2, status not available" 519074 "DCU Node 2, status not available" 519075 "DCU Node 2, status not available" 519076 "DCU Node 2, status not available" 519077 "DCU Node 2, status not available" 519078 "DCU Node 2, status not available" 519079 "DCU Node 2, status not available" 519080 "DCU Node 2, status not available" 519081 "DCU Node 2, Error, Rotor Detection, Five Step" 519082 "DCU Node 2, Error, Rotor Detection, Ld equal Lq" 519083 "DCU Node 2, Error, Limit Switch Forward" 519084 "DCU Node 2, Error, Limit Switch Reverse" 519085 "DCU Node 2, Error, Limit Switch Override Forward" 519086 "DCU Node 2, Error, Limit Switch Override Reverse" 519087 "DCU Node 2, Error Limit Switch" 519088 "DCU Node 2, Error, Power Off End" 519089 "DCU Node 2, Error, Encoder Type Change" 519090 "DCU Node 2, Error, Control Board Communication" 519091 "DCU Node 2, INIT, Encoder Interface" 519092 "DCU Node 2, status not available" 519093 "DCU Node 2, status not available" 519094 "DCU Node 2, status not available" 519095 "DCU Node 2, status not available" 519096 "DCU Node 2, Error, Encoder Missing" 519097 "DCU Node 2, Error, Overspeed (EMF)" 519098 "DCU Node 2, Error, Encoder A Changed" 519099 "DCU Node 2, Error, Encoder B Changed" 519100 "DCU Node 2, Error Overcurrent, Out 01" 519101 "DCU Node 2, Error Overcurrent, Out 02" 519102 "DCU Node 2, Error Overcurrent, Out 03" 519103 "DCU Node 2, Error Overcurrent, Out 04" 519104 "DCU Node 2, Error Overcurrent, Fan" 519105 "DCU Node 2, Error Overcurrent ,Encoder" 519106 "DCU Node 2, Error Overcurrent, 24V Supply" 519107 "DCU Node 2, Error, Overfrequency" 519108 "DCU Node 2, Error Reset, Internal Overheat Control Board" 519109 "DCU Node 2, Error, Internal Overheat, Control Board" 519110 "DCU Node 2, Error, Ramp OH" 519111 "DCU Node 2, Error, Ramp OHI" 519112 "DCU Node 2, Error 24V Supply Undervoltage" 519113 "DCU Node 2, Error STO signals" 519114 "DCU Node 2, Error Ext. 24V Supply Undervoltage" 519115 "DCU Node 2, Error GTR7 Always OFF" 519116 "DCU Node 2, Error GTR7 OC" 519117 "DCU Node 2, Error GTR7 Always ON" 519118 "DCU Node 2, OC at 5V Diagnostic" 519119 "DCU Node 2, Error, Extreme Overpotential" 519120 "DCU Node 2, Error, DC Capacitor Damaged" 519121 "DCU Node 2, status not available" 519122 "DCU Node 2, status not available" 519123 "DCU Node 2, status not available" 519124 "DCU Node 2, status not available" 519125 "DCU Node 2, status not available" 519126 "DCU Node 2, status not available" 519127 "DCU Node 2, status not available" 519128 "DCU Node 2, status not available" 519129 "DCU Node 2, status not available" 519130 "DCU Node 2, status not available" 519131 "DCU Node 2, status not available" 519132 "DCU Node 2, status not available" 519133 "DCU Node 2, status not available" 519134 "DCU Node 2, status not available" 519135 "DCU Node 2, status not available" 519300 "App Node 2, No error" 519301 "App Node 2, No axis" 519302 "App Node 2, Error reading mapping" 519303 "App Node 2, Error reading rated current" 519304 "App Node 2, Error rated current mismatch" 519305 "App Node 2, Error write pll offset" 519306 "App Node 2, Error auto mapping" 519307 "App Node 2, Error interlink communication" 519308 "App Node 2, Error overload parameter" 519309 "App Node 2, Incompatible default download" 519310 "App Node 2, Error downloading default download" 519311 "App Node 2, Default download not found" 519312 "App Node 2, Error CAN data timeout" 519313 "App Node 2, Error CAN data invalid" 519314 "App Node 2, Invalid license" 519315 "App Node 2, Error reinitializing app" 519319 "App Node 2, General application error" 520000 "DCU Node 3, No Error" 520001 "DCU Node 3, status not available" 520002 "DCU Node 3, status not available" 520003 "DCU Node 3, Error, Overcurrent Power Unit" 520004 "DCU Node 3, Error, Overcurrent Analog" 520005 "DCU Node 3, Error, Overvoltage DC Link" 520006 "DCU Node 3, Error, Undervoltage DC Link" 520007 "DCU Node 3, Error, Overload" 520008 "DCU Node 3, Reset Error, Overload" 520009 "DCU Node 3, Error, Overload 02" 520010 "DCU Node 3, Error, Power Module Overheat" 520011 "DCU Node 3, Reset Error, Power Module Overheat" 520012 "DCU Node 3, Error, Internal Power Unit Overheat" 520013 "DCU Node 3, Reset Error, Internal Power Unit Overheat" 520014 "DCU Node 3, Error, Motor Protection" 520015 "DCU Node 3, Reset Error, Motor Protection" 520016 "DCU Node 3, Error, Drive Overheat" 520017 "DCU Node 3, Reset Error, Drive Overheat" 520018 "DCU Node 3, Error, Overspeed" 520019 "DCU Node 3, status not available" 520020 "DCU Node 3, Error, Drive Data" 520021 "DCU Node 3, Error, Motor Data Not Stored" 520022 "DCU Node 3, Error, Indentification" 520023 "DCU Node 3, Error, Speed Difference" 520024 "DCU Node 3, Error, Fieldbus Memory" 520025 "DCU Node 3, status not available" 520026 "DCU Node 3, status not available" 520027 "DCU Node 3, status not available" 520028 "DCU Node 3, status not available" 520029 "DCU Node 3, status not available" 520030 "DCU Node 3, status not available" 520031 "DCU Node 3, status not available" 520032 "DCU Node 3, status not available" 520033 "DCU Node 3, status not available" 520034 "DCU Node 3, status not available" 520035 "DCU Node 3, status not available" 520036 "DCU Node 3, status not available" 520037 "DCU Node 3, status not available" 520038 "DCU Node 3, Error, Memory Size" 520039 "DCU Node 3, Error, Power Unit Software Version" 520040 "DCU Node 3, Error, FPGA Config" 520041 "DCU Node 3, status not available" 520042 "DCU Node 3, status not available" 520043 "DCU Node 3, Error, Encoder Interface Communication" 520044 "DCU Node 3, Error, Invlid Data, Power Unit" 520045 "DCU Node 3, status not available" 520046 "DCU Node 3, status not available" 520047 "DCU Node 3, status not available" 520048 "DCU Node 3, status not available" 520049 "DCU Node 3, status not available" 520050 "DCU Node 3, status not available" 520051 "DCU Node 3, status not available" 520052 "DCU Node 3, Error, Phase Undervoltage" 520053 "DCU Node 3, Error, Rotor Detection Current" 520054 "DCU Node 3, status not available" 520055 "DCU Node 3, status not available" 520056 "DCU Node 3, Error, SW Switch Left" 520057 "DCU Node 3, Error, SW Switch Right" 520058 "DCU Node 3, Error, Fieldbus Watchdog Response" 520059 "DCU Node 3, Error, Prog. Input" 520060 "DCU Node 3, status not available" 520061 "DCU Node 3, status not available" 520062 "DCU Node 3, Error, Power Unit Changed" 520063 "DCU Node 3, Error, Encoder Interface Changed" 520064 "DCU Node 3, Error, Power Unit Type Changed" 520065 "DCU Node 3, Error, Invalid Ver., Encoder Interface" 520066 "DCU Node 3, Error, Overcurrent" 520067 "DCU Node 3, Error, Max Accel/Decel Setting Exceeded" 520068 "DCU Node 3, Error, Overcurrent Brake" 520069 "DCU Node 3, Error, Power Unit" 520070 "DCU Node 3, status not available" 520071 "DCU Node 3, status not available" 520072 "DCU Node 3, status not available" 520073 "DCU Node 3, status not available" 520074 "DCU Node 3, status not available" 520075 "DCU Node 3, status not available" 520076 "DCU Node 3, status not available" 520077 "DCU Node 3, status not available" 520078 "DCU Node 3, status not available" 520079 "DCU Node 3, status not available" 520080 "DCU Node 3, status not available" 520081 "DCU Node 3, Error, Rotor Detection, Five Step" 520082 "DCU Node 3, Error, Rotor Detection, Ld equal Lq" 520083 "DCU Node 3, Error, Limit Switch Forward" 520084 "DCU Node 3, Error, Limit Switch Reverse" 520085 "DCU Node 3, Error, Limit Switch Override Forward" 520086 "DCU Node 3, Error, Limit Switch Override Reverse" 520087 "DCU Node 3, Error Limit Switch" 520088 "DCU Node 3, Error, Power Off End" 520089 "DCU Node 3, Error, Encoder Type Change" 520090 "DCU Node 3, Error, Control Board Communication" 520091 "DCU Node 3, INIT, Encoder Interface" 520092 "DCU Node 3, status not available" 520093 "DCU Node 3, status not available" 520094 "DCU Node 3, status not available" 520095 "DCU Node 3, status not available" 520096 "DCU Node 3, Error, Encoder Missing" 520097 "DCU Node 3, Error, Overspeed (EMF)" 520098 "DCU Node 3, Error, Encoder A Changed" 520099 "DCU Node 3, Error, Encoder B Changed" 520100 "DCU Node 3, Error Overcurrent, Out 01" 520101 "DCU Node 3, Error Overcurrent, Out 02" 520102 "DCU Node 3, Error Overcurrent, Out 03" 520103 "DCU Node 3, Error Overcurrent, Out 04" 520104 "DCU Node 3, Error Overcurrent, Fan" 520105 "DCU Node 3, Error Overcurrent ,Encoder" 520106 "DCU Node 3, Error Overcurrent, 24V Supply" 520107 "DCU Node 3, Error, Overfrequency" 520108 "DCU Node 3, Error Reset, Internal Overheat Control Board" 520109 "DCU Node 3, Error, Internal Overheat, Control Board" 520110 "DCU Node 3, Error, Ramp OH" 520111 "DCU Node 3, Error, Ramp OHI" 520112 "DCU Node 3, Error 24V Supply Undervoltage" 520113 "DCU Node 3, Error STO signals" 520114 "DCU Node 3, Error Ext. 24V Supply Undervoltage" 520115 "DCU Node 3, Error GTR7 Always OFF" 520116 "DCU Node 3, Error GTR7 OC" 520117 "DCU Node 3, Error GTR7 Always ON" 520118 "DCU Node 3, OC at 5V Diagnostic" 520119 "DCU Node 3, Error, Extreme Overpotential" 520120 "DCU Node 3, Error, DC Capacitor Damaged" 520121 "DCU Node 3, status not available" 520122 "DCU Node 3, status not available" 520123 "DCU Node 3, status not available" 520124 "DCU Node 3, status not available" 520125 "DCU Node 3, status not available" 520126 "DCU Node 3, status not available" 520127 "DCU Node 3, status not available" 520128 "DCU Node 3, status not available" 520129 "DCU Node 3, status not available" 520130 "DCU Node 3, status not available" 520131 "DCU Node 3, status not available" 520132 "DCU Node 3, status not available" 520133 "DCU Node 3, status not available" 520134 "DCU Node 3, status not available" 520135 "DCU Node 3, status not available" 520300 "App Node 3, No error" 520301 "App Node 3, No axis" 520302 "App Node 3, Error reading mapping" 520303 "App Node 3, Error reading rated current" 520304 "App Node 3, Error rated current mismatch" 520305 "App Node 3, Error write pll offset" 520306 "App Node 3, Error auto mapping" 520307 "App Node 3, Error interlink communication" 520308 "App Node 3, Error overload parameter" 520309 "App Node 3, Incompatible default download" 520310 "App Node 3, Error downloading default download" 520311 "App Node 3, Default download not found" 520312 "App Node 3, Error CAN data timeout" 520313 "App Node 3, Error CAN data invalid" 520314 "App Node 3, Invalid license" 520315 "App Node 3, Error reinitializing app" 520319 "App Node 3, General application error" 521000 "DCU Node 4, No Error" 521001 "DCU Node 4, status not available" 521002 "DCU Node 4, status not available" 521003 "DCU Node 4, Error, Overcurrent Power Unit" 521004 "DCU Node 4, Error, Overcurrent Analog" 521005 "DCU Node 4, Error, Overvoltage DC Link" 521006 "DCU Node 4, Error, Undervoltage DC Link" 521007 "DCU Node 4, Error, Overload" 521008 "DCU Node 4, Reset Error, Overload" 521009 "DCU Node 4, Error, Overload 02" 521010 "DCU Node 4, Error, Power Module Overheat" 521011 "DCU Node 4, Reset Error, Power Module Overheat" 521012 "DCU Node 4, Error, Internal Power Unit Overheat" 521013 "DCU Node 4, Reset Error, Internal Power Unit Overheat" 521014 "DCU Node 4, Error, Motor Protection" 521015 "DCU Node 4, Reset Error, Motor Protection" 521016 "DCU Node 4, Error, Drive Overheat" 521017 "DCU Node 4, Reset Error, Drive Overheat" 521018 "DCU Node 4, Error, Overspeed" 521019 "DCU Node 4, status not available" 521020 "DCU Node 4, Error, Drive Data" 521021 "DCU Node 4, Error, Motor Data Not Stored" 521022 "DCU Node 4, Error, Indentification" 521023 "DCU Node 4, Error, Speed Difference" 521024 "DCU Node 4, Error, Fieldbus Memory" 521025 "DCU Node 4, status not available" 521026 "DCU Node 4, status not available" 521027 "DCU Node 4, status not available" 521028 "DCU Node 4, status not available" 521029 "DCU Node 4, status not available" 521030 "DCU Node 4, status not available" 521031 "DCU Node 4, status not available" 521032 "DCU Node 4, status not available" 521033 "DCU Node 4, status not available" 521034 "DCU Node 4, status not available" 521035 "DCU Node 4, status not available" 521036 "DCU Node 4, status not available" 521037 "DCU Node 4, status not available" 521038 "DCU Node 4, Error, Memory Size" 521039 "DCU Node 4, Error, Power Unit Software Version" 521040 "DCU Node 4, Error, FPGA Config" 521041 "DCU Node 4, status not available" 521042 "DCU Node 4, status not available" 521043 "DCU Node 4, Error, Encoder Interface Communication" 521044 "DCU Node 4, Error, Invlid Data, Power Unit" 521045 "DCU Node 4, status not available" 521046 "DCU Node 4, status not available" 521047 "DCU Node 4, status not available" 521048 "DCU Node 4, status not available" 521049 "DCU Node 4, status not available" 521050 "DCU Node 4, status not available" 521051 "DCU Node 4, status not available" 521052 "DCU Node 4, Error, Phase Undervoltage" 521053 "DCU Node 4, Error, Rotor Detection Current" 521054 "DCU Node 4, status not available" 521055 "DCU Node 4, status not available" 521056 "DCU Node 4, Error, SW Switch Left" 521057 "DCU Node 4, Error, SW Switch Right" 521058 "DCU Node 4, Error, Fieldbus Watchdog Response" 521059 "DCU Node 4, Error, Prog. Input" 521060 "DCU Node 4, status not available" 521061 "DCU Node 4, status not available" 521062 "DCU Node 4, Error, Power Unit Changed" 521063 "DCU Node 4, Error, Encoder Interface Changed" 521064 "DCU Node 4, Error, Power Unit Type Changed" 521065 "DCU Node 4, Error, Invalid Ver., Encoder Interface" 521066 "DCU Node 4, Error, Overcurrent" 521067 "DCU Node 4, Error, Max Accel/Decel Setting Exceeded" 521068 "DCU Node 4, Error, Overcurrent Brake" 521069 "DCU Node 4, Error, Power Unit" 521070 "DCU Node 4, status not available" 521071 "DCU Node 4, status not available" 521072 "DCU Node 4, status not available" 521073 "DCU Node 4, status not available" 521074 "DCU Node 4, status not available" 521075 "DCU Node 4, status not available" 521076 "DCU Node 4, status not available" 521077 "DCU Node 4, status not available" 521078 "DCU Node 4, status not available" 521079 "DCU Node 4, status not available" 521080 "DCU Node 4, status not available" 521081 "DCU Node 4, Error, Rotor Detection, Five Step" 521082 "DCU Node 4, Error, Rotor Detection, Ld equal Lq" 521083 "DCU Node 4, Error, Limit Switch Forward" 521084 "DCU Node 4, Error, Limit Switch Reverse" 521085 "DCU Node 4, Error, Limit Switch Override Forward" 521086 "DCU Node 4, Error, Limit Switch Override Reverse" 521087 "DCU Node 4, Error Limit Switch" 521088 "DCU Node 4, Error, Power Off End" 521089 "DCU Node 4, Error, Encoder Type Change" 521090 "DCU Node 4, Error, Control Board Communication" 521091 "DCU Node 4, INIT, Encoder Interface" 521092 "DCU Node 4, status not available" 521093 "DCU Node 4, status not available" 521094 "DCU Node 4, status not available" 521095 "DCU Node 4, status not available" 521096 "DCU Node 4, Error, Encoder Missing" 521097 "DCU Node 4, Error, Overspeed (EMF)" 521098 "DCU Node 4, Error, Encoder A Changed" 521099 "DCU Node 4, Error, Encoder B Changed" 521100 "DCU Node 4, Error Overcurrent, Out 01" 521101 "DCU Node 4, Error Overcurrent, Out 02" 521102 "DCU Node 4, Error Overcurrent, Out 03" 521103 "DCU Node 4, Error Overcurrent, Out 04" 521104 "DCU Node 4, Error Overcurrent, Fan" 521105 "DCU Node 4, Error Overcurrent ,Encoder" 521106 "DCU Node 4, Error Overcurrent, 24V Supply" 521107 "DCU Node 4, Error, Overfrequency" 521108 "DCU Node 4, Error Reset, Internal Overheat Control Board" 521109 "DCU Node 4, Error, Internal Overheat, Control Board" 521110 "DCU Node 4, Error, Ramp OH" 521111 "DCU Node 4, Error, Ramp OHI" 521112 "DCU Node 4, Error 24V Supply Undervoltage" 521113 "DCU Node 4, Error STO signals" 521114 "DCU Node 4, Error Ext. 24V Supply Undervoltage" 521115 "DCU Node 4, Error GTR7 Always OFF" 521116 "DCU Node 4, Error GTR7 OC" 521117 "DCU Node 4, Error GTR7 Always ON" 521118 "DCU Node 4, OC at 5V Diagnostic" 521119 "DCU Node 4, Error, Extreme Overpotential" 521120 "DCU Node 4, Error, DC Capacitor Damaged" 521121 "DCU Node 4, status not available" 521122 "DCU Node 4, status not available" 521123 "DCU Node 4, status not available" 521124 "DCU Node 4, status not available" 521125 "DCU Node 4, status not available" 521126 "DCU Node 4, status not available" 521127 "DCU Node 4, status not available" 521128 "DCU Node 4, status not available" 521129 "DCU Node 4, status not available" 521130 "DCU Node 4, status not available" 521131 "DCU Node 4, status not available" 521132 "DCU Node 4, status not available" 521133 "DCU Node 4, status not available" 521134 "DCU Node 4, status not available" 521135 "DCU Node 4, status not available" 521300 "App Node 4, No error" 521301 "App Node 4, No axis" 521302 "App Node 4, Error reading mapping" 521303 "App Node 4, Error reading rated current" 521304 "App Node 4, Error rated current mismatch" 521305 "App Node 4, Error write pll offset" 521306 "App Node 4, Error auto mapping" 521307 "App Node 4, Error interlink communication" 521308 "App Node 4, Error overload parameter" 521309 "App Node 4, Incompatible default download" 521310 "App Node 4, Error downloading default download" 521311 "App Node 4, Default download not found" 521312 "App Node 4, Error CAN data timeout" 521313 "App Node 4, Error CAN data invalid" 521314 "App Node 4, Invalid license" 521315 "App Node 4, Error reinitializing app" 521319 "App Node 4, General application error" 522000 "DCU Node 5, No Error" 522001 "DCU Node 5, status not available" 522002 "DCU Node 5, status not available" 522003 "DCU Node 5, Error, Overcurrent Power Unit" 522004 "DCU Node 5, Error, Overcurrent Analog" 522005 "DCU Node 5, Error, Overvoltage DC Link" 522006 "DCU Node 5, Error, Undervoltage DC Link" 522007 "DCU Node 5, Error, Overload" 522008 "DCU Node 5, Reset Error, Overload" 522009 "DCU Node 5, Error, Overload 02" 522010 "DCU Node 5, Error, Power Module Overheat" 522011 "DCU Node 5, Reset Error, Power Module Overheat" 522012 "DCU Node 5, Error, Internal Power Unit Overheat" 522013 "DCU Node 5, Reset Error, Internal Power Unit Overheat" 522014 "DCU Node 5, Error, Motor Protection" 522015 "DCU Node 5, Reset Error, Motor Protection" 522016 "DCU Node 5, Error, Drive Overheat" 522017 "DCU Node 5, Reset Error, Drive Overheat" 522018 "DCU Node 5, Error, Overspeed" 522019 "DCU Node 5, status not available" 522020 "DCU Node 5, Error, Drive Data" 522021 "DCU Node 5, Error, Motor Data Not Stored" 522022 "DCU Node 5, Error, Indentification" 522023 "DCU Node 5, Error, Speed Difference" 522024 "DCU Node 5, Error, Fieldbus Memory" 522025 "DCU Node 5, status not available" 522026 "DCU Node 5, status not available" 522027 "DCU Node 5, status not available" 522028 "DCU Node 5, status not available" 522029 "DCU Node 5, status not available" 522030 "DCU Node 5, status not available" 522031 "DCU Node 5, status not available" 522032 "DCU Node 5, status not available" 522033 "DCU Node 5, status not available" 522034 "DCU Node 5, status not available" 522035 "DCU Node 5, status not available" 522036 "DCU Node 5, status not available" 522037 "DCU Node 5, status not available" 522038 "DCU Node 5, Error, Memory Size" 522039 "DCU Node 5, Error, Power Unit Software Version" 522040 "DCU Node 5, Error, FPGA Config" 522041 "DCU Node 5, status not available" 522042 "DCU Node 5, status not available" 522043 "DCU Node 5, Error, Encoder Interface Communication" 522044 "DCU Node 5, Error, Invlid Data, Power Unit" 522045 "DCU Node 5, status not available" 522046 "DCU Node 5, status not available" 522047 "DCU Node 5, status not available" 522048 "DCU Node 5, status not available" 522049 "DCU Node 5, status not available" 522050 "DCU Node 5, status not available" 522051 "DCU Node 5, status not available" 522052 "DCU Node 5, Error, Phase Undervoltage" 522053 "DCU Node 5, Error, Rotor Detection Current" 522054 "DCU Node 5, status not available" 522055 "DCU Node 5, status not available" 522056 "DCU Node 5, Error, SW Switch Left" 522057 "DCU Node 5, Error, SW Switch Right" 522058 "DCU Node 5, Error, Fieldbus Watchdog Response" 522059 "DCU Node 5, Error, Prog. Input" 522060 "DCU Node 5, status not available" 522061 "DCU Node 5, status not available" 522062 "DCU Node 5, Error, Power Unit Changed" 522063 "DCU Node 5, Error, Encoder Interface Changed" 522064 "DCU Node 5, Error, Power Unit Type Changed" 522065 "DCU Node 5, Error, Invalid Ver., Encoder Interface" 522066 "DCU Node 5, Error, Overcurrent" 522067 "DCU Node 5, Error, Max Accel/Decel Setting Exceeded" 522068 "DCU Node 5, Error, Overcurrent Brake" 522069 "DCU Node 5, Error, Power Unit" 522070 "DCU Node 5, status not available" 522071 "DCU Node 5, status not available" 522072 "DCU Node 5, status not available" 522073 "DCU Node 5, status not available" 522074 "DCU Node 5, status not available" 522075 "DCU Node 5, status not available" 522076 "DCU Node 5, status not available" 522077 "DCU Node 5, status not available" 522078 "DCU Node 5, status not available" 522079 "DCU Node 5, status not available" 522080 "DCU Node 5, status not available" 522081 "DCU Node 5, Error, Rotor Detection, Five Step" 522082 "DCU Node 5, Error, Rotor Detection, Ld equal Lq" 522083 "DCU Node 5, Error, Limit Switch Forward" 522084 "DCU Node 5, Error, Limit Switch Reverse" 522085 "DCU Node 5, Error, Limit Switch Override Forward" 522086 "DCU Node 5, Error, Limit Switch Override Reverse" 522087 "DCU Node 5, Error Limit Switch" 522088 "DCU Node 5, Error, Power Off End" 522089 "DCU Node 5, Error, Encoder Type Change" 522090 "DCU Node 5, Error, Control Board Communication" 522091 "DCU Node 5, INIT, Encoder Interface" 522092 "DCU Node 5, status not available" 522093 "DCU Node 5, status not available" 522094 "DCU Node 5, status not available" 522095 "DCU Node 5, status not available" 522096 "DCU Node 5, Error, Encoder Missing" 522097 "DCU Node 5, Error, Overspeed (EMF)" 522098 "DCU Node 5, Error, Encoder A Changed" 522099 "DCU Node 5, Error, Encoder B Changed" 522100 "DCU Node 5, Error Overcurrent, Out 01" 522101 "DCU Node 5, Error Overcurrent, Out 02" 522102 "DCU Node 5, Error Overcurrent, Out 03" 522103 "DCU Node 5, Error Overcurrent, Out 04" 522104 "DCU Node 5, Error Overcurrent, Fan" 522105 "DCU Node 5, Error Overcurrent ,Encoder" 522106 "DCU Node 5, Error Overcurrent, 24V Supply" 522107 "DCU Node 5, Error, Overfrequency" 522108 "DCU Node 5, Error Reset, Internal Overheat Control Board" 522109 "DCU Node 5, Error, Internal Overheat, Control Board" 522110 "DCU Node 5, Error, Ramp OH" 522111 "DCU Node 5, Error, Ramp OHI" 522112 "DCU Node 5, Error 24V Supply Undervoltage" 522113 "DCU Node 5, Error STO signals" 522114 "DCU Node 5, Error Ext. 24V Supply Undervoltage" 522115 "DCU Node 5, Error GTR7 Always OFF" 522116 "DCU Node 5, Error GTR7 OC" 522117 "DCU Node 5, Error GTR7 Always ON" 522118 "DCU Node 5, OC at 5V Diagnostic" 522119 "DCU Node 5, Error, Extreme Overpotential" 522120 "DCU Node 5, Error, DC Capacitor Damaged" 522121 "DCU Node 5, status not available" 522122 "DCU Node 5, status not available" 522123 "DCU Node 5, status not available" 522124 "DCU Node 5, status not available" 522125 "DCU Node 5, status not available" 522126 "DCU Node 5, status not available" 522127 "DCU Node 5, status not available" 522128 "DCU Node 5, status not available" 522129 "DCU Node 5, status not available" 522130 "DCU Node 5, status not available" 522131 "DCU Node 5, status not available" 522132 "DCU Node 5, status not available" 522133 "DCU Node 5, status not available" 522134 "DCU Node 5, status not available" 522135 "DCU Node 5, status not available" 522300 "App Node 5, No error" 522301 "App Node 5, No axis" 522302 "App Node 5, Error reading mapping" 522303 "App Node 5, Error reading rated current" 522304 "App Node 5, Error rated current mismatch" 522305 "App Node 5, Error write pll offset" 522306 "App Node 5, Error auto mapping" 522307 "App Node 5, Error interlink communication" 522308 "App Node 5, Error overload parameter" 522309 "App Node 5, Incompatible default download" 522310 "App Node 5, Error downloading default download" 522311 "App Node 5, Default download not found" 522312 "App Node 5, Error CAN data timeout" 522313 "App Node 5, Error CAN data invalid" 522314 "App Node 5, Invalid license" 522315 "App Node 5, Error reinitializing app" 522319 "App Node 5, General application error" 523000 "DCU Node 6, No Error" 523001 "DCU Node 6, status not available" 523002 "DCU Node 6, status not available" 523003 "DCU Node 6, Error, Overcurrent Power Unit" 523004 "DCU Node 6, Error, Overcurrent Analog" 523005 "DCU Node 6, Error, Overvoltage DC Link" 523006 "DCU Node 6, Error, Undervoltage DC Link" 523007 "DCU Node 6, Error, Overload" 523008 "DCU Node 6, Reset Error, Overload" 523009 "DCU Node 6, Error, Overload 02" 523010 "DCU Node 6, Error, Power Module Overheat" 523011 "DCU Node 6, Reset Error, Power Module Overheat" 523012 "DCU Node 6, Error, Internal Power Unit Overheat" 523013 "DCU Node 6, Reset Error, Internal Power Unit Overheat" 523014 "DCU Node 6, Error, Motor Protection" 523015 "DCU Node 6, Reset Error, Motor Protection" 523016 "DCU Node 6, Error, Drive Overheat" 523017 "DCU Node 6, Reset Error, Drive Overheat" 523018 "DCU Node 6, Error, Overspeed" 523019 "DCU Node 6, status not available" 523020 "DCU Node 6, Error, Drive Data" 523021 "DCU Node 6, Error, Motor Data Not Stored" 523022 "DCU Node 6, Error, Indentification" 523023 "DCU Node 6, Error, Speed Difference" 523024 "DCU Node 6, Error, Fieldbus Memory" 523025 "DCU Node 6, status not available" 523026 "DCU Node 6, status not available" 523027 "DCU Node 6, status not available" 523028 "DCU Node 6, status not available" 523029 "DCU Node 6, status not available" 523030 "DCU Node 6, status not available" 523031 "DCU Node 6, status not available" 523032 "DCU Node 6, status not available" 523033 "DCU Node 6, status not available" 523034 "DCU Node 6, status not available" 523035 "DCU Node 6, status not available" 523036 "DCU Node 6, status not available" 523037 "DCU Node 6, status not available" 523038 "DCU Node 6, Error, Memory Size" 523039 "DCU Node 6, Error, Power Unit Software Version" 523040 "DCU Node 6, Error, FPGA Config" 523041 "DCU Node 6, status not available" 523042 "DCU Node 6, status not available" 523043 "DCU Node 6, Error, Encoder Interface Communication" 523044 "DCU Node 6, Error, Invlid Data, Power Unit" 523045 "DCU Node 6, status not available" 523046 "DCU Node 6, status not available" 523047 "DCU Node 6, status not available" 523048 "DCU Node 6, status not available" 523049 "DCU Node 6, status not available" 523050 "DCU Node 6, status not available" 523051 "DCU Node 6, status not available" 523052 "DCU Node 6, Error, Phase Undervoltage" 523053 "DCU Node 6, Error, Rotor Detection Current" 523054 "DCU Node 6, status not available" 523055 "DCU Node 6, status not available" 523056 "DCU Node 6, Error, SW Switch Left" 523057 "DCU Node 6, Error, SW Switch Right" 523058 "DCU Node 6, Error, Fieldbus Watchdog Response" 523059 "DCU Node 6, Error, Prog. Input" 523060 "DCU Node 6, status not available" 523061 "DCU Node 6, status not available" 523062 "DCU Node 6, Error, Power Unit Changed" 523063 "DCU Node 6, Error, Encoder Interface Changed" 523064 "DCU Node 6, Error, Power Unit Type Changed" 523065 "DCU Node 6, Error, Invalid Ver., Encoder Interface" 523066 "DCU Node 6, Error, Overcurrent" 523067 "DCU Node 6, Error, Max Accel/Decel Setting Exceeded" 523068 "DCU Node 6, Error, Overcurrent Brake" 523069 "DCU Node 6, Error, Power Unit" 523070 "DCU Node 6, status not available" 523071 "DCU Node 6, status not available" 523072 "DCU Node 6, status not available" 523073 "DCU Node 6, status not available" 523074 "DCU Node 6, status not available" 523075 "DCU Node 6, status not available" 523076 "DCU Node 6, status not available" 523077 "DCU Node 6, status not available" 523078 "DCU Node 6, status not available" 523079 "DCU Node 6, status not available" 523080 "DCU Node 6, status not available" 523081 "DCU Node 6, Error, Rotor Detection, Five Step" 523082 "DCU Node 6, Error, Rotor Detection, Ld equal Lq" 523083 "DCU Node 6, Error, Limit Switch Forward" 523084 "DCU Node 6, Error, Limit Switch Reverse" 523085 "DCU Node 6, Error, Limit Switch Override Forward" 523086 "DCU Node 6, Error, Limit Switch Override Reverse" 523087 "DCU Node 6, Error Limit Switch" 523088 "DCU Node 6, Error, Power Off End" 523089 "DCU Node 6, Error, Encoder Type Change" 523090 "DCU Node 6, Error, Control Board Communication" 523091 "DCU Node 6, INIT, Encoder Interface" 523092 "DCU Node 6, status not available" 523093 "DCU Node 6, status not available" 523094 "DCU Node 6, status not available" 523095 "DCU Node 6, status not available" 523096 "DCU Node 6, Error, Encoder Missing" 523097 "DCU Node 6, Error, Overspeed (EMF)" 523098 "DCU Node 6, Error, Encoder A Changed" 523099 "DCU Node 6, Error, Encoder B Changed" 523100 "DCU Node 6, Error Overcurrent, Out 01" 523101 "DCU Node 6, Error Overcurrent, Out 02" 523102 "DCU Node 6, Error Overcurrent, Out 03" 523103 "DCU Node 6, Error Overcurrent, Out 04" 523104 "DCU Node 6, Error Overcurrent, Fan" 523105 "DCU Node 6, Error Overcurrent ,Encoder" 523106 "DCU Node 6, Error Overcurrent, 24V Supply" 523107 "DCU Node 6, Error, Overfrequency" 523108 "DCU Node 6, Error Reset, Internal Overheat Control Board" 523109 "DCU Node 6, Error, Internal Overheat, Control Board" 523110 "DCU Node 6, Error, Ramp OH" 523111 "DCU Node 6, Error, Ramp OHI" 523112 "DCU Node 6, Error 24V Supply Undervoltage" 523113 "DCU Node 6, Error STO signals" 523114 "DCU Node 6, Error Ext. 24V Supply Undervoltage" 523115 "DCU Node 6, Error GTR7 Always OFF" 523116 "DCU Node 6, Error GTR7 OC" 523117 "DCU Node 6, Error GTR7 Always ON" 523118 "DCU Node 6, OC at 5V Diagnostic" 523119 "DCU Node 6, Error, Extreme Overpotential" 523120 "DCU Node 6, Error, DC Capacitor Damaged" 523121 "DCU Node 6, status not available" 523122 "DCU Node 6, status not available" 523123 "DCU Node 6, status not available" 523124 "DCU Node 6, status not available" 523125 "DCU Node 6, status not available" 523126 "DCU Node 6, status not available" 523127 "DCU Node 6, status not available" 523128 "DCU Node 6, status not available" 523129 "DCU Node 6, status not available" 523130 "DCU Node 6, status not available" 523131 "DCU Node 6, status not available" 523132 "DCU Node 6, status not available" 523133 "DCU Node 6, status not available" 523134 "DCU Node 6, status not available" 523135 "DCU Node 6, status not available" 523300 "App Node 6, No error" 523301 "App Node 6, No axis" 523302 "App Node 6, Error reading mapping" 523303 "App Node 6, Error reading rated current" 523304 "App Node 6, Error rated current mismatch" 523305 "App Node 6, Error write pll offset" 523306 "App Node 6, Error auto mapping" 523307 "App Node 6, Error interlink communication" 523308 "App Node 6, Error overload parameter" 523309 "App Node 6, Incompatible default download" 523310 "App Node 6, Error downloading default download" 523311 "App Node 6, Default download not found" 523312 "App Node 6, Error CAN data timeout" 523313 "App Node 6, Error CAN data invalid" 523314 "App Node 6, Invalid license" 523315 "App Node 6, Error reinitializing app" 523319 "App Node 6, General application error" ;
VAL_ 2566834768 SPN_DTC5 0 "No Error" 517290 "MCU Node 0, No Error" 517291 "MCU Node 0, No configuration file found" 517292 "MCU Node 0, Invalid J1939 license" 517293 "MCU Node 0, Error downloading configuration file" 517294 "MCU Node 0, Overload protection active" 517295 "MCU Node 0, Invalid app selection" 517296 "MCU Node 0, Overload warning active" 518000 "DCU Node 1, No Error" 518001 "DCU Node 1, status not available" 518002 "DCU Node 1, status not available" 518003 "DCU Node 1, Error, Overcurrent Power Unit" 518004 "DCU Node 1, Error, Overcurrent Analog" 518005 "DCU Node 1, Error, Overvoltage DC Link" 518006 "DCU Node 1, Error, Undervoltage DC Link" 518007 "DCU Node 1, Error, Overload" 518008 "DCU Node 1, Reset Error, Overload" 518009 "DCU Node 1, Error, Overload 02" 518010 "DCU Node 1, Error, Power Module Overheat" 518011 "DCU Node 1, Reset Error, Power Module Overheat" 518012 "DCU Node 1, Error, Internal Power Unit Overheat" 518013 "DCU Node 1, Reset Error, Internal Power Unit Overheat" 518014 "DCU Node 1, Error, Motor Protection" 518015 "DCU Node 1, Reset Error, Motor Protection" 518016 "DCU Node 1, Error, Drive Overheat" 518017 "DCU Node 1, Reset Error, Drive Overheat" 518018 "DCU Node 1, Error, Overspeed" 518019 "DCU Node 1, status not available" 518020 "DCU Node 1, Error, Drive Data" 518021 "DCU Node 1, Error, Motor Data Not Stored" 518022 "DCU Node 1, Error, Indentification" 518023 "DCU Node 1, Error, Speed Difference" 518024 "DCU Node 1, Error, Fieldbus Memory" 518025 "DCU Node 1, status not available" 518026 "DCU Node 1, status not available" 518027 "DCU Node 1, status not available" 518028 "DCU Node 1, status not available" 518029 "DCU Node 1, status not available" 518030 "DCU Node 1, status not available" 518031 "DCU Node 1, status not available" 518032 "DCU Node 1, status not available" 518033 "DCU Node 1, status not available" 518034 "DCU Node 1, status not available" 518035 "DCU Node 1, status not available" 518036 "DCU Node 1, status not available" 518037 "DCU Node 1, status not available" 518038 "DCU Node 1, Error, Memory Size" 518039 "DCU Node 1, Error, Power Unit Software Version" 518040 "DCU Node 1, Error, FPGA Config" 518041 "DCU Node 1, status not available" 518042 "DCU Node 1, status not available" 518043 "DCU Node 1, Error, Encoder Interface Communication" 518044 "DCU Node 1, Error, Invlid Data, Power Unit" 518045 "DCU Node 1, status not available" 518046 "DCU Node 1, status not available" 518047 "DCU Node 1, status not available" 518048 "DCU Node 1, status not available" 518049 "DCU Node 1, status not available" 518050 "DCU Node 1, status not available" 518051 "DCU Node 1, status not available" 518052 "DCU Node 1, Error, Phase Undervoltage" 518053 "DCU Node 1, Error, Rotor Detection Current" 518054 "DCU Node 1, status not available" 518055 "DCU Node 1, status not available" 518056 "DCU Node 1, Error, SW Switch Left" 518057 "DCU Node 1, Error, SW Switch Right" 518058 "DCU Node 1, Error, Fieldbus Watchdog Response" 518059 "DCU Node 1, Error, Prog. Input" 518060 "DCU Node 1, status not available" 518061 "DCU Node 1, status not available" 518062 "DCU Node 1, Error, Power Unit Changed" 518063 "DCU Node 1, Error, Encoder Interface Changed" 518064 "DCU Node 1, Error, Power Unit Type Changed" 518065 "DCU Node 1, Error, Invalid Ver., Encoder Interface" 518066 "DCU Node 1, Error, Overcurrent" 518067 "DCU Node 1, Error, Max Accel/Decel Setting Exceeded" 518068 "DCU Node 1, Error, Overcurrent Brake" 518069 "DCU Node 1, Error, Power Unit" 518070 "DCU Node 1, status not available" 518071 "DCU Node 1, status not available" 518072 "DCU Node 1, status not available" 518073 "DCU Node 1, status not available" 518074 "DCU Node 1, status not available" 518075 "DCU Node 1, status not available" 518076 "DCU Node 1, status not available" 518077 "DCU Node 1, status not available" 518078 "DCU Node 1, status not available" 518079 "DCU Node 1, status not available" 518080 "DCU Node 1, status not available" 518081 "DCU Node 1, Error, Rotor Detection, Five Step" 518082 "DCU Node 1, Error, Rotor Detection, Ld equal Lq" 518083 "DCU Node 1, Error, Limit Switch Forward" 518084 "DCU Node 1, Error, Limit Switch Reverse" 518085 "DCU Node 1, Error, Limit Switch Override Forward" 518086 "DCU Node 1, Error, Limit Switch Override Reverse" 518087 "DCU Node 1, Error Limit Switch" 518088 "DCU Node 1, Error, Power Off End" 518089 "DCU Node 1, Error, Encoder Type Change" 518090 "DCU Node 1, Error, Control Board Communication" 518091 "DCU Node 1, INIT, Encoder Interface" 518092 "DCU Node 1, status not available" 518093 "DCU Node 1, status not available" 518094 "DCU Node 1, status not available" 518095 "DCU Node 1, status not available" 518096 "DCU Node 1, Error, Encoder Missing" 518097 "DCU Node 1, Error, Overspeed (EMF)" 518098 "DCU Node 1, Error, Encoder A Changed" 518099 "DCU Node 1, Error, Encoder B Changed" 518100 "DCU Node 1, Error Overcurrent, Out 01" 518101 "DCU Node 1, Error Overcurrent, Out 02" 518102 "DCU Node 1, Error Overcurrent, Out 03" 518103 "DCU Node 1, Error Overcurrent, Out 04" 518104 "DCU Node 1, Error Overcurrent, Fan" 518105 "DCU Node 1, Error Overcurrent ,Encoder" 518106 "DCU Node 1, Error Overcurrent, 24V Supply" 518107 "DCU Node 1, Error, Overfrequency" 518108 "DCU Node 1, Error Reset, Internal Overheat Control Board" 518109 "DCU Node 1, Error, Internal Overheat, Control Board" 518110 "DCU Node 1, Error, Ramp OH" 518111 "DCU Node 1, Error, Ramp OHI" 518112 "DCU Node 1, Error 24V Supply Undervoltage" 518113 "DCU Node 1, Error STO signals" 518114 "DCU Node 1, Error Ext. 24V Supply Undervoltage" 518115 "DCU Node 1, Error GTR7 Always OFF" 518116 "DCU Node 1, Error GTR7 OC" 518117 "DCU Node 1, Error GTR7 Always ON" 518118 "DCU Node 1, OC at 5V Diagnostic" 518119 "DCU Node 1, Error, Extreme Overpotential" 518120 "DCU Node 1, Error, DC Capacitor Damaged" 518121 "DCU Node 1, status not available" 518122 "DCU Node 1, status not available" 518123 "DCU Node 1, status not available" 518124 "DCU Node 1, status not available" 518125 "DCU Node 1, status not available" 518126 "DCU Node 1, status not available" 518127 "DCU Node 1, status not available" 518128 "DCU Node 1, status not available" 518129 "DCU Node 1, status not available" 518130 "DCU Node 1, status not available" 518131 "DCU Node 1, status not available" 518132 "DCU Node 1, status not available" 518133 "DCU Node 1, status not available" 518134 "DCU Node 1, status not available" 518135 "DCU Node 1, status not available" 518300 "App Node 1, No error" 518301 "App Node 1, No axis" 518302 "App Node 1, Error reading mapping" 518303 "App Node 1, Error reading rated current" 518304 "App Node 1, Error rated current mismatch" 518305 "App Node 1, Error write pll offset" 518306 "App Node 1, Error auto mapping" 518307 "App Node 1, Error interlink communication" 518308 "App Node 1, Error overload parameter" 518309 "App Node 1, Incompatible default download" 518310 "App Node 1, Error downloading default download" 518311 "App Node 1, Default download not found" 518312 "App Node 1, Error CAN data timeout" 518313 "App Node 1, Error CAN data invalid" 518314 "App Node 1, Invalid license" 518315 "App Node 1, Error reinitializing app" 518319 "App Node 1, General application error" 519000 "DCU Node 2, No Error" 519001 "DCU Node 2, status not available" 519002 "DCU Node 2, status not available" 519003 "DCU Node 2, Error, Overcurrent Power Unit" 519004 "DCU Node 2, Error, Overcurrent Analog" 519005 "DCU Node 2, Error, Overvoltage DC Link" 519006 "DCU Node 2, Error, Undervoltage DC Link" 519007 "DCU Node 2, Error, Overload" 519008 "DCU Node 2, Reset Error, Overload" 519009 "DCU Node 2, Error, Overload 02" 519010 "DCU Node 2, Error, Power Module Overheat" 519011 "DCU Node 2, Reset Error, Power Module Overheat" 519012 "DCU Node 2, Error, Internal Power Unit Overheat" 519013 "DCU Node 2, Reset Error, Internal Power Unit Overheat" 519014 "DCU Node 2, Error, Motor Protection" 519015 "DCU Node 2, Reset Error, Motor Protection" 519016 "DCU Node 2, Error, Drive Overheat" 519017 "DCU Node 2, Reset Error, Drive Overheat" 519018 "DCU Node 2, Error, Overspeed" 519019 "DCU Node 2, status not available" 519020 "DCU Node 2, Error, Drive Data" 519021 "DCU Node 2, Error, Motor Data Not Stored" 519022 "DCU Node 2, Error, Indentification" 519023 "DCU Node 2, Error, Speed Difference" 519024 "DCU Node 2, Error, Fieldbus Memory" 519025 "DCU Node 2, status not available" 519026 "DCU Node 2, status not available" 519027 "DCU Node 2, status not available" 519028 "DCU Node 2, status not available" 519029 "DCU Node 2, status not available" 519030 "DCU Node 2, status not available" 519031 "DCU Node 2, status not available" 519032 "DCU Node 2, status not available" 519033 "DCU Node 2, status not available" 519034 "DCU Node 2, status not available" 519035 "DCU Node 2, status not available" 519036 "DCU Node 2, status not available" 519037 "DCU Node 2, status not available" 519038 "DCU Node 2, Error, Memory Size" 519039 "DCU Node 2, Error, Power Unit Software Version" 519040 "DCU Node 2, Error, FPGA Config" 519041 "DCU Node 2, status not available" 519042 "DCU Node 2, status not available" 519043 "DCU Node 2, Error, Encoder Interface Communication" 519044 "DCU Node 2, Error, Invlid Data, Power Unit" 519045 "DCU Node 2, status not available" 519046 "DCU Node 2, status not available" 519047 "DCU Node 2, status not available" 519048 "DCU Node 2, status not available" 519049 "DCU Node 2, status not available" 519050 "DCU Node 2, status not available" 519051 "DCU Node 2, status not available" 519052 "DCU Node 2, Error, Phase Undervoltage" 519053 "DCU Node 2, Error, Rotor Detection Current" 519054 "DCU Node 2, status not available" 519055 "DCU Node 2, status not available" 519056 "DCU Node 2, Error, SW Switch Left" 519057 "DCU Node 2, Error, SW Switch Right" 519058 "DCU Node 2, Error, Fieldbus Watchdog Response" 519059 "DCU Node 2, Error, Prog. Input" 519060 "DCU Node 2, status not available" 519061 "DCU Node 2, status not available" 519062 "DCU Node 2, Error, Power Unit Changed" 519063 "DCU Node 2, Error, Encoder Interface Changed" 519064 "DCU Node 2, Error, Power Unit Type Changed" 519065 "DCU Node 2, Error, Invalid Ver., Encoder Interface" 519066 "DCU Node 2, Error, Overcurrent" 519067 "DCU Node 2, Error, Max Accel/Decel Setting Exceeded" 519068 "DCU Node 2, Error, Overcurrent Brake" 519069 "DCU Node 2, Error, Power Unit" 519070 "DCU Node 2, status not available" 519071 "DCU Node 2, status not available" 519072 "DCU Node 2, status not available" 519073 "DCU Node 2, status not available" 519074 "DCU Node 2, status not available" 519075 "DCU Node 2, status not available" 519076 "DCU Node 2, status not available" 519077 "DCU Node 2, status not available" 519078 "DCU Node 2, status not available" 519079 "DCU Node 2, status not available" 519080 "DCU Node 2, status not available" 519081 "DCU Node 2, Error, Rotor Detection, Five Step" 519082 "DCU Node 2, Error, Rotor Detection, Ld equal Lq" 519083 "DCU Node 2, Error, Limit Switch Forward" 519084 "DCU Node 2, Error, Limit Switch Reverse" 519085 "DCU Node 2, Error, Limit Switch Override Forward" 519086 "DCU Node 2, Error, Limit Switch Override Reverse" 519087 "DCU Node 2, Error Limit Switch" 519088 "DCU Node 2, Error, Power Off End" 519089 "DCU Node 2, Error, Encoder Type Change" 519090 "DCU Node 2, Error, Control Board Communication" 519091 "DCU Node 2, INIT, Encoder Interface" 519092 "DCU Node 2, status not available" 519093 "DCU Node 2, status not available" 519094 "DCU Node 2, status not available" 519095 "DCU Node 2, status not available" 519096 "DCU Node 2, Error, Encoder Missing" 519097 "DCU Node 2, Error, Overspeed (EMF)" 519098 "DCU Node 2, Error, Encoder A Changed" 519099 "DCU Node 2, Error, Encoder B Changed" 519100 "DCU Node 2, Error Overcurrent, Out 01" 519101 "DCU Node 2, Error Overcurrent, Out 02" 519102 "DCU Node 2, Error Overcurrent, Out 03" 519103 "DCU Node 2, Error Overcurrent, Out 04" 519104 "DCU Node 2, Error Overcurrent, Fan" 519105 "DCU Node 2, Error Overcurrent ,Encoder" 519106 "DCU Node 2, Error Overcurrent, 24V Supply" 519107 "DCU Node 2, Error, Overfrequency" 519108 "DCU Node 2, Error Reset, Internal Overheat Control Board" 519109 "DCU Node 2, Error, Internal Overheat, Control Board" 519110 "DCU Node 2, Error, Ramp OH" 519111 "DCU Node 2, Error, Ramp OHI" 519112 "DCU Node 2, Error 24V Supply Undervoltage" 519113 "DCU Node 2, Error STO signals" 519114 "DCU Node 2, Error Ext. 24V Supply Undervoltage" 519115 "DCU Node 2, Error GTR7 Always OFF" 519116 "DCU Node 2, Error GTR7 OC" 519117 "DCU Node 2, Error GTR7 Always ON" 519118 "DCU Node 2, OC at 5V Diagnostic" 519119 "DCU Node 2, Error, Extreme Overpotential" 519120 "DCU Node 2, Error, DC Capacitor Damaged" 519121 "DCU Node 2, status not available" 519122 "DCU Node 2, status not available" 519123 "DCU Node 2, status not available" 519124 "DCU Node 2, status not available" 519125 "DCU Node 2, status not available" 519126 "DCU Node 2, status not available" 519127 "DCU Node 2, status not available" 519128 "DCU Node 2, status not available" 519129 "DCU Node 2, status not available" 519130 "DCU Node 2, status not available" 519131 "DCU Node 2, status not available" 519132 "DCU Node 2, status not available" 519133 "DCU Node 2, status not available" 519134 "DCU Node 2, status not available" 519135 "DCU Node 2, status not available" 519300 "App Node 2, No error" 519301 "App Node 2, No axis" 519302 "App Node 2, Error reading mapping" 519303 "App Node 2, Error reading rated current" 519304 "App Node 2, Error rated current mismatch" 519305 "App Node 2, Error write pll offset" 519306 "App Node 2, Error auto mapping" 519307 "App Node 2, Error interlink communication" 519308 "App Node 2, Error overload parameter" 519309 "App Node 2, Incompatible default download" 519310 "App Node 2, Error downloading default download" 519311 "App Node 2, Default download not found" 519312 "App Node 2, Error CAN data timeout" 519313 "App Node 2, Error CAN data invalid" 519314 "App Node 2, Invalid license" 519315 "App Node 2, Error reinitializing app" 519319 "App Node 2, General application error" 520000 "DCU Node 3, No Error" 520001 "DCU Node 3, status not available" 520002 "DCU Node 3, status not available" 520003 "DCU Node 3, Error, Overcurrent Power Unit" 520004 "DCU Node 3, Error, Overcurrent Analog" 520005 "DCU Node 3, Error, Overvoltage DC Link" 520006 "DCU Node 3, Error, Undervoltage DC Link" 520007 "DCU Node 3, Error, Overload" 520008 "DCU Node 3, Reset Error, Overload" 520009 "DCU Node 3, Error, Overload 02" 520010 "DCU Node 3, Error, Power Module Overheat" 520011 "DCU Node 3, Reset Error, Power Module Overheat" 520012 "DCU Node 3, Error, Internal Power Unit Overheat" 520013 "DCU Node 3, Reset Error, Internal Power Unit Overheat" 520014 "DCU Node 3, Error, Motor Protection" 520015 "DCU Node 3, Reset Error, Motor Protection" 520016 "DCU Node 3, Error, Drive Overheat" 520017 "DCU Node 3, Reset Error, Drive Overheat" 520018 "DCU Node 3, Error, Overspeed" 520019 "DCU Node 3, status not available" 520020 "DCU Node 3, Error, Drive Data" 520021 "DCU Node 3, Error, Motor Data Not Stored" 520022 "DCU Node 3, Error, Indentification" 520023 "DCU Node 3, Error, Speed Difference" 520024 "DCU Node 3, Error, Fieldbus Memory" 520025 "DCU Node 3, status not available" 520026 "DCU Node 3, status not available" 520027 "DCU Node 3, status not available" 520028 "DCU Node 3, status not available" 520029 "DCU Node 3, status not available" 520030 "DCU Node 3, status not available" 520031 "DCU Node 3, status not available" 520032 "DCU Node 3, status not available" 520033 "DCU Node 3, status not available" 520034 "DCU Node 3, status not available" 520035 "DCU Node 3, status not available" 520036 "DCU Node 3, status not available" 520037 "DCU Node 3, status not available" 520038 "DCU Node 3, Error, Memory Size" 520039 "DCU Node 3, Error, Power Unit Software Version" 520040 "DCU Node 3, Error, FPGA Config" 520041 "DCU Node 3, status not available" 520042 "DCU Node 3, status not available" 520043 "DCU Node 3, Error, Encoder Interface Communication" 520044 "DCU Node 3, Error, Invlid Data, Power Unit" 520045 "DCU Node 3, status not available" 520046 "DCU Node 3, status not available" 520047 "DCU Node 3, status not available" 520048 "DCU Node 3, status not available" 520049 "DCU Node 3, status not available" 520050 "DCU Node 3, status not available" 520051 "DCU Node 3, status not available" 520052 "DCU Node 3, Error, Phase Undervoltage" 520053 "DCU Node 3, Error, Rotor Detection Current" 520054 "DCU Node 3, status not available" 520055 "DCU Node 3, status not available" 520056 "DCU Node 3, Error, SW Switch Left" 520057 "DCU Node 3, Error, SW Switch Right" 520058 "DCU Node 3, Error, Fieldbus Watchdog Response" 520059 "DCU Node 3, Error, Prog. Input" 520060 "DCU Node 3, status not available" 520061 "DCU Node 3, status not available" 520062 "DCU Node 3, Error, Power Unit Changed" 520063 "DCU Node 3, Error, Encoder Interface Changed" 520064 "DCU Node 3, Error, Power Unit Type Changed" 520065 "DCU Node 3, Error, Invalid Ver., Encoder Interface" 520066 "DCU Node 3, Error, Overcurrent" 520067 "DCU Node 3, Error, Max Accel/Decel Setting Exceeded" 520068 "DCU Node 3, Error, Overcurrent Brake" 520069 "DCU Node 3, Error, Power Unit" 520070 "DCU Node 3, status not available" 520071 "DCU Node 3, status not available" 520072 "DCU Node 3, status not available" 520073 "DCU Node 3, status not available" 520074 "DCU Node 3, status not available" 520075 "DCU Node 3, status not available" 520076 "DCU Node 3, status not available" 520077 "DCU Node 3, status not available" 520078 "DCU Node 3, status not available" 520079 "DCU Node 3, status not available" 520080 "DCU Node 3, status not available" 520081 "DCU Node 3, Error, Rotor Detection, Five Step" 520082 "DCU Node 3, Error, Rotor Detection, Ld equal Lq" 520083 "DCU Node 3, Error, Limit Switch Forward" 520084 "DCU Node 3, Error, Limit Switch Reverse" 520085 "DCU Node 3, Error, Limit Switch Override Forward" 520086 "DCU Node 3, Error, Limit Switch Override Reverse" 520087 "DCU Node 3, Error Limit Switch" 520088 "DCU Node 3, Error, Power Off End" 520089 "DCU Node 3, Error, Encoder Type Change" 520090 "DCU Node 3, Error, Control Board Communication" 520091 "DCU Node 3, INIT, Encoder Interface" 520092 "DCU Node 3, status not available" 520093 "DCU Node 3, status not available" 520094 "DCU Node 3, status not available" 520095 "DCU Node 3, status not available" 520096 "DCU Node 3, Error, Encoder Missing" 520097 "DCU Node 3, Error, Overspeed (EMF)" 520098 "DCU Node 3, Error, Encoder A Changed" 520099 "DCU Node 3, Error, Encoder B Changed" 520100 "DCU Node 3, Error Overcurrent, Out 01" 520101 "DCU Node 3, Error Overcurrent, Out 02" 520102 "DCU Node 3, Error Overcurrent, Out 03" 520103 "DCU Node 3, Error Overcurrent, Out 04" 520104 "DCU Node 3, Error Overcurrent, Fan" 520105 "DCU Node 3, Error Overcurrent ,Encoder" 520106 "DCU Node 3, Error Overcurrent, 24V Supply" 520107 "DCU Node 3, Error, Overfrequency" 520108 "DCU Node 3, Error Reset, Internal Overheat Control Board" 520109 "DCU Node 3, Error, Internal Overheat, Control Board" 520110 "DCU Node 3, Error, Ramp OH" 520111 "DCU Node 3, Error, Ramp OHI" 520112 "DCU Node 3, Error 24V Supply Undervoltage" 520113 "DCU Node 3, Error STO signals" 520114 "DCU Node 3, Error Ext. 24V Supply Undervoltage" 520115 "DCU Node 3, Error GTR7 Always OFF" 520116 "DCU Node 3, Error GTR7 OC" 520117 "DCU Node 3, Error GTR7 Always ON" 520118 "DCU Node 3, OC at 5V Diagnostic" 520119 "DCU Node 3, Error, Extreme Overpotential" 520120 "DCU Node 3, Error, DC Capacitor Damaged" 520121 "DCU Node 3, status not available" 520122 "DCU Node 3, status not available" 520123 "DCU Node 3, status not available" 520124 "DCU Node 3, status not available" 520125 "DCU Node 3, status not available" 520126 "DCU Node 3, status not available" 520127 "DCU Node 3, status not available" 520128 "DCU Node 3, status not available" 520129 "DCU Node 3, status not available" 520130 "DCU Node 3, status not available" 520131 "DCU Node 3, status not available" 520132 "DCU Node 3, status not available" 520133 "DCU Node 3, status not available" 520134 "DCU Node 3, status not available" 520135 "DCU Node 3, status not available" 520300 "App Node 3, No error" 520301 "App Node 3, No axis" 520302 "App Node 3, Error reading mapping" 520303 "App Node 3, Error reading rated current" 520304 "App Node 3, Error rated current mismatch" 520305 "App Node 3, Error write pll offset" 520306 "App Node 3, Error auto mapping" 520307 "App Node 3, Error interlink communication" 520308 "App Node 3, Error overload parameter" 520309 "App Node 3, Incompatible default download" 520310 "App Node 3, Error downloading default download" 520311 "App Node 3, Default download not found" 520312 "App Node 3, Error CAN data timeout" 520313 "App Node 3, Error CAN data invalid" 520314 "App Node 3, Invalid license" 520315 "App Node 3, Error reinitializing app" 520319 "App Node 3, General application error" 521000 "DCU Node 4, No Error" 521001 "DCU Node 4, status not available" 521002 "DCU Node 4, status not available" 521003 "DCU Node 4, Error, Overcurrent Power Unit" 521004 "DCU Node 4, Error, Overcurrent Analog" 521005 "DCU Node 4, Error, Overvoltage DC Link" 521006 "DCU Node 4, Error, Undervoltage DC Link" 521007 "DCU Node 4, Error, Overload" 521008 "DCU Node 4, Reset Error, Overload" 521009 "DCU Node 4, Error, Overload 02" 521010 "DCU Node 4, Error, Power Module Overheat" 521011 "DCU Node 4, Reset Error, Power Module Overheat" 521012 "DCU Node 4, Error, Internal Power Unit Overheat" 521013 "DCU Node 4, Reset Error, Internal Power Unit Overheat" 521014 "DCU Node 4, Error, Motor Protection" 521015 "DCU Node 4, Reset Error, Motor Protection" 521016 "DCU Node 4, Error, Drive Overheat" 521017 "DCU Node 4, Reset Error, Drive Overheat" 521018 "DCU Node 4, Error, Overspeed" 521019 "DCU Node 4, status not available" 521020 "DCU Node 4, Error, Drive Data" 521021 "DCU Node 4, Error, Motor Data Not Stored" 521022 "DCU Node 4, Error, Indentification" 521023 "DCU Node 4, Error, Speed Difference" 521024 "DCU Node 4, Error, Fieldbus Memory" 521025 "DCU Node 4, status not available" 521026 "DCU Node 4, status not available" 521027 "DCU Node 4, status not available" 521028 "DCU Node 4, status not available" 521029 "DCU Node 4, status not available" 521030 "DCU Node 4, status not available" 521031 "DCU Node 4, status not available" 521032 "DCU Node 4, status not available" 521033 "DCU Node 4, status not available" 521034 "DCU Node 4, status not available" 521035 "DCU Node 4, status not available" 521036 "DCU Node 4, status not available" 521037 "DCU Node 4, status not available" 521038 "DCU Node 4, Error, Memory Size" 521039 "DCU Node 4, Error, Power Unit Software Version" 521040 "DCU Node 4, Error, FPGA Config" 521041 "DCU Node 4, status not available" 521042 "DCU Node 4, status not available" 521043 "DCU Node 4, Error, Encoder Interface Communication" 521044 "DCU Node 4, Error, Invlid Data, Power Unit" 521045 "DCU Node 4, status not available" 521046 "DCU Node 4, status not available" 521047 "DCU Node 4, status not available" 521048 "DCU Node 4, status not available" 521049 "DCU Node 4, status not available" 521050 "DCU Node 4, status not available" 521051 "DCU Node 4, status not available" 521052 "DCU Node 4, Error, Phase Undervoltage" 521053 "DCU Node 4, Error, Rotor Detection Current" 521054 "DCU Node 4, status not available" 521055 "DCU Node 4, status not available" 521056 "DCU Node 4, Error, SW Switch Left" 521057 "DCU Node 4, Error, SW Switch Right" 521058 "DCU Node 4, Error, Fieldbus Watchdog Response" 521059 "DCU Node 4, Error, Prog. Input" 521060 "DCU Node 4, status not available" 521061 "DCU Node 4, status not available" 521062 "DCU Node 4, Error, Power Unit Changed" 521063 "DCU Node 4, Error, Encoder Interface Changed" 521064 "DCU Node 4, Error, Power Unit Type Changed" 521065 "DCU Node 4, Error, Invalid Ver., Encoder Interface" 521066 "DCU Node 4, Error, Overcurrent" 521067 "DCU Node 4, Error, Max Accel/Decel Setting Exceeded" 521068 "DCU Node 4, Error, Overcurrent Brake" 521069 "DCU Node 4, Error, Power Unit" 521070 "DCU Node 4, status not available" 521071 "DCU Node 4, status not available" 521072 "DCU Node 4, status not available" 521073 "DCU Node 4, status not available" 521074 "DCU Node 4, status not available" 521075 "DCU Node 4, status not available" 521076 "DCU Node 4, status not available" 521077 "DCU Node 4, status not available" 521078 "DCU Node 4, status not available" 521079 "DCU Node 4, status not available" 521080 "DCU Node 4, status not available" 521081 "DCU Node 4, Error, Rotor Detection, Five Step" 521082 "DCU Node 4, Error, Rotor Detection, Ld equal Lq" 521083 "DCU Node 4, Error, Limit Switch Forward" 521084 "DCU Node 4, Error, Limit Switch Reverse" 521085 "DCU Node 4, Error, Limit Switch Override Forward" 521086 "DCU Node 4, Error, Limit Switch Override Reverse" 521087 "DCU Node 4, Error Limit Switch" 521088 "DCU Node 4, Error, Power Off End" 521089 "DCU Node 4, Error, Encoder Type Change" 521090 "DCU Node 4, Error, Control Board Communication" 521091 "DCU Node 4, INIT, Encoder Interface" 521092 "DCU Node 4, status not available" 521093 "DCU Node 4, status not available" 521094 "DCU Node 4, status not available" 521095 "DCU Node 4, status not available" 521096 "DCU Node 4, Error, Encoder Missing" 521097 "DCU Node 4, Error, Overspeed (EMF)" 521098 "DCU Node 4, Error, Encoder A Changed" 521099 "DCU Node 4, Error, Encoder B Changed" 521100 "DCU Node 4, Error Overcurrent, Out 01" 521101 "DCU Node 4, Error Overcurrent, Out 02" 521102 "DCU Node 4, Error Overcurrent, Out 03" 521103 "DCU Node 4, Error Overcurrent, Out 04" 521104 "DCU Node 4, Error Overcurrent, Fan" 521105 "DCU Node 4, Error Overcurrent ,Encoder" 521106 "DCU Node 4, Error Overcurrent, 24V Supply" 521107 "DCU Node 4, Error, Overfrequency" 521108 "DCU Node 4, Error Reset, Internal Overheat Control Board" 521109 "DCU Node 4, Error, Internal Overheat, Control Board" 521110 "DCU Node 4, Error, Ramp OH" 521111 "DCU Node 4, Error, Ramp OHI" 521112 "DCU Node 4, Error 24V Supply Undervoltage" 521113 "DCU Node 4, Error STO signals" 521114 "DCU Node 4, Error Ext. 24V Supply Undervoltage" 521115 "DCU Node 4, Error GTR7 Always OFF" 521116 "DCU Node 4, Error GTR7 OC" 521117 "DCU Node 4, Error GTR7 Always ON" 521118 "DCU Node 4, OC at 5V Diagnostic" 521119 "DCU Node 4, Error, Extreme Overpotential" 521120 "DCU Node 4, Error, DC Capacitor Damaged" 521121 "DCU Node 4, status not available" 521122 "DCU Node 4, status not available" 521123 "DCU Node 4, status not available" 521124 "DCU Node 4, status not available" 521125 "DCU Node 4, status not available" 521126 "DCU Node 4, status not available" 521127 "DCU Node 4, status not available" 521128 "DCU Node 4, status not available" 521129 "DCU Node 4, status not available" 521130 "DCU Node 4, status not available" 521131 "DCU Node 4, status not available" 521132 "DCU Node 4, status not available" 521133 "DCU Node 4, status not available" 521134 "DCU Node 4, status not available" 521135 "DCU Node 4, status not available" 521300 "App Node 4, No error" 521301 "App Node 4, No axis" 521302 "App Node 4, Error reading mapping" 521303 "App Node 4, Error reading rated current" 521304 "App Node 4, Error rated current mismatch" 521305 "App Node 4, Error write pll offset" 521306 "App Node 4, Error auto mapping" 521307 "App Node 4, Error interlink communication" 521308 "App Node 4, Error overload parameter" 521309 "App Node 4, Incompatible default download" 521310 "App Node 4, Error downloading default download" 521311 "App Node 4, Default download not found" 521312 "App Node 4, Error CAN data timeout" 521313 "App Node 4, Error CAN data invalid" 521314 "App Node 4, Invalid license" 521315 "App Node 4, Error reinitializing app" 521319 "App Node 4, General application error" 522000 "DCU Node 5, No Error" 522001 "DCU Node 5, status not available" 522002 "DCU Node 5, status not available" 522003 "DCU Node 5, Error, Overcurrent Power Unit" 522004 "DCU Node 5, Error, Overcurrent Analog" 522005 "DCU Node 5, Error, Overvoltage DC Link" 522006 "DCU Node 5, Error, Undervoltage DC Link" 522007 "DCU Node 5, Error, Overload" 522008 "DCU Node 5, Reset Error, Overload" 522009 "DCU Node 5, Error, Overload 02" 522010 "DCU Node 5, Error, Power Module Overheat" 522011 "DCU Node 5, Reset Error, Power Module Overheat" 522012 "DCU Node 5, Error, Internal Power Unit Overheat" 522013 "DCU Node 5, Reset Error, Internal Power Unit Overheat" 522014 "DCU Node 5, Error, Motor Protection" 522015 "DCU Node 5, Reset Error, Motor Protection" 522016 "DCU Node 5, Error, Drive Overheat" 522017 "DCU Node 5, Reset Error, Drive Overheat" 522018 "DCU Node 5, Error, Overspeed" 522019 "DCU Node 5, status not available" 522020 "DCU Node 5, Error, Drive Data" 522021 "DCU Node 5, Error, Motor Data Not Stored" 522022 "DCU Node 5, Error, Indentification" 522023 "DCU Node 5, Error, Speed Difference" 522024 "DCU Node 5, Error, Fieldbus Memory" 522025 "DCU Node 5, status not available" 522026 "DCU Node 5, status not available" 522027 "DCU Node 5, status not available" 522028 "DCU Node 5, status not available" 522029 "DCU Node 5, status not available" 522030 "DCU Node 5, status not available" 522031 "DCU Node 5, status not available" 522032 "DCU Node 5, status not available" 522033 "DCU Node 5, status not available" 522034 "DCU Node 5, status not available" 522035 "DCU Node 5, status not available" 522036 "DCU Node 5, status not available" 522037 "DCU Node 5, status not available" 522038 "DCU Node 5, Error, Memory Size" 522039 "DCU Node 5, Error, Power Unit Software Version" 522040 "DCU Node 5, Error, FPGA Config" 522041 "DCU Node 5, status not available" 522042 "DCU Node 5, status not available" 522043 "DCU Node 5, Error, Encoder Interface Communication" 522044 "DCU Node 5, Error, Invlid Data, Power Unit" 522045 "DCU Node 5, status not available" 522046 "DCU Node 5, status not available" 522047 "DCU Node 5, status not available" 522048 "DCU Node 5, status not available" 522049 "DCU Node 5, status not available" 522050 "DCU Node 5, status not available" 522051 "DCU Node 5, status not available" 522052 "DCU Node 5, Error, Phase Undervoltage" 522053 "DCU Node 5, Error, Rotor Detection Current" 522054 "DCU Node 5, status not available" 522055 "DCU Node 5, status not available" 522056 "DCU Node 5, Error, SW Switch Left" 522057 "DCU Node 5, Error, SW Switch Right" 522058 "DCU Node 5, Error, Fieldbus Watchdog Response" 522059 "DCU Node 5, Error, Prog. Input" 522060 "DCU Node 5, status not available" 522061 "DCU Node 5, status not available" 522062 "DCU Node 5, Error, Power Unit Changed" 522063 "DCU Node 5, Error, Encoder Interface Changed" 522064 "DCU Node 5, Error, Power Unit Type Changed" 522065 "DCU Node 5, Error, Invalid Ver., Encoder Interface" 522066 "DCU Node 5, Error, Overcurrent" 522067 "DCU Node 5, Error, Max Accel/Decel Setting Exceeded" 522068 "DCU Node 5, Error, Overcurrent Brake" 522069 "DCU Node 5, Error, Power Unit" 522070 "DCU Node 5, status not available" 522071 "DCU Node 5, status not available" 522072 "DCU Node 5, status not available" 522073 "DCU Node 5, status not available" 522074 "DCU Node 5, status not available" 522075 "DCU Node 5, status not available" 522076 "DCU Node 5, status not available" 522077 "DCU Node 5, status not available" 522078 "DCU Node 5, status not available" 522079 "DCU Node 5, status not available" 522080 "DCU Node 5, status not available" 522081 "DCU Node 5, Error, Rotor Detection, Five Step" 522082 "DCU Node 5, Error, Rotor Detection, Ld equal Lq" 522083 "DCU Node 5, Error, Limit Switch Forward" 522084 "DCU Node 5, Error, Limit Switch Reverse" 522085 "DCU Node 5, Error, Limit Switch Override Forward" 522086 "DCU Node 5, Error, Limit Switch Override Reverse" 522087 "DCU Node 5, Error Limit Switch" 522088 "DCU Node 5, Error, Power Off End" 522089 "DCU Node 5, Error, Encoder Type Change" 522090 "DCU Node 5, Error, Control Board Communication" 522091 "DCU Node 5, INIT, Encoder Interface" 522092 "DCU Node 5, status not available" 522093 "DCU Node 5, status not available" 522094 "DCU Node 5, status not available" 522095 "DCU Node 5, status not available" 522096 "DCU Node 5, Error, Encoder Missing" 522097 "DCU Node 5, Error, Overspeed (EMF)" 522098 "DCU Node 5, Error, Encoder A Changed" 522099 "DCU Node 5, Error, Encoder B Changed" 522100 "DCU Node 5, Error Overcurrent, Out 01" 522101 "DCU Node 5, Error Overcurrent, Out 02" 522102 "DCU Node 5, Error Overcurrent, Out 03" 522103 "DCU Node 5, Error Overcurrent, Out 04" 522104 "DCU Node 5, Error Overcurrent, Fan" 522105 "DCU Node 5, Error Overcurrent ,Encoder" 522106 "DCU Node 5, Error Overcurrent, 24V Supply" 522107 "DCU Node 5, Error, Overfrequency" 522108 "DCU Node 5, Error Reset, Internal Overheat Control Board" 522109 "DCU Node 5, Error, Internal Overheat, Control Board" 522110 "DCU Node 5, Error, Ramp OH" 522111 "DCU Node 5, Error, Ramp OHI" 522112 "DCU Node 5, Error 24V Supply Undervoltage" 522113 "DCU Node 5, Error STO signals" 522114 "DCU Node 5, Error Ext. 24V Supply Undervoltage" 522115 "DCU Node 5, Error GTR7 Always OFF" 522116 "DCU Node 5, Error GTR7 OC" 522117 "DCU Node 5, Error GTR7 Always ON" 522118 "DCU Node 5, OC at 5V Diagnostic" 522119 "DCU Node 5, Error, Extreme Overpotential" 522120 "DCU Node 5, Error, DC Capacitor Damaged" 522121 "DCU Node 5, status not available" 522122 "DCU Node 5, status not available" 522123 "DCU Node 5, status not available" 522124 "DCU Node 5, status not available" 522125 "DCU Node 5, status not available" 522126 "DCU Node 5, status not available" 522127 "DCU Node 5, status not available" 522128 "DCU Node 5, status not available" 522129 "DCU Node 5, status not available" 522130 "DCU Node 5, status not available" 522131 "DCU Node 5, status not available" 522132 "DCU Node 5, status not available" 522133 "DCU Node 5, status not available" 522134 "DCU Node 5, status not available" 522135 "DCU Node 5, status not available" 522300 "App Node 5, No error" 522301 "App Node 5, No axis" 522302 "App Node 5, Error reading mapping" 522303 "App Node 5, Error reading rated current" 522304 "App Node 5, Error rated current mismatch" 522305 "App Node 5, Error write pll offset" 522306 "App Node 5, Error auto mapping" 522307 "App Node 5, Error interlink communication" 522308 "App Node 5, Error overload parameter" 522309 "App Node 5, Incompatible default download" 522310 "App Node 5, Error downloading default download" 522311 "App Node 5, Default download not found" 522312 "App Node 5, Error CAN data timeout" 522313 "App Node 5, Error CAN data invalid" 522314 "App Node 5, Invalid license" 522315 "App Node 5, Error reinitializing app" 522319 "App Node 5, General application error" 523000 "DCU Node 6, No Error" 523001 "DCU Node 6, status not available" 523002 "DCU Node 6, status not available" 523003 "DCU Node 6, Error, Overcurrent Power Unit" 523004 "DCU Node 6, Error, Overcurrent Analog" 523005 "DCU Node 6, Error, Overvoltage DC Link" 523006 "DCU Node 6, Error, Undervoltage DC Link" 523007 "DCU Node 6, Error, Overload" 523008 "DCU Node 6, Reset Error, Overload" 523009 "DCU Node 6, Error, Overload 02" 523010 "DCU Node 6, Error, Power Module Overheat" 523011 "DCU Node 6, Reset Error, Power Module Overheat" 523012 "DCU Node 6, Error, Internal Power Unit Overheat" 523013 "DCU Node 6, Reset Error, Internal Power Unit Overheat" 523014 "DCU Node 6, Error, Motor Protection" 523015 "DCU Node 6, Reset Error, Motor Protection" 523016 "DCU Node 6, Error, Drive Overheat" 523017 "DCU Node 6, Reset Error, Drive Overheat" 523018 "DCU Node 6, Error, Overspeed" 523019 "DCU Node 6, status not available" 523020 "DCU Node 6, Error, Drive Data" 523021 "DCU Node 6, Error, Motor Data Not Stored" 523022 "DCU Node 6, Error, Indentification" 523023 "DCU Node 6, Error, Speed Difference" 523024 "DCU Node 6, Error, Fieldbus Memory" 523025 "DCU Node 6, status not available" 523026 "DCU Node 6, status not available" 523027 "DCU Node 6, status not available" 523028 "DCU Node 6, status not available" 523029 "DCU Node 6, status not available" 523030 "DCU Node 6, status not available" 523031 "DCU Node 6, status not available" 523032 "DCU Node 6, status not available" 523033 "DCU Node 6, status not available" 523034 "DCU Node 6, status not available" 523035 "DCU Node 6, status not available" 523036 "DCU Node 6, status not available" 523037 "DCU Node 6, status not available" 523038 "DCU Node 6, Error, Memory Size" 523039 "DCU Node 6, Error, Power Unit Software Version" 523040 "DCU Node 6, Error, FPGA Config" 523041 "DCU Node 6, status not available" 523042 "DCU Node 6, status not available" 523043 "DCU Node 6, Error, Encoder Interface Communication" 523044 "DCU Node 6, Error, Invlid Data, Power Unit" 523045 "DCU Node 6, status not available" 523046 "DCU Node 6, status not available" 523047 "DCU Node 6, status not available" 523048 "DCU Node 6, status not available" 523049 "DCU Node 6, status not available" 523050 "DCU Node 6, status not available" 523051 "DCU Node 6, status not available" 523052 "DCU Node 6, Error, Phase Undervoltage" 523053 "DCU Node 6, Error, Rotor Detection Current" 523054 "DCU Node 6, status not available" 523055 "DCU Node 6, status not available" 523056 "DCU Node 6, Error, SW Switch Left" 523057 "DCU Node 6, Error, SW Switch Right" 523058 "DCU Node 6, Error, Fieldbus Watchdog Response" 523059 "DCU Node 6, Error, Prog. Input" 523060 "DCU Node 6, status not available" 523061 "DCU Node 6, status not available" 523062 "DCU Node 6, Error, Power Unit Changed" 523063 "DCU Node 6, Error, Encoder Interface Changed" 523064 "DCU Node 6, Error, Power Unit Type Changed" 523065 "DCU Node 6, Error, Invalid Ver., Encoder Interface" 523066 "DCU Node 6, Error, Overcurrent" 523067 "DCU Node 6, Error, Max Accel/Decel Setting Exceeded" 523068 "DCU Node 6, Error, Overcurrent Brake" 523069 "DCU Node 6, Error, Power Unit" 523070 "DCU Node 6, status not available" 523071 "DCU Node 6, status not available" 523072 "DCU Node 6, status not available" 523073 "DCU Node 6, status not available" 523074 "DCU Node 6, status not available" 523075 "DCU Node 6, status not available" 523076 "DCU Node 6, status not available" 523077 "DCU Node 6, status not available" 523078 "DCU Node 6, status not available" 523079 "DCU Node 6, status not available" 523080 "DCU Node 6, status not available" 523081 "DCU Node 6, Error, Rotor Detection, Five Step" 523082 "DCU Node 6, Error, Rotor Detection, Ld equal Lq" 523083 "DCU Node 6, Error, Limit Switch Forward" 523084 "DCU Node 6, Error, Limit Switch Reverse" 523085 "DCU Node 6, Error, Limit Switch Override Forward" 523086 "DCU Node 6, Error, Limit Switch Override Reverse" 523087 "DCU Node 6, Error Limit Switch" 523088 "DCU Node 6, Error, Power Off End" 523089 "DCU Node 6, Error, Encoder Type Change" 523090 "DCU Node 6, Error, Control Board Communication" 523091 "DCU Node 6, INIT, Encoder Interface" 523092 "DCU Node 6, status not available" 523093 "DCU Node 6, status not available" 523094 "DCU Node 6, status not available" 523095 "DCU Node 6, status not available" 523096 "DCU Node 6, Error, Encoder Missing" 523097 "DCU Node 6, Error, Overspeed (EMF)" 523098 "DCU Node 6, Error, Encoder A Changed" 523099 "DCU Node 6, Error, Encoder B Changed" 523100 "DCU Node 6, Error Overcurrent, Out 01" 523101 "DCU Node 6, Error Overcurrent, Out 02" 523102 "DCU Node 6, Error Overcurrent, Out 03" 523103 "DCU Node 6, Error Overcurrent, Out 04" 523104 "DCU Node 6, Error Overcurrent, Fan" 523105 "DCU Node 6, Error Overcurrent ,Encoder" 523106 "DCU Node 6, Error Overcurrent, 24V Supply" 523107 "DCU Node 6, Error, Overfrequency" 523108 "DCU Node 6, Error Reset, Internal Overheat Control Board" 523109 "DCU Node 6, Error, Internal Overheat, Control Board" 523110 "DCU Node 6, Error, Ramp OH" 523111 "DCU Node 6, Error, Ramp OHI" 523112 "DCU Node 6, Error 24V Supply Undervoltage" 523113 "DCU Node 6, Error STO signals" 523114 "DCU Node 6, Error Ext. 24V Supply Undervoltage" 523115 "DCU Node 6, Error GTR7 Always OFF" 523116 "DCU Node 6, Error GTR7 OC" 523117 "DCU Node 6, Error GTR7 Always ON" 523118 "DCU Node 6, OC at 5V Diagnostic" 523119 "DCU Node 6, Error, Extreme Overpotential" 523120 "DCU Node 6, Error, DC Capacitor Damaged" 523121 "DCU Node 6, status not available" 523122 "DCU Node 6, status not available" 523123 "DCU Node 6, status not available" 523124 "DCU Node 6, status not available" 523125 "DCU Node 6, status not available" 523126 "DCU Node 6, status not available" 523127 "DCU Node 6, status not available" 523128 "DCU Node 6, status not available" 523129 "DCU Node 6, status not available" 523130 "DCU Node 6, status not available" 523131 "DCU Node 6, status not available" 523132 "DCU Node 6, status not available" 523133 "DCU Node 6, status not available" 523134 "DCU Node 6, status not available" 523135 "DCU Node 6, status not available" 523300 "App Node 6, No error" 523301 "App Node 6, No axis" 523302 "App Node 6, Error reading mapping" 523303 "App Node 6, Error reading rated current" 523304 "App Node 6, Error rated current mismatch" 523305 "App Node 6, Error write pll offset" 523306 "App Node 6, Error auto mapping" 523307 "App Node 6, Error interlink communication" 523308 "App Node 6, Error overload parameter" 523309 "App Node 6, Incompatible default download" 523310 "App Node 6, Error downloading default download" 523311 "App Node 6, Default download not found" 523312 "App Node 6, Error CAN data timeout" 523313 "App Node 6, Error CAN data invalid" 523314 "App Node 6, Invalid license" 523315 "App Node 6, Error reinitializing app" 523319 "App Node 6, General application error" ;
VAL_ 2566834768 SPN_DTC4 0 "No Error" 517290 "MCU Node 0, No Error" 517291 "MCU Node 0, No configuration file found" 517292 "MCU Node 0, Invalid J1939 license" 517293 "MCU Node 0, Error downloading configuration file" 517294 "MCU Node 0, Overload protection active" 517295 "MCU Node 0, Invalid app selection" 517296 "MCU Node 0, Overload warning active" 518000 "DCU Node 1, No Error" 518001 "DCU Node 1, status not available" 518002 "DCU Node 1, status not available" 518003 "DCU Node 1, Error, Overcurrent Power Unit" 518004 "DCU Node 1, Error, Overcurrent Analog" 518005 "DCU Node 1, Error, Overvoltage DC Link" 518006 "DCU Node 1, Error, Undervoltage DC Link" 518007 "DCU Node 1, Error, Overload" 518008 "DCU Node 1, Reset Error, Overload" 518009 "DCU Node 1, Error, Overload 02" 518010 "DCU Node 1, Error, Power Module Overheat" 518011 "DCU Node 1, Reset Error, Power Module Overheat" 518012 "DCU Node 1, Error, Internal Power Unit Overheat" 518013 "DCU Node 1, Reset Error, Internal Power Unit Overheat" 518014 "DCU Node 1, Error, Motor Protection" 518015 "DCU Node 1, Reset Error, Motor Protection" 518016 "DCU Node 1, Error, Drive Overheat" 518017 "DCU Node 1, Reset Error, Drive Overheat" 518018 "DCU Node 1, Error, Overspeed" 518019 "DCU Node 1, status not available" 518020 "DCU Node 1, Error, Drive Data" 518021 "DCU Node 1, Error, Motor Data Not Stored" 518022 "DCU Node 1, Error, Indentification" 518023 "DCU Node 1, Error, Speed Difference" 518024 "DCU Node 1, Error, Fieldbus Memory" 518025 "DCU Node 1, status not available" 518026 "DCU Node 1, status not available" 518027 "DCU Node 1, status not available" 518028 "DCU Node 1, status not available" 518029 "DCU Node 1, status not available" 518030 "DCU Node 1, status not available" 518031 "DCU Node 1, status not available" 518032 "DCU Node 1, status not available" 518033 "DCU Node 1, status not available" 518034 "DCU Node 1, status not available" 518035 "DCU Node 1, status not available" 518036 "DCU Node 1, status not available" 518037 "DCU Node 1, status not available" 518038 "DCU Node 1, Error, Memory Size" 518039 "DCU Node 1, Error, Power Unit Software Version" 518040 "DCU Node 1, Error, FPGA Config" 518041 "DCU Node 1, status not available" 518042 "DCU Node 1, status not available" 518043 "DCU Node 1, Error, Encoder Interface Communication" 518044 "DCU Node 1, Error, Invlid Data, Power Unit" 518045 "DCU Node 1, status not available" 518046 "DCU Node 1, status not available" 518047 "DCU Node 1, status not available" 518048 "DCU Node 1, status not available" 518049 "DCU Node 1, status not available" 518050 "DCU Node 1, status not available" 518051 "DCU Node 1, status not available" 518052 "DCU Node 1, Error, Phase Undervoltage" 518053 "DCU Node 1, Error, Rotor Detection Current" 518054 "DCU Node 1, status not available" 518055 "DCU Node 1, status not available" 518056 "DCU Node 1, Error, SW Switch Left" 518057 "DCU Node 1, Error, SW Switch Right" 518058 "DCU Node 1, Error, Fieldbus Watchdog Response" 518059 "DCU Node 1, Error, Prog. Input" 518060 "DCU Node 1, status not available" 518061 "DCU Node 1, status not available" 518062 "DCU Node 1, Error, Power Unit Changed" 518063 "DCU Node 1, Error, Encoder Interface Changed" 518064 "DCU Node 1, Error, Power Unit Type Changed" 518065 "DCU Node 1, Error, Invalid Ver., Encoder Interface" 518066 "DCU Node 1, Error, Overcurrent" 518067 "DCU Node 1, Error, Max Accel/Decel Setting Exceeded" 518068 "DCU Node 1, Error, Overcurrent Brake" 518069 "DCU Node 1, Error, Power Unit" 518070 "DCU Node 1, status not available" 518071 "DCU Node 1, status not available" 518072 "DCU Node 1, status not available" 518073 "DCU Node 1, status not available" 518074 "DCU Node 1, status not available" 518075 "DCU Node 1, status not available" 518076 "DCU Node 1, status not available" 518077 "DCU Node 1, status not available" 518078 "DCU Node 1, status not available" 518079 "DCU Node 1, status not available" 518080 "DCU Node 1, status not available" 518081 "DCU Node 1, Error, Rotor Detection, Five Step" 518082 "DCU Node 1, Error, Rotor Detection, Ld equal Lq" 518083 "DCU Node 1, Error, Limit Switch Forward" 518084 "DCU Node 1, Error, Limit Switch Reverse" 518085 "DCU Node 1, Error, Limit Switch Override Forward" 518086 "DCU Node 1, Error, Limit Switch Override Reverse" 518087 "DCU Node 1, Error Limit Switch" 518088 "DCU Node 1, Error, Power Off End" 518089 "DCU Node 1, Error, Encoder Type Change" 518090 "DCU Node 1, Error, Control Board Communication" 518091 "DCU Node 1, INIT, Encoder Interface" 518092 "DCU Node 1, status not available" 518093 "DCU Node 1, status not available" 518094 "DCU Node 1, status not available" 518095 "DCU Node 1, status not available" 518096 "DCU Node 1, Error, Encoder Missing" 518097 "DCU Node 1, Error, Overspeed (EMF)" 518098 "DCU Node 1, Error, Encoder A Changed" 518099 "DCU Node 1, Error, Encoder B Changed" 518100 "DCU Node 1, Error Overcurrent, Out 01" 518101 "DCU Node 1, Error Overcurrent, Out 02" 518102 "DCU Node 1, Error Overcurrent, Out 03" 518103 "DCU Node 1, Error Overcurrent, Out 04" 518104 "DCU Node 1, Error Overcurrent, Fan" 518105 "DCU Node 1, Error Overcurrent ,Encoder" 518106 "DCU Node 1, Error Overcurrent, 24V Supply" 518107 "DCU Node 1, Error, Overfrequency" 518108 "DCU Node 1, Error Reset, Internal Overheat Control Board" 518109 "DCU Node 1, Error, Internal Overheat, Control Board" 518110 "DCU Node 1, Error, Ramp OH" 518111 "DCU Node 1, Error, Ramp OHI" 518112 "DCU Node 1, Error 24V Supply Undervoltage" 518113 "DCU Node 1, Error STO signals" 518114 "DCU Node 1, Error Ext. 24V Supply Undervoltage" 518115 "DCU Node 1, Error GTR7 Always OFF" 518116 "DCU Node 1, Error GTR7 OC" 518117 "DCU Node 1, Error GTR7 Always ON" 518118 "DCU Node 1, OC at 5V Diagnostic" 518119 "DCU Node 1, Error, Extreme Overpotential" 518120 "DCU Node 1, Error, DC Capacitor Damaged" 518121 "DCU Node 1, status not available" 518122 "DCU Node 1, status not available" 518123 "DCU Node 1, status not available" 518124 "DCU Node 1, status not available" 518125 "DCU Node 1, status not available" 518126 "DCU Node 1, status not available" 518127 "DCU Node 1, status not available" 518128 "DCU Node 1, status not available" 518129 "DCU Node 1, status not available" 518130 "DCU Node 1, status not available" 518131 "DCU Node 1, status not available" 518132 "DCU Node 1, status not available" 518133 "DCU Node 1, status not available" 518134 "DCU Node 1, status not available" 518135 "DCU Node 1, status not available" 518300 "App Node 1, No error" 518301 "App Node 1, No axis" 518302 "App Node 1, Error reading mapping" 518303 "App Node 1, Error reading rated current" 518304 "App Node 1, Error rated current mismatch" 518305 "App Node 1, Error write pll offset" 518306 "App Node 1, Error auto mapping" 518307 "App Node 1, Error interlink communication" 518308 "App Node 1, Error overload parameter" 518309 "App Node 1, Incompatible default download" 518310 "App Node 1, Error downloading default download" 518311 "App Node 1, Default download not found" 518312 "App Node 1, Error CAN data timeout" 518313 "App Node 1, Error CAN data invalid" 518314 "App Node 1, Invalid license" 518315 "App Node 1, Error reinitializing app" 518319 "App Node 1, General application error" 519000 "DCU Node 2, No Error" 519001 "DCU Node 2, status not available" 519002 "DCU Node 2, status not available" 519003 "DCU Node 2, Error, Overcurrent Power Unit" 519004 "DCU Node 2, Error, Overcurrent Analog" 519005 "DCU Node 2, Error, Overvoltage DC Link" 519006 "DCU Node 2, Error, Undervoltage DC Link" 519007 "DCU Node 2, Error, Overload" 519008 "DCU Node 2, Reset Error, Overload" 519009 "DCU Node 2, Error, Overload 02" 519010 "DCU Node 2, Error, Power Module Overheat" 519011 "DCU Node 2, Reset Error, Power Module Overheat" 519012 "DCU Node 2, Error, Internal Power Unit Overheat" 519013 "DCU Node 2, Reset Error, Internal Power Unit Overheat" 519014 "DCU Node 2, Error, Motor Protection" 519015 "DCU Node 2, Reset Error, Motor Protection" 519016 "DCU Node 2, Error, Drive Overheat" 519017 "DCU Node 2, Reset Error, Drive Overheat" 519018 "DCU Node 2, Error, Overspeed" 519019 "DCU Node 2, status not available" 519020 "DCU Node 2, Error, Drive Data" 519021 "DCU Node 2, Error, Motor Data Not Stored" 519022 "DCU Node 2, Error, Indentification" 519023 "DCU Node 2, Error, Speed Difference" 519024 "DCU Node 2, Error, Fieldbus Memory" 519025 "DCU Node 2, status not available" 519026 "DCU Node 2, status not available" 519027 "DCU Node 2, status not available" 519028 "DCU Node 2, status not available" 519029 "DCU Node 2, status not available" 519030 "DCU Node 2, status not available" 519031 "DCU Node 2, status not available" 519032 "DCU Node 2, status not available" 519033 "DCU Node 2, status not available" 519034 "DCU Node 2, status not available" 519035 "DCU Node 2, status not available" 519036 "DCU Node 2, status not available" 519037 "DCU Node 2, status not available" 519038 "DCU Node 2, Error, Memory Size" 519039 "DCU Node 2, Error, Power Unit Software Version" 519040 "DCU Node 2, Error, FPGA Config" 519041 "DCU Node 2, status not available" 519042 "DCU Node 2, status not available" 519043 "DCU Node 2, Error, Encoder Interface Communication" 519044 "DCU Node 2, Error, Invlid Data, Power Unit" 519045 "DCU Node 2, status not available" 519046 "DCU Node 2, status not available" 519047 "DCU Node 2, status not available" 519048 "DCU Node 2, status not available" 519049 "DCU Node 2, status not available" 519050 "DCU Node 2, status not available" 519051 "DCU Node 2, status not available" 519052 "DCU Node 2, Error, Phase Undervoltage" 519053 "DCU Node 2, Error, Rotor Detection Current" 519054 "DCU Node 2, status not available" 519055 "DCU Node 2, status not available" 519056 "DCU Node 2, Error, SW Switch Left" 519057 "DCU Node 2, Error, SW Switch Right" 519058 "DCU Node 2, Error, Fieldbus Watchdog Response" 519059 "DCU Node 2, Error, Prog. Input" 519060 "DCU Node 2, status not available" 519061 "DCU Node 2, status not available" 519062 "DCU Node 2, Error, Power Unit Changed" 519063 "DCU Node 2, Error, Encoder Interface Changed" 519064 "DCU Node 2, Error, Power Unit Type Changed" 519065 "DCU Node 2, Error, Invalid Ver., Encoder Interface" 519066 "DCU Node 2, Error, Overcurrent" 519067 "DCU Node 2, Error, Max Accel/Decel Setting Exceeded" 519068 "DCU Node 2, Error, Overcurrent Brake" 519069 "DCU Node 2, Error, Power Unit" 519070 "DCU Node 2, status not available" 519071 "DCU Node 2, status not available" 519072 "DCU Node 2, status not available" 519073 "DCU Node 2, status not available" 519074 "DCU Node 2, status not available" 519075 "DCU Node 2, status not available" 519076 "DCU Node 2, status not available" 519077 "DCU Node 2, status not available" 519078 "DCU Node 2, status not available" 519079 "DCU Node 2, status not available" 519080 "DCU Node 2, status not available" 519081 "DCU Node 2, Error, Rotor Detection, Five Step" 519082 "DCU Node 2, Error, Rotor Detection, Ld equal Lq" 519083 "DCU Node 2, Error, Limit Switch Forward" 519084 "DCU Node 2, Error, Limit Switch Reverse" 519085 "DCU Node 2, Error, Limit Switch Override Forward" 519086 "DCU Node 2, Error, Limit Switch Override Reverse" 519087 "DCU Node 2, Error Limit Switch" 519088 "DCU Node 2, Error, Power Off End" 519089 "DCU Node 2, Error, Encoder Type Change" 519090 "DCU Node 2, Error, Control Board Communication" 519091 "DCU Node 2, INIT, Encoder Interface" 519092 "DCU Node 2, status not available" 519093 "DCU Node 2, status not available" 519094 "DCU Node 2, status not available" 519095 "DCU Node 2, status not available" 519096 "DCU Node 2, Error, Encoder Missing" 519097 "DCU Node 2, Error, Overspeed (EMF)" 519098 "DCU Node 2, Error, Encoder A Changed" 519099 "DCU Node 2, Error, Encoder B Changed" 519100 "DCU Node 2, Error Overcurrent, Out 01" 519101 "DCU Node 2, Error Overcurrent, Out 02" 519102 "DCU Node 2, Error Overcurrent, Out 03" 519103 "DCU Node 2, Error Overcurrent, Out 04" 519104 "DCU Node 2, Error Overcurrent, Fan" 519105 "DCU Node 2, Error Overcurrent ,Encoder" 519106 "DCU Node 2, Error Overcurrent, 24V Supply" 519107 "DCU Node 2, Error, Overfrequency" 519108 "DCU Node 2, Error Reset, Internal Overheat Control Board" 519109 "DCU Node 2, Error, Internal Overheat, Control Board" 519110 "DCU Node 2, Error, Ramp OH" 519111 "DCU Node 2, Error, Ramp OHI" 519112 "DCU Node 2, Error 24V Supply Undervoltage" 519113 "DCU Node 2, Error STO signals" 519114 "DCU Node 2, Error Ext. 24V Supply Undervoltage" 519115 "DCU Node 2, Error GTR7 Always OFF" 519116 "DCU Node 2, Error GTR7 OC" 519117 "DCU Node 2, Error GTR7 Always ON" 519118 "DCU Node 2, OC at 5V Diagnostic" 519119 "DCU Node 2, Error, Extreme Overpotential" 519120 "DCU Node 2, Error, DC Capacitor Damaged" 519121 "DCU Node 2, status not available" 519122 "DCU Node 2, status not available" 519123 "DCU Node 2, status not available" 519124 "DCU Node 2, status not available" 519125 "DCU Node 2, status not available" 519126 "DCU Node 2, status not available" 519127 "DCU Node 2, status not available" 519128 "DCU Node 2, status not available" 519129 "DCU Node 2, status not available" 519130 "DCU Node 2, status not available" 519131 "DCU Node 2, status not available" 519132 "DCU Node 2, status not available" 519133 "DCU Node 2, status not available" 519134 "DCU Node 2, status not available" 519135 "DCU Node 2, status not available" 519300 "App Node 2, No error" 519301 "App Node 2, No axis" 519302 "App Node 2, Error reading mapping" 519303 "App Node 2, Error reading rated current" 519304 "App Node 2, Error rated current mismatch" 519305 "App Node 2, Error write pll offset" 519306 "App Node 2, Error auto mapping" 519307 "App Node 2, Error interlink communication" 519308 "App Node 2, Error overload parameter" 519309 "App Node 2, Incompatible default download" 519310 "App Node 2, Error downloading default download" 519311 "App Node 2, Default download not found" 519312 "App Node 2, Error CAN data timeout" 519313 "App Node 2, Error CAN data invalid" 519314 "App Node 2, Invalid license" 519315 "App Node 2, Error reinitializing app" 519319 "App Node 2, General application error" 520000 "DCU Node 3, No Error" 520001 "DCU Node 3, status not available" 520002 "DCU Node 3, status not available" 520003 "DCU Node 3, Error, Overcurrent Power Unit" 520004 "DCU Node 3, Error, Overcurrent Analog" 520005 "DCU Node 3, Error, Overvoltage DC Link" 520006 "DCU Node 3, Error, Undervoltage DC Link" 520007 "DCU Node 3, Error, Overload" 520008 "DCU Node 3, Reset Error, Overload" 520009 "DCU Node 3, Error, Overload 02" 520010 "DCU Node 3, Error, Power Module Overheat" 520011 "DCU Node 3, Reset Error, Power Module Overheat" 520012 "DCU Node 3, Error, Internal Power Unit Overheat" 520013 "DCU Node 3, Reset Error, Internal Power Unit Overheat" 520014 "DCU Node 3, Error, Motor Protection" 520015 "DCU Node 3, Reset Error, Motor Protection" 520016 "DCU Node 3, Error, Drive Overheat" 520017 "DCU Node 3, Reset Error, Drive Overheat" 520018 "DCU Node 3, Error, Overspeed" 520019 "DCU Node 3, status not available" 520020 "DCU Node 3, Error, Drive Data" 520021 "DCU Node 3, Error, Motor Data Not Stored" 520022 "DCU Node 3, Error, Indentification" 520023 "DCU Node 3, Error, Speed Difference" 520024 "DCU Node 3, Error, Fieldbus Memory" 520025 "DCU Node 3, status not available" 520026 "DCU Node 3, status not available" 520027 "DCU Node 3, status not available" 520028 "DCU Node 3, status not available" 520029 "DCU Node 3, status not available" 520030 "DCU Node 3, status not available" 520031 "DCU Node 3, status not available" 520032 "DCU Node 3, status not available" 520033 "DCU Node 3, status not available" 520034 "DCU Node 3, status not available" 520035 "DCU Node 3, status not available" 520036 "DCU Node 3, status not available" 520037 "DCU Node 3, status not available" 520038 "DCU Node 3, Error, Memory Size" 520039 "DCU Node 3, Error, Power Unit Software Version" 520040 "DCU Node 3, Error, FPGA Config" 520041 "DCU Node 3, status not available" 520042 "DCU Node 3, status not available" 520043 "DCU Node 3, Error, Encoder Interface Communication" 520044 "DCU Node 3, Error, Invlid Data, Power Unit" 520045 "DCU Node 3, status not available" 520046 "DCU Node 3, status not available" 520047 "DCU Node 3, status not available" 520048 "DCU Node 3, status not available" 520049 "DCU Node 3, status not available" 520050 "DCU Node 3, status not available" 520051 "DCU Node 3, status not available" 520052 "DCU Node 3, Error, Phase Undervoltage" 520053 "DCU Node 3, Error, Rotor Detection Current" 520054 "DCU Node 3, status not available" 520055 "DCU Node 3, status not available" 520056 "DCU Node 3, Error, SW Switch Left" 520057 "DCU Node 3, Error, SW Switch Right" 520058 "DCU Node 3, Error, Fieldbus Watchdog Response" 520059 "DCU Node 3, Error, Prog. Input" 520060 "DCU Node 3, status not available" 520061 "DCU Node 3, status not available" 520062 "DCU Node 3, Error, Power Unit Changed" 520063 "DCU Node 3, Error, Encoder Interface Changed" 520064 "DCU Node 3, Error, Power Unit Type Changed" 520065 "DCU Node 3, Error, Invalid Ver., Encoder Interface" 520066 "DCU Node 3, Error, Overcurrent" 520067 "DCU Node 3, Error, Max Accel/Decel Setting Exceeded" 520068 "DCU Node 3, Error, Overcurrent Brake" 520069 "DCU Node 3, Error, Power Unit" 520070 "DCU Node 3, status not available" 520071 "DCU Node 3, status not available" 520072 "DCU Node 3, status not available" 520073 "DCU Node 3, status not available" 520074 "DCU Node 3, status not available" 520075 "DCU Node 3, status not available" 520076 "DCU Node 3, status not available" 520077 "DCU Node 3, status not available" 520078 "DCU Node 3, status not available" 520079 "DCU Node 3, status not available" 520080 "DCU Node 3, status not available" 520081 "DCU Node 3, Error, Rotor Detection, Five Step" 520082 "DCU Node 3, Error, Rotor Detection, Ld equal Lq" 520083 "DCU Node 3, Error, Limit Switch Forward" 520084 "DCU Node 3, Error, Limit Switch Reverse" 520085 "DCU Node 3, Error, Limit Switch Override Forward" 520086 "DCU Node 3, Error, Limit Switch Override Reverse" 520087 "DCU Node 3, Error Limit Switch" 520088 "DCU Node 3, Error, Power Off End" 520089 "DCU Node 3, Error, Encoder Type Change" 520090 "DCU Node 3, Error, Control Board Communication" 520091 "DCU Node 3, INIT, Encoder Interface" 520092 "DCU Node 3, status not available" 520093 "DCU Node 3, status not available" 520094 "DCU Node 3, status not available" 520095 "DCU Node 3, status not available" 520096 "DCU Node 3, Error, Encoder Missing" 520097 "DCU Node 3, Error, Overspeed (EMF)" 520098 "DCU Node 3, Error, Encoder A Changed" 520099 "DCU Node 3, Error, Encoder B Changed" 520100 "DCU Node 3, Error Overcurrent, Out 01" 520101 "DCU Node 3, Error Overcurrent, Out 02" 520102 "DCU Node 3, Error Overcurrent, Out 03" 520103 "DCU Node 3, Error Overcurrent, Out 04" 520104 "DCU Node 3, Error Overcurrent, Fan" 520105 "DCU Node 3, Error Overcurrent ,Encoder" 520106 "DCU Node 3, Error Overcurrent, 24V Supply" 520107 "DCU Node 3, Error, Overfrequency" 520108 "DCU Node 3, Error Reset, Internal Overheat Control Board" 520109 "DCU Node 3, Error, Internal Overheat, Control Board" 520110 "DCU Node 3, Error, Ramp OH" 520111 "DCU Node 3, Error, Ramp OHI" 520112 "DCU Node 3, Error 24V Supply Undervoltage" 520113 "DCU Node 3, Error STO signals" 520114 "DCU Node 3, Error Ext. 24V Supply Undervoltage" 520115 "DCU Node 3, Error GTR7 Always OFF" 520116 "DCU Node 3, Error GTR7 OC" 520117 "DCU Node 3, Error GTR7 Always ON" 520118 "DCU Node 3, OC at 5V Diagnostic" 520119 "DCU Node 3, Error, Extreme Overpotential" 520120 "DCU Node 3, Error, DC Capacitor Damaged" 520121 "DCU Node 3, status not available" 520122 "DCU Node 3, status not available" 520123 "DCU Node 3, status not available" 520124 "DCU Node 3, status not available" 520125 "DCU Node 3, status not available" 520126 "DCU Node 3, status not available" 520127 "DCU Node 3, status not available" 520128 "DCU Node 3, status not available" 520129 "DCU Node 3, status not available" 520130 "DCU Node 3, status not available" 520131 "DCU Node 3, status not available" 520132 "DCU Node 3, status not available" 520133 "DCU Node 3, status not available" 520134 "DCU Node 3, status not available" 520135 "DCU Node 3, status not available" 520300 "App Node 3, No error" 520301 "App Node 3, No axis" 520302 "App Node 3, Error reading mapping" 520303 "App Node 3, Error reading rated current" 520304 "App Node 3, Error rated current mismatch" 520305 "App Node 3, Error write pll offset" 520306 "App Node 3, Error auto mapping" 520307 "App Node 3, Error interlink communication" 520308 "App Node 3, Error overload parameter" 520309 "App Node 3, Incompatible default download" 520310 "App Node 3, Error downloading default download" 520311 "App Node 3, Default download not found" 520312 "App Node 3, Error CAN data timeout" 520313 "App Node 3, Error CAN data invalid" 520314 "App Node 3, Invalid license" 520315 "App Node 3, Error reinitializing app" 520319 "App Node 3, General application error" 521000 "DCU Node 4, No Error" 521001 "DCU Node 4, status not available" 521002 "DCU Node 4, status not available" 521003 "DCU Node 4, Error, Overcurrent Power Unit" 521004 "DCU Node 4, Error, Overcurrent Analog" 521005 "DCU Node 4, Error, Overvoltage DC Link" 521006 "DCU Node 4, Error, Undervoltage DC Link" 521007 "DCU Node 4, Error, Overload" 521008 "DCU Node 4, Reset Error, Overload" 521009 "DCU Node 4, Error, Overload 02" 521010 "DCU Node 4, Error, Power Module Overheat" 521011 "DCU Node 4, Reset Error, Power Module Overheat" 521012 "DCU Node 4, Error, Internal Power Unit Overheat" 521013 "DCU Node 4, Reset Error, Internal Power Unit Overheat" 521014 "DCU Node 4, Error, Motor Protection" 521015 "DCU Node 4, Reset Error, Motor Protection" 521016 "DCU Node 4, Error, Drive Overheat" 521017 "DCU Node 4, Reset Error, Drive Overheat" 521018 "DCU Node 4, Error, Overspeed" 521019 "DCU Node 4, status not available" 521020 "DCU Node 4, Error, Drive Data" 521021 "DCU Node 4, Error, Motor Data Not Stored" 521022 "DCU Node 4, Error, Indentification" 521023 "DCU Node 4, Error, Speed Difference" 521024 "DCU Node 4, Error, Fieldbus Memory" 521025 "DCU Node 4, status not available" 521026 "DCU Node 4, status not available" 521027 "DCU Node 4, status not available" 521028 "DCU Node 4, status not available" 521029 "DCU Node 4, status not available" 521030 "DCU Node 4, status not available" 521031 "DCU Node 4, status not available" 521032 "DCU Node 4, status not available" 521033 "DCU Node 4, status not available" 521034 "DCU Node 4, status not available" 521035 "DCU Node 4, status not available" 521036 "DCU Node 4, status not available" 521037 "DCU Node 4, status not available" 521038 "DCU Node 4, Error, Memory Size" 521039 "DCU Node 4, Error, Power Unit Software Version" 521040 "DCU Node 4, Error, FPGA Config" 521041 "DCU Node 4, status not available" 521042 "DCU Node 4, status not available" 521043 "DCU Node 4, Error, Encoder Interface Communication" 521044 "DCU Node 4, Error, Invlid Data, Power Unit" 521045 "DCU Node 4, status not available" 521046 "DCU Node 4, status not available" 521047 "DCU Node 4, status not available" 521048 "DCU Node 4, status not available" 521049 "DCU Node 4, status not available" 521050 "DCU Node 4, status not available" 521051 "DCU Node 4, status not available" 521052 "DCU Node 4, Error, Phase Undervoltage" 521053 "DCU Node 4, Error, Rotor Detection Current" 521054 "DCU Node 4, status not available" 521055 "DCU Node 4, status not available" 521056 "DCU Node 4, Error, SW Switch Left" 521057 "DCU Node 4, Error, SW Switch Right" 521058 "DCU Node 4, Error, Fieldbus Watchdog Response" 521059 "DCU Node 4, Error, Prog. Input" 521060 "DCU Node 4, status not available" 521061 "DCU Node 4, status not available" 521062 "DCU Node 4, Error, Power Unit Changed" 521063 "DCU Node 4, Error, Encoder Interface Changed" 521064 "DCU Node 4, Error, Power Unit Type Changed" 521065 "DCU Node 4, Error, Invalid Ver., Encoder Interface" 521066 "DCU Node 4, Error, Overcurrent" 521067 "DCU Node 4, Error, Max Accel/Decel Setting Exceeded" 521068 "DCU Node 4, Error, Overcurrent Brake" 521069 "DCU Node 4, Error, Power Unit" 521070 "DCU Node 4, status not available" 521071 "DCU Node 4, status not available" 521072 "DCU Node 4, status not available" 521073 "DCU Node 4, status not available" 521074 "DCU Node 4, status not available" 521075 "DCU Node 4, status not available" 521076 "DCU Node 4, status not available" 521077 "DCU Node 4, status not available" 521078 "DCU Node 4, status not available" 521079 "DCU Node 4, status not available" 521080 "DCU Node 4, status not available" 521081 "DCU Node 4, Error, Rotor Detection, Five Step" 521082 "DCU Node 4, Error, Rotor Detection, Ld equal Lq" 521083 "DCU Node 4, Error, Limit Switch Forward" 521084 "DCU Node 4, Error, Limit Switch Reverse" 521085 "DCU Node 4, Error, Limit Switch Override Forward" 521086 "DCU Node 4, Error, Limit Switch Override Reverse" 521087 "DCU Node 4, Error Limit Switch" 521088 "DCU Node 4, Error, Power Off End" 521089 "DCU Node 4, Error, Encoder Type Change" 521090 "DCU Node 4, Error, Control Board Communication" 521091 "DCU Node 4, INIT, Encoder Interface" 521092 "DCU Node 4, status not available" 521093 "DCU Node 4, status not available" 521094 "DCU Node 4, status not available" 521095 "DCU Node 4, status not available" 521096 "DCU Node 4, Error, Encoder Missing" 521097 "DCU Node 4, Error, Overspeed (EMF)" 521098 "DCU Node 4, Error, Encoder A Changed" 521099 "DCU Node 4, Error, Encoder B Changed" 521100 "DCU Node 4, Error Overcurrent, Out 01" 521101 "DCU Node 4, Error Overcurrent, Out 02" 521102 "DCU Node 4, Error Overcurrent, Out 03" 521103 "DCU Node 4, Error Overcurrent, Out 04" 521104 "DCU Node 4, Error Overcurrent, Fan" 521105 "DCU Node 4, Error Overcurrent ,Encoder" 521106 "DCU Node 4, Error Overcurrent, 24V Supply" 521107 "DCU Node 4, Error, Overfrequency" 521108 "DCU Node 4, Error Reset, Internal Overheat Control Board" 521109 "DCU Node 4, Error, Internal Overheat, Control Board" 521110 "DCU Node 4, Error, Ramp OH" 521111 "DCU Node 4, Error, Ramp OHI" 521112 "DCU Node 4, Error 24V Supply Undervoltage" 521113 "DCU Node 4, Error STO signals" 521114 "DCU Node 4, Error Ext. 24V Supply Undervoltage" 521115 "DCU Node 4, Error GTR7 Always OFF" 521116 "DCU Node 4, Error GTR7 OC" 521117 "DCU Node 4, Error GTR7 Always ON" 521118 "DCU Node 4, OC at 5V Diagnostic" 521119 "DCU Node 4, Error, Extreme Overpotential" 521120 "DCU Node 4, Error, DC Capacitor Damaged" 521121 "DCU Node 4, status not available" 521122 "DCU Node 4, status not available" 521123 "DCU Node 4, status not available" 521124 "DCU Node 4, status not available" 521125 "DCU Node 4, status not available" 521126 "DCU Node 4, status not available" 521127 "DCU Node 4, status not available" 521128 "DCU Node 4, status not available" 521129 "DCU Node 4, status not available" 521130 "DCU Node 4, status not available" 521131 "DCU Node 4, status not available" 521132 "DCU Node 4, status not available" 521133 "DCU Node 4, status not available" 521134 "DCU Node 4, status not available" 521135 "DCU Node 4, status not available" 521300 "App Node 4, No error" 521301 "App Node 4, No axis" 521302 "App Node 4, Error reading mapping" 521303 "App Node 4, Error reading rated current" 521304 "App Node 4, Error rated current mismatch" 521305 "App Node 4, Error write pll offset" 521306 "App Node 4, Error auto mapping" 521307 "App Node 4, Error interlink communication" 521308 "App Node 4, Error overload parameter" 521309 "App Node 4, Incompatible default download" 521310 "App Node 4, Error downloading default download" 521311 "App Node 4, Default download not found" 521312 "App Node 4, Error CAN data timeout" 521313 "App Node 4, Error CAN data invalid" 521314 "App Node 4, Invalid license" 521315 "App Node 4, Error reinitializing app" 521319 "App Node 4, General application error" 522000 "DCU Node 5, No Error" 522001 "DCU Node 5, status not available" 522002 "DCU Node 5, status not available" 522003 "DCU Node 5, Error, Overcurrent Power Unit" 522004 "DCU Node 5, Error, Overcurrent Analog" 522005 "DCU Node 5, Error, Overvoltage DC Link" 522006 "DCU Node 5, Error, Undervoltage DC Link" 522007 "DCU Node 5, Error, Overload" 522008 "DCU Node 5, Reset Error, Overload" 522009 "DCU Node 5, Error, Overload 02" 522010 "DCU Node 5, Error, Power Module Overheat" 522011 "DCU Node 5, Reset Error, Power Module Overheat" 522012 "DCU Node 5, Error, Internal Power Unit Overheat" 522013 "DCU Node 5, Reset Error, Internal Power Unit Overheat" 522014 "DCU Node 5, Error, Motor Protection" 522015 "DCU Node 5, Reset Error, Motor Protection" 522016 "DCU Node 5, Error, Drive Overheat" 522017 "DCU Node 5, Reset Error, Drive Overheat" 522018 "DCU Node 5, Error, Overspeed" 522019 "DCU Node 5, status not available" 522020 "DCU Node 5, Error, Drive Data" 522021 "DCU Node 5, Error, Motor Data Not Stored" 522022 "DCU Node 5, Error, Indentification" 522023 "DCU Node 5, Error, Speed Difference" 522024 "DCU Node 5, Error, Fieldbus Memory" 522025 "DCU Node 5, status not available" 522026 "DCU Node 5, status not available" 522027 "DCU Node 5, status not available" 522028 "DCU Node 5, status not available" 522029 "DCU Node 5, status not available" 522030 "DCU Node 5, status not available" 522031 "DCU Node 5, status not available" 522032 "DCU Node 5, status not available" 522033 "DCU Node 5, status not available" 522034 "DCU Node 5, status not available" 522035 "DCU Node 5, status not available" 522036 "DCU Node 5, status not available" 522037 "DCU Node 5, status not available" 522038 "DCU Node 5, Error, Memory Size" 522039 "DCU Node 5, Error, Power Unit Software Version" 522040 "DCU Node 5, Error, FPGA Config" 522041 "DCU Node 5, status not available" 522042 "DCU Node 5, status not available" 522043 "DCU Node 5, Error, Encoder Interface Communication" 522044 "DCU Node 5, Error, Invlid Data, Power Unit" 522045 "DCU Node 5, status not available" 522046 "DCU Node 5, status not available" 522047 "DCU Node 5, status not available" 522048 "DCU Node 5, status not available" 522049 "DCU Node 5, status not available" 522050 "DCU Node 5, status not available" 522051 "DCU Node 5, status not available" 522052 "DCU Node 5, Error, Phase Undervoltage" 522053 "DCU Node 5, Error, Rotor Detection Current" 522054 "DCU Node 5, status not available" 522055 "DCU Node 5, status not available" 522056 "DCU Node 5, Error, SW Switch Left" 522057 "DCU Node 5, Error, SW Switch Right" 522058 "DCU Node 5, Error, Fieldbus Watchdog Response" 522059 "DCU Node 5, Error, Prog. Input" 522060 "DCU Node 5, status not available" 522061 "DCU Node 5, status not available" 522062 "DCU Node 5, Error, Power Unit Changed" 522063 "DCU Node 5, Error, Encoder Interface Changed" 522064 "DCU Node 5, Error, Power Unit Type Changed" 522065 "DCU Node 5, Error, Invalid Ver., Encoder Interface" 522066 "DCU Node 5, Error, Overcurrent" 522067 "DCU Node 5, Error, Max Accel/Decel Setting Exceeded" 522068 "DCU Node 5, Error, Overcurrent Brake" 522069 "DCU Node 5, Error, Power Unit" 522070 "DCU Node 5, status not available" 522071 "DCU Node 5, status not available" 522072 "DCU Node 5, status not available" 522073 "DCU Node 5, status not available" 522074 "DCU Node 5, status not available" 522075 "DCU Node 5, status not available" 522076 "DCU Node 5, status not available" 522077 "DCU Node 5, status not available" 522078 "DCU Node 5, status not available" 522079 "DCU Node 5, status not available" 522080 "DCU Node 5, status not available" 522081 "DCU Node 5, Error, Rotor Detection, Five Step" 522082 "DCU Node 5, Error, Rotor Detection, Ld equal Lq" 522083 "DCU Node 5, Error, Limit Switch Forward" 522084 "DCU Node 5, Error, Limit Switch Reverse" 522085 "DCU Node 5, Error, Limit Switch Override Forward" 522086 "DCU Node 5, Error, Limit Switch Override Reverse" 522087 "DCU Node 5, Error Limit Switch" 522088 "DCU Node 5, Error, Power Off End" 522089 "DCU Node 5, Error, Encoder Type Change" 522090 "DCU Node 5, Error, Control Board Communication" 522091 "DCU Node 5, INIT, Encoder Interface" 522092 "DCU Node 5, status not available" 522093 "DCU Node 5, status not available" 522094 "DCU Node 5, status not available" 522095 "DCU Node 5, status not available" 522096 "DCU Node 5, Error, Encoder Missing" 522097 "DCU Node 5, Error, Overspeed (EMF)" 522098 "DCU Node 5, Error, Encoder A Changed" 522099 "DCU Node 5, Error, Encoder B Changed" 522100 "DCU Node 5, Error Overcurrent, Out 01" 522101 "DCU Node 5, Error Overcurrent, Out 02" 522102 "DCU Node 5, Error Overcurrent, Out 03" 522103 "DCU Node 5, Error Overcurrent, Out 04" 522104 "DCU Node 5, Error Overcurrent, Fan" 522105 "DCU Node 5, Error Overcurrent ,Encoder" 522106 "DCU Node 5, Error Overcurrent, 24V Supply" 522107 "DCU Node 5, Error, Overfrequency" 522108 "DCU Node 5, Error Reset, Internal Overheat Control Board" 522109 "DCU Node 5, Error, Internal Overheat, Control Board" 522110 "DCU Node 5, Error, Ramp OH" 522111 "DCU Node 5, Error, Ramp OHI" 522112 "DCU Node 5, Error 24V Supply Undervoltage" 522113 "DCU Node 5, Error STO signals" 522114 "DCU Node 5, Error Ext. 24V Supply Undervoltage" 522115 "DCU Node 5, Error GTR7 Always OFF" 522116 "DCU Node 5, Error GTR7 OC" 522117 "DCU Node 5, Error GTR7 Always ON" 522118 "DCU Node 5, OC at 5V Diagnostic" 522119 "DCU Node 5, Error, Extreme Overpotential" 522120 "DCU Node 5, Error, DC Capacitor Damaged" 522121 "DCU Node 5, status not available" 522122 "DCU Node 5, status not available" 522123 "DCU Node 5, status not available" 522124 "DCU Node 5, status not available" 522125 "DCU Node 5, status not available" 522126 "DCU Node 5, status not available" 522127 "DCU Node 5, status not available" 522128 "DCU Node 5, status not available" 522129 "DCU Node 5, status not available" 522130 "DCU Node 5, status not available" 522131 "DCU Node 5, status not available" 522132 "DCU Node 5, status not available" 522133 "DCU Node 5, status not available" 522134 "DCU Node 5, status not available" 522135 "DCU Node 5, status not available" 522300 "App Node 5, No error" 522301 "App Node 5, No axis" 522302 "App Node 5, Error reading mapping" 522303 "App Node 5, Error reading rated current" 522304 "App Node 5, Error rated current mismatch" 522305 "App Node 5, Error write pll offset" 522306 "App Node 5, Error auto mapping" 522307 "App Node 5, Error interlink communication" 522308 "App Node 5, Error overload parameter" 522309 "App Node 5, Incompatible default download" 522310 "App Node 5, Error downloading default download" 522311 "App Node 5, Default download not found" 522312 "App Node 5, Error CAN data timeout" 522313 "App Node 5, Error CAN data invalid" 522314 "App Node 5, Invalid license" 522315 "App Node 5, Error reinitializing app" 522319 "App Node 5, General application error" 523000 "DCU Node 6, No Error" 523001 "DCU Node 6, status not available" 523002 "DCU Node 6, status not available" 523003 "DCU Node 6, Error, Overcurrent Power Unit" 523004 "DCU Node 6, Error, Overcurrent Analog" 523005 "DCU Node 6, Error, Overvoltage DC Link" 523006 "DCU Node 6, Error, Undervoltage DC Link" 523007 "DCU Node 6, Error, Overload" 523008 "DCU Node 6, Reset Error, Overload" 523009 "DCU Node 6, Error, Overload 02" 523010 "DCU Node 6, Error, Power Module Overheat" 523011 "DCU Node 6, Reset Error, Power Module Overheat" 523012 "DCU Node 6, Error, Internal Power Unit Overheat" 523013 "DCU Node 6, Reset Error, Internal Power Unit Overheat" 523014 "DCU Node 6, Error, Motor Protection" 523015 "DCU Node 6, Reset Error, Motor Protection" 523016 "DCU Node 6, Error, Drive Overheat" 523017 "DCU Node 6, Reset Error, Drive Overheat" 523018 "DCU Node 6, Error, Overspeed" 523019 "DCU Node 6, status not available" 523020 "DCU Node 6, Error, Drive Data" 523021 "DCU Node 6, Error, Motor Data Not Stored" 523022 "DCU Node 6, Error, Indentification" 523023 "DCU Node 6, Error, Speed Difference" 523024 "DCU Node 6, Error, Fieldbus Memory" 523025 "DCU Node 6, status not available" 523026 "DCU Node 6, status not available" 523027 "DCU Node 6, status not available" 523028 "DCU Node 6, status not available" 523029 "DCU Node 6, status not available" 523030 "DCU Node 6, status not available" 523031 "DCU Node 6, status not available" 523032 "DCU Node 6, status not available" 523033 "DCU Node 6, status not available" 523034 "DCU Node 6, status not available" 523035 "DCU Node 6, status not available" 523036 "DCU Node 6, status not available" 523037 "DCU Node 6, status not available" 523038 "DCU Node 6, Error, Memory Size" 523039 "DCU Node 6, Error, Power Unit Software Version" 523040 "DCU Node 6, Error, FPGA Config" 523041 "DCU Node 6, status not available" 523042 "DCU Node 6, status not available" 523043 "DCU Node 6, Error, Encoder Interface Communication" 523044 "DCU Node 6, Error, Invlid Data, Power Unit" 523045 "DCU Node 6, status not available" 523046 "DCU Node 6, status not available" 523047 "DCU Node 6, status not available" 523048 "DCU Node 6, status not available" 523049 "DCU Node 6, status not available" 523050 "DCU Node 6, status not available" 523051 "DCU Node 6, status not available" 523052 "DCU Node 6, Error, Phase Undervoltage" 523053 "DCU Node 6, Error, Rotor Detection Current" 523054 "DCU Node 6, status not available" 523055 "DCU Node 6, status not available" 523056 "DCU Node 6, Error, SW Switch Left" 523057 "DCU Node 6, Error, SW Switch Right" 523058 "DCU Node 6, Error, Fieldbus Watchdog Response" 523059 "DCU Node 6, Error, Prog. Input" 523060 "DCU Node 6, status not available" 523061 "DCU Node 6, status not available" 523062 "DCU Node 6, Error, Power Unit Changed" 523063 "DCU Node 6, Error, Encoder Interface Changed" 523064 "DCU Node 6, Error, Power Unit Type Changed" 523065 "DCU Node 6, Error, Invalid Ver., Encoder Interface" 523066 "DCU Node 6, Error, Overcurrent" 523067 "DCU Node 6, Error, Max Accel/Decel Setting Exceeded" 523068 "DCU Node 6, Error, Overcurrent Brake" 523069 "DCU Node 6, Error, Power Unit" 523070 "DCU Node 6, status not available" 523071 "DCU Node 6, status not available" 523072 "DCU Node 6, status not available" 523073 "DCU Node 6, status not available" 523074 "DCU Node 6, status not available" 523075 "DCU Node 6, status not available" 523076 "DCU Node 6, status not available" 523077 "DCU Node 6, status not available" 523078 "DCU Node 6, status not available" 523079 "DCU Node 6, status not available" 523080 "DCU Node 6, status not available" 523081 "DCU Node 6, Error, Rotor Detection, Five Step" 523082 "DCU Node 6, Error, Rotor Detection, Ld equal Lq" 523083 "DCU Node 6, Error, Limit Switch Forward" 523084 "DCU Node 6, Error, Limit Switch Reverse" 523085 "DCU Node 6, Error, Limit Switch Override Forward" 523086 "DCU Node 6, Error, Limit Switch Override Reverse" 523087 "DCU Node 6, Error Limit Switch" 523088 "DCU Node 6, Error, Power Off End" 523089 "DCU Node 6, Error, Encoder Type Change" 523090 "DCU Node 6, Error, Control Board Communication" 523091 "DCU Node 6, INIT, Encoder Interface" 523092 "DCU Node 6, status not available" 523093 "DCU Node 6, status not available" 523094 "DCU Node 6, status not available" 523095 "DCU Node 6, status not available" 523096 "DCU Node 6, Error, Encoder Missing" 523097 "DCU Node 6, Error, Overspeed (EMF)" 523098 "DCU Node 6, Error, Encoder A Changed" 523099 "DCU Node 6, Error, Encoder B Changed" 523100 "DCU Node 6, Error Overcurrent, Out 01" 523101 "DCU Node 6, Error Overcurrent, Out 02" 523102 "DCU Node 6, Error Overcurrent, Out 03" 523103 "DCU Node 6, Error Overcurrent, Out 04" 523104 "DCU Node 6, Error Overcurrent, Fan" 523105 "DCU Node 6, Error Overcurrent ,Encoder" 523106 "DCU Node 6, Error Overcurrent, 24V Supply" 523107 "DCU Node 6, Error, Overfrequency" 523108 "DCU Node 6, Error Reset, Internal Overheat Control Board" 523109 "DCU Node 6, Error, Internal Overheat, Control Board" 523110 "DCU Node 6, Error, Ramp OH" 523111 "DCU Node 6, Error, Ramp OHI" 523112 "DCU Node 6, Error 24V Supply Undervoltage" 523113 "DCU Node 6, Error STO signals" 523114 "DCU Node 6, Error Ext. 24V Supply Undervoltage" 523115 "DCU Node 6, Error GTR7 Always OFF" 523116 "DCU Node 6, Error GTR7 OC" 523117 "DCU Node 6, Error GTR7 Always ON" 523118 "DCU Node 6, OC at 5V Diagnostic" 523119 "DCU Node 6, Error, Extreme Overpotential" 523120 "DCU Node 6, Error, DC Capacitor Damaged" 523121 "DCU Node 6, status not available" 523122 "DCU Node 6, status not available" 523123 "DCU Node 6, status not available" 523124 "DCU Node 6, status not available" 523125 "DCU Node 6, status not available" 523126 "DCU Node 6, status not available" 523127 "DCU Node 6, status not available" 523128 "DCU Node 6, status not available" 523129 "DCU Node 6, status not available" 523130 "DCU Node 6, status not available" 523131 "DCU Node 6, status not available" 523132 "DCU Node 6, status not available" 523133 "DCU Node 6, status not available" 523134 "DCU Node 6, status not available" 523135 "DCU Node 6, status not available" 523300 "App Node 6, No error" 523301 "App Node 6, No axis" 523302 "App Node 6, Error reading mapping" 523303 "App Node 6, Error reading rated current" 523304 "App Node 6, Error rated current mismatch" 523305 "App Node 6, Error write pll offset" 523306 "App Node 6, Error auto mapping" 523307 "App Node 6, Error interlink communication" 523308 "App Node 6, Error overload parameter" 523309 "App Node 6, Incompatible default download" 523310 "App Node 6, Error downloading default download" 523311 "App Node 6, Default download not found" 523312 "App Node 6, Error CAN data timeout" 523313 "App Node 6, Error CAN data invalid" 523314 "App Node 6, Invalid license" 523315 "App Node 6, Error reinitializing app" 523319 "App Node 6, General application error" ;
