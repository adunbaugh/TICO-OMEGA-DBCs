VERSION ""

NS_ :

BS_:

BU_: BMS_Controller NF_Controller NF_Controllers

BO_ 2499762788 BATT_Diagnostic_Pack_B: 8 BMS_Controller
 SG_ BATT_01_SenseBrickImpHigh m0 : 2|2@1+ (1,0) [0|3] ""  NF_Controller
 SG_ BATT_01_AFEfault m0 : 0|2@1+ (1,0) [0|3] ""  NF_Controller
 SG_ BATT_01_AFEerror m0 : 14|2@1+ (1,0) [0|3] ""  NF_Controller
 SG_ BATT_01_HostMIA m0 : 12|2@1+ (1,0) [0|3] ""  NF_Controller
 SG_ BATT_01_TempAmbientOverSev m0 : 10|2@1+ (1,0) [0|3] ""  NF_Controller
 SG_ BATT_01_TempAmbientOverMod m0 : 8|2@1+ (1,0) [0|3] ""  NF_Controller
 SG_ BATT_01_TempAmbientOverWar m0 : 22|2@1+ (1,0) [0|3] ""  NF_Controller
 SG_ BATT_01_AbnormReset m0 : 20|2@1+ (1,0) [0|3] ""  NF_Controller
 SG_ BATT_01_SenseloadVoltErrorPri m0 : 18|2@1+ (1,0) [0|3] ""  NF_Controller
 SG_ BATT_01_CalibrationInvalid m0 : 16|2@1+ (1,0) [0|3] ""  NF_Controller
 SG_ BATT_01_TaskLockup m0 : 30|2@1+ (1,0) [0|3] ""  NF_Controller
 SG_ BATT_01_RAMover m0 : 28|2@1+ (1,0) [0|3] ""  NF_Controller
 SG_ BATT_01_BrickOverdischarge m0 : 26|2@1+ (1,0) [0|3] ""  NF_Controller
 SG_ BATT_01_BrickOvercharge m0 : 24|2@1+ (1,0) [0|3] ""  NF_Controller
 SG_ BATT_01_vBrickImbalance m0 : 38|2@1+ (1,0) [0|3] ""  NF_Controller
 SG_ BATT_01_TempBrickImbalance m0 : 36|2@1+ (1,0) [0|3] ""  NF_Controller
 SG_ BATT_01_CapPackLow m0 : 34|2@1+ (1,0) [0|3] ""  NF_Controller
 SG_ BATT_01_rBrickHigh m0 : 32|2@1+ (1,0) [0|3] ""  NF_Controller
 SG_ BATT_01_PowerpackInsuffErr m0 : 46|2@1+ (1,0) [0|3] ""  NF_Controller
 SG_ BATT_01_BrickSoftShort m0 : 44|2@1+ (1,0) [0|3] ""  NF_Controller
 SG_ BATT_01_chargeUndercurrent m0 : 42|2@1+ (1,0) [0|3] ""  NF_Controller
 SG_ BATT_01_HVILcurrentSourceError m0 : 40|2@1+ (1,0) [0|3] ""  NF_Controller
 SG_ BATT_01_SRS m0 : 54|2@1+ (1,0) [0|3] ""  NF_Controller
 SG_ BATT_01_IsolationExtWar m0 : 52|2@1+ (1,0) [0|3] ""  NF_Controller
 SG_ BATT_01_IsolationIntWar m0 : 50|2@1+ (1,0) [0|3] ""  NF_Controller
 SG_ BATT_01_PyroFuseBlown m0 : 48|2@1+ (1,0) [0|3] ""  NF_Controller
 SG_ BATT_01_vBrickUnderSev m0 : 62|2@1+ (1,0) [0|3] ""  NF_Controller
 SG_ BATT_01_chargePrechargeTimeout m0 : 60|2@1+ (1,0) [0|3] ""  NF_Controller
 SG_ BATT_01_ModuleThermFaultModerate m0 : 58|2@1+ (1,0) [0|3] ""  NF_Controller
 SG_ BATT_01_ModuleThermFaultWarning m0 : 56|2@1+ (1,0) [0|3] ""  NF_Controller
 SG_ BATT_02_SenseBrickImpHigh m1 : 2|2@1+ (1,0) [0|3] ""  NF_Controller
 SG_ BATT_02_AFEfault m1 : 0|2@1+ (1,0) [0|3] ""  NF_Controller
 SG_ BATT_02_AFEerror m1 : 14|2@1+ (1,0) [0|3] ""  NF_Controller
 SG_ BATT_02_HostMIA m1 : 12|2@1+ (1,0) [0|3] ""  NF_Controller
 SG_ BATT_02_TempAmbientOverSev m1 : 10|2@1+ (1,0) [0|3] ""  NF_Controller
 SG_ BATT_02_TempAmbientOverMod m1 : 8|2@1+ (1,0) [0|3] ""  NF_Controller
 SG_ BATT_02_TempAmbientOverWar m1 : 22|2@1+ (1,0) [0|3] ""  NF_Controller
 SG_ BATT_02_AbnormReset m1 : 20|2@1+ (1,0) [0|3] ""  NF_Controller
 SG_ BATT_02_SenseloadVoltErrorPri m1 : 18|2@1+ (1,0) [0|3] ""  NF_Controller
 SG_ BATT_02_CalibrationInvalid m1 : 16|2@1+ (1,0) [0|3] ""  NF_Controller
 SG_ BATT_02_TaskLockup m1 : 30|2@1+ (1,0) [0|3] ""  NF_Controller
 SG_ BATT_02_RAMover m1 : 28|2@1+ (1,0) [0|3] ""  NF_Controller
 SG_ BATT_02_BrickOverdischarge m1 : 26|2@1+ (1,0) [0|3] ""  NF_Controller
 SG_ BATT_02_BrickOvercharge m1 : 24|2@1+ (1,0) [0|3] ""  NF_Controller
 SG_ BATT_02_vBrickImbalance m1 : 38|2@1+ (1,0) [0|3] ""  NF_Controller
 SG_ BATT_02_TempBrickImbalance m1 : 36|2@1+ (1,0) [0|3] ""  NF_Controller
 SG_ BATT_02_CapPackLow m1 : 34|2@1+ (1,0) [0|3] ""  NF_Controller
 SG_ BATT_02_rBrickHigh m1 : 32|2@1+ (1,0) [0|3] ""  NF_Controller
 SG_ BATT_02_PowerpackInsuffErr m1 : 46|2@1+ (1,0) [0|3] ""  NF_Controller
 SG_ BATT_02_BrickSoftShort m1 : 44|2@1+ (1,0) [0|3] ""  NF_Controller
 SG_ BATT_02_chargeUndercurrent m1 : 42|2@1+ (1,0) [0|3] ""  NF_Controller
 SG_ BATT_02_HVILcurrentSourceError m1 : 40|2@1+ (1,0) [0|3] ""  NF_Controller
 SG_ BATT_02_SRS m1 : 54|2@1+ (1,0) [0|3] ""  NF_Controller
 SG_ BATT_02_IsolationExtWar m1 : 52|2@1+ (1,0) [0|3] ""  NF_Controller
 SG_ BATT_02_IsolationIntWar m1 : 50|2@1+ (1,0) [0|3] ""  NF_Controller
 SG_ BATT_02_PyroFuseBlown m1 : 48|2@1+ (1,0) [0|3] ""  NF_Controller
 SG_ BATT_02_vBrickUnderSev m1 : 62|2@1+ (1,0) [0|3] ""  NF_Controller
 SG_ BATT_02_chargePrechargeTimeout m1 : 60|2@1+ (1,0) [0|3] ""  NF_Controller
 SG_ BATT_02_ModuleThermFaultModerate m1 : 58|2@1+ (1,0) [0|3] ""  NF_Controller
 SG_ BATT_02_ModuleThermFaultWarning m1 : 56|2@1+ (1,0) [0|3] ""  NF_Controller
 SG_ BATT_03_SenseBrickImpHigh m2 : 2|2@1+ (1,0) [0|3] ""  NF_Controller
 SG_ BATT_03_AFEfault m2 : 0|2@1+ (1,0) [0|3] ""  NF_Controller
 SG_ BATT_03_AFEerror m2 : 14|2@1+ (1,0) [0|3] ""  NF_Controller
 SG_ BATT_03_HostMIA m2 : 12|2@1+ (1,0) [0|3] ""  NF_Controller
 SG_ BATT_03_TempAmbientOverSev m2 : 10|2@1+ (1,0) [0|3] ""  NF_Controller
 SG_ BATT_03_TempAmbientOverMod m2 : 8|2@1+ (1,0) [0|3] ""  NF_Controller
 SG_ BATT_03_TempAmbientOverWar m2 : 22|2@1+ (1,0) [0|3] ""  NF_Controller
 SG_ BATT_03_AbnormReset m2 : 20|2@1+ (1,0) [0|3] ""  NF_Controller
 SG_ BATT_03_SenseloadVoltErrorPri m2 : 18|2@1+ (1,0) [0|3] ""  NF_Controller
 SG_ BATT_03_CalibrationInvalid m2 : 16|2@1+ (1,0) [0|3] ""  NF_Controller
 SG_ BATT_03_TaskLockup m2 : 30|2@1+ (1,0) [0|3] ""  NF_Controller
 SG_ BATT_03_RAMover m2 : 28|2@1+ (1,0) [0|3] ""  NF_Controller
 SG_ BATT_03_BrickOverdischarge m2 : 26|2@1+ (1,0) [0|3] ""  NF_Controller
 SG_ BATT_03_BrickOvercharge m2 : 24|2@1+ (1,0) [0|3] ""  NF_Controller
 SG_ BATT_03_vBrickImbalance m2 : 38|2@1+ (1,0) [0|3] ""  NF_Controller
 SG_ BATT_03_TempBrickImbalance m2 : 36|2@1+ (1,0) [0|3] ""  NF_Controller
 SG_ BATT_03_CapPackLow m2 : 34|2@1+ (1,0) [0|3] ""  NF_Controller
 SG_ BATT_03_rBrickHigh m2 : 32|2@1+ (1,0) [0|3] ""  NF_Controller
 SG_ BATT_03_PowerpackInsuffErr m2 : 46|2@1+ (1,0) [0|3] ""  NF_Controller
 SG_ BATT_03_BrickSoftShort m2 : 44|2@1+ (1,0) [0|3] ""  NF_Controller
 SG_ BATT_03_chargeUndercurrent m2 : 42|2@1+ (1,0) [0|3] ""  NF_Controller
 SG_ BATT_03_HVILcurrentSourceError m2 : 40|2@1+ (1,0) [0|3] ""  NF_Controller
 SG_ BATT_03_SRS m2 : 54|2@1+ (1,0) [0|3] ""  NF_Controller
 SG_ BATT_03_IsolationExtWar m2 : 52|2@1+ (1,0) [0|3] ""  NF_Controller
 SG_ BATT_03_IsolationIntWar m2 : 50|2@1+ (1,0) [0|3] ""  NF_Controller
 SG_ BATT_03_PyroFuseBlown m2 : 48|2@1+ (1,0) [0|3] ""  NF_Controller
 SG_ BATT_03_vBrickUnderSev m2 : 62|2@1+ (1,0) [0|3] ""  NF_Controller
 SG_ BATT_03_chargePrechargeTimeout m2 : 60|2@1+ (1,0) [0|3] ""  NF_Controller
 SG_ BATT_03_ModuleThermFaultModerate m2 : 58|2@1+ (1,0) [0|3] ""  NF_Controller
 SG_ BATT_03_ModuleThermFaultWarning m2 : 56|2@1+ (1,0) [0|3] ""  NF_Controller
 SG_ BATT_04_SenseBrickImpHigh m3 : 2|2@1+ (1,0) [0|3] ""  NF_Controller
 SG_ BATT_04_AFEfault m3 : 0|2@1+ (1,0) [0|3] ""  NF_Controller
 SG_ BATT_04_AFEerror m3 : 14|2@1+ (1,0) [0|3] ""  NF_Controller
 SG_ BATT_04_HostMIA m3 : 12|2@1+ (1,0) [0|3] ""  NF_Controller
 SG_ BATT_04_TempAmbientOverSev m3 : 10|2@1+ (1,0) [0|3] ""  NF_Controller
 SG_ BATT_04_TempAmbientOverMod m3 : 8|2@1+ (1,0) [0|3] ""  NF_Controller
 SG_ BATT_04_TempAmbientOverWar m3 : 22|2@1+ (1,0) [0|3] ""  NF_Controller
 SG_ BATT_04_AbnormReset m3 : 20|2@1+ (1,0) [0|3] ""  NF_Controller
 SG_ BATT_04_SenseloadVoltErrorPri m3 : 18|2@1+ (1,0) [0|3] ""  NF_Controller
 SG_ BATT_04_CalibrationInvalid m3 : 16|2@1+ (1,0) [0|3] ""  NF_Controller
 SG_ BATT_04_TaskLockup m3 : 30|2@1+ (1,0) [0|3] ""  NF_Controller
 SG_ BATT_04_RAMover m3 : 28|2@1+ (1,0) [0|3] ""  NF_Controller
 SG_ BATT_04_BrickOverdischarge m3 : 26|2@1+ (1,0) [0|3] ""  NF_Controller
 SG_ BATT_04_BrickOvercharge m3 : 24|2@1+ (1,0) [0|3] ""  NF_Controller
 SG_ BATT_04_vBrickImbalance m3 : 38|2@1+ (1,0) [0|3] ""  NF_Controller
 SG_ BATT_04_TempBrickImbalance m3 : 36|2@1+ (1,0) [0|3] ""  NF_Controller
 SG_ BATT_04_CapPackLow m3 : 34|2@1+ (1,0) [0|3] ""  NF_Controller
 SG_ BATT_04_rBrickHigh m3 : 32|2@1+ (1,0) [0|3] ""  NF_Controller
 SG_ BATT_04_PowerpackInsuffErr m3 : 46|2@1+ (1,0) [0|3] ""  NF_Controller
 SG_ BATT_04_BrickSoftShort m3 : 44|2@1+ (1,0) [0|3] ""  NF_Controller
 SG_ BATT_04_chargeUndercurrent m3 : 42|2@1+ (1,0) [0|3] ""  NF_Controller
 SG_ BATT_04_HVILcurrentSourceError m3 : 40|2@1+ (1,0) [0|3] ""  NF_Controller
 SG_ BATT_04_SRS m3 : 54|2@1+ (1,0) [0|3] ""  NF_Controller
 SG_ BATT_04_IsolationExtWar m3 : 52|2@1+ (1,0) [0|3] ""  NF_Controller
 SG_ BATT_04_IsolationIntWar m3 : 50|2@1+ (1,0) [0|3] ""  NF_Controller
 SG_ BATT_04_PyroFuseBlown m3 : 48|2@1+ (1,0) [0|3] ""  NF_Controller
 SG_ BATT_04_vBrickUnderSev m3 : 62|2@1+ (1,0) [0|3] ""  NF_Controller
 SG_ BATT_04_chargePrechargeTimeout m3 : 60|2@1+ (1,0) [0|3] ""  NF_Controller
 SG_ BATT_04_ModuleThermFaultModerate m3 : 58|2@1+ (1,0) [0|3] ""  NF_Controller
 SG_ BATT_04_ModuleThermFaultWarning m3 : 56|2@1+ (1,0) [0|3] ""  NF_Controller
 SG_ BATT_05_SenseBrickImpHigh m4 : 2|2@1+ (1,0) [0|3] ""  NF_Controller
 SG_ BATT_05_AFEfault m4 : 0|2@1+ (1,0) [0|3] ""  NF_Controller
 SG_ BATT_05_AFEerror m4 : 14|2@1+ (1,0) [0|3] ""  NF_Controller
 SG_ BATT_05_HostMIA m4 : 12|2@1+ (1,0) [0|3] ""  NF_Controller
 SG_ BATT_05_TempAmbientOverSev m4 : 10|2@1+ (1,0) [0|3] ""  NF_Controller
 SG_ BATT_05_TempAmbientOverMod m4 : 8|2@1+ (1,0) [0|3] ""  NF_Controller
 SG_ BATT_05_TempAmbientOverWar m4 : 22|2@1+ (1,0) [0|3] ""  NF_Controller
 SG_ BATT_05_AbnormReset m4 : 20|2@1+ (1,0) [0|3] ""  NF_Controller
 SG_ BATT_05_SenseloadVoltErrorPri m4 : 18|2@1+ (1,0) [0|3] ""  NF_Controller
 SG_ BATT_05_CalibrationInvalid m4 : 16|2@1+ (1,0) [0|3] ""  NF_Controller
 SG_ BATT_05_TaskLockup m4 : 30|2@1+ (1,0) [0|3] ""  NF_Controller
 SG_ BATT_05_RAMover m4 : 28|2@1+ (1,0) [0|3] ""  NF_Controller
 SG_ BATT_05_BrickOverdischarge m4 : 26|2@1+ (1,0) [0|3] ""  NF_Controller
 SG_ BATT_05_BrickOvercharge m4 : 24|2@1+ (1,0) [0|3] ""  NF_Controller
 SG_ BATT_05_vBrickImbalance m4 : 38|2@1+ (1,0) [0|3] ""  NF_Controller
 SG_ BATT_05_TempBrickImbalance m4 : 36|2@1+ (1,0) [0|3] ""  NF_Controller
 SG_ BATT_05_CapPackLow m4 : 34|2@1+ (1,0) [0|3] ""  NF_Controller
 SG_ BATT_05_rBrickHigh m4 : 32|2@1+ (1,0) [0|3] ""  NF_Controller
 SG_ BATT_05_PowerpackInsuffErr m4 : 46|2@1+ (1,0) [0|3] ""  NF_Controller
 SG_ BATT_05_BrickSoftShort m4 : 44|2@1+ (1,0) [0|3] ""  NF_Controller
 SG_ BATT_05_chargeUndercurrent m4 : 42|2@1+ (1,0) [0|3] ""  NF_Controller
 SG_ BATT_05_HVILcurrentSourceError m4 : 40|2@1+ (1,0) [0|3] ""  NF_Controller
 SG_ BATT_05_SRS m4 : 54|2@1+ (1,0) [0|3] ""  NF_Controller
 SG_ BATT_05_IsolationExtWar m4 : 52|2@1+ (1,0) [0|3] ""  NF_Controller
 SG_ BATT_05_IsolationIntWar m4 : 50|2@1+ (1,0) [0|3] ""  NF_Controller
 SG_ BATT_05_PyroFuseBlown m4 : 48|2@1+ (1,0) [0|3] ""  NF_Controller
 SG_ BATT_05_vBrickUnderSev m4 : 62|2@1+ (1,0) [0|3] ""  NF_Controller
 SG_ BATT_05_chargePrechargeTimeout m4 : 60|2@1+ (1,0) [0|3] ""  NF_Controller
 SG_ BATT_05_ModuleThermFaultModerate m4 : 58|2@1+ (1,0) [0|3] ""  NF_Controller
 SG_ BATT_05_ModuleThermFaultWarning m4 : 56|2@1+ (1,0) [0|3] ""  NF_Controller
 SG_ BATT_06_SenseBrickImpHigh m5 : 2|2@1+ (1,0) [0|3] ""  NF_Controller
 SG_ BATT_06_AFEfault m5 : 0|2@1+ (1,0) [0|3] ""  NF_Controller
 SG_ BATT_06_AFEerror m5 : 14|2@1+ (1,0) [0|3] ""  NF_Controller
 SG_ BATT_06_HostMIA m5 : 12|2@1+ (1,0) [0|3] ""  NF_Controller
 SG_ BATT_06_TempAmbientOverSev m5 : 10|2@1+ (1,0) [0|3] ""  NF_Controller
 SG_ BATT_06_TempAmbientOverMod m5 : 8|2@1+ (1,0) [0|3] ""  NF_Controller
 SG_ BATT_06_TempAmbientOverWar m5 : 22|2@1+ (1,0) [0|3] ""  NF_Controller
 SG_ BATT_06_AbnormReset m5 : 20|2@1+ (1,0) [0|3] ""  NF_Controller
 SG_ BATT_06_SenseloadVoltErrorPri m5 : 18|2@1+ (1,0) [0|3] ""  NF_Controller
 SG_ BATT_06_CalibrationInvalid m5 : 16|2@1+ (1,0) [0|3] ""  NF_Controller
 SG_ BATT_06_TaskLockup m5 : 30|2@1+ (1,0) [0|3] ""  NF_Controller
 SG_ BATT_06_RAMover m5 : 28|2@1+ (1,0) [0|3] ""  NF_Controller
 SG_ BATT_06_BrickOverdischarge m5 : 26|2@1+ (1,0) [0|3] ""  NF_Controller
 SG_ BATT_06_BrickOvercharge m5 : 24|2@1+ (1,0) [0|3] ""  NF_Controller
 SG_ BATT_06_vBrickImbalance m5 : 38|2@1+ (1,0) [0|3] ""  NF_Controller
 SG_ BATT_06_TempBrickImbalance m5 : 36|2@1+ (1,0) [0|3] ""  NF_Controller
 SG_ BATT_06_CapPackLow m5 : 34|2@1+ (1,0) [0|3] ""  NF_Controller
 SG_ BATT_06_rBrickHigh m5 : 32|2@1+ (1,0) [0|3] ""  NF_Controller
 SG_ BATT_06_PowerpackInsuffErr m5 : 46|2@1+ (1,0) [0|3] ""  NF_Controller
 SG_ BATT_06_BrickSoftShort m5 : 44|2@1+ (1,0) [0|3] ""  NF_Controller
 SG_ BATT_06_chargeUndercurrent m5 : 42|2@1+ (1,0) [0|3] ""  NF_Controller
 SG_ BATT_06_HVILcurrentSourceError m5 : 40|2@1+ (1,0) [0|3] ""  NF_Controller
 SG_ BATT_06_SRS m5 : 54|2@1+ (1,0) [0|3] ""  NF_Controller
 SG_ BATT_06_IsolationExtWar m5 : 52|2@1+ (1,0) [0|3] ""  NF_Controller
 SG_ BATT_06_IsolationIntWar m5 : 50|2@1+ (1,0) [0|3] ""  NF_Controller
 SG_ BATT_06_PyroFuseBlown m5 : 48|2@1+ (1,0) [0|3] ""  NF_Controller
 SG_ BATT_06_vBrickUnderSev m5 : 62|2@1+ (1,0) [0|3] ""  NF_Controller
 SG_ BATT_06_chargePrechargeTimeout m5 : 60|2@1+ (1,0) [0|3] ""  NF_Controller
 SG_ BATT_06_ModuleThermFaultModerate m5 : 58|2@1+ (1,0) [0|3] ""  NF_Controller
 SG_ BATT_06_ModuleThermFaultWarning m5 : 56|2@1+ (1,0) [0|3] ""  NF_Controller
 SG_ BATT_07_SenseBrickImpHigh m6 : 2|2@1+ (1,0) [0|3] ""  NF_Controller
 SG_ BATT_07_AFEfault m6 : 0|2@1+ (1,0) [0|3] ""  NF_Controller
 SG_ BATT_07_AFEerror m6 : 14|2@1+ (1,0) [0|3] ""  NF_Controller
 SG_ BATT_07_HostMIA m6 : 12|2@1+ (1,0) [0|3] ""  NF_Controller
 SG_ BATT_07_TempAmbientOverSev m6 : 10|2@1+ (1,0) [0|3] ""  NF_Controller
 SG_ BATT_07_TempAmbientOverMod m6 : 8|2@1+ (1,0) [0|3] ""  NF_Controller
 SG_ BATT_07_TempAmbientOverWar m6 : 22|2@1+ (1,0) [0|3] ""  NF_Controller
 SG_ BATT_07_AbnormReset m6 : 20|2@1+ (1,0) [0|3] ""  NF_Controller
 SG_ BATT_07_SenseloadVoltErrorPri m6 : 18|2@1+ (1,0) [0|3] ""  NF_Controller
 SG_ BATT_07_CalibrationInvalid m6 : 16|2@1+ (1,0) [0|3] ""  NF_Controller
 SG_ BATT_07_TaskLockup m6 : 30|2@1+ (1,0) [0|3] ""  NF_Controller
 SG_ BATT_07_RAMover m6 : 28|2@1+ (1,0) [0|3] ""  NF_Controller
 SG_ BATT_07_BrickOverdischarge m6 : 26|2@1+ (1,0) [0|3] ""  NF_Controller
 SG_ BATT_07_BrickOvercharge m6 : 24|2@1+ (1,0) [0|3] ""  NF_Controller
 SG_ BATT_07_vBrickImbalance m6 : 38|2@1+ (1,0) [0|3] ""  NF_Controller
 SG_ BATT_07_TempBrickImbalance m6 : 36|2@1+ (1,0) [0|3] ""  NF_Controller
 SG_ BATT_07_CapPackLow m6 : 34|2@1+ (1,0) [0|3] ""  NF_Controller
 SG_ BATT_07_rBrickHigh m6 : 32|2@1+ (1,0) [0|3] ""  NF_Controller
 SG_ BATT_07_PowerpackInsuffErr m6 : 46|2@1+ (1,0) [0|3] ""  NF_Controller
 SG_ BATT_07_BrickSoftShort m6 : 44|2@1+ (1,0) [0|3] ""  NF_Controller
 SG_ BATT_07_chargeUndercurrent m6 : 42|2@1+ (1,0) [0|3] ""  NF_Controller
 SG_ BATT_07_HVILcurrentSourceError m6 : 40|2@1+ (1,0) [0|3] ""  NF_Controller
 SG_ BATT_07_SRS m6 : 54|2@1+ (1,0) [0|3] ""  NF_Controller
 SG_ BATT_07_IsolationExtWar m6 : 52|2@1+ (1,0) [0|3] ""  NF_Controller
 SG_ BATT_07_IsolationIntWar m6 : 50|2@1+ (1,0) [0|3] ""  NF_Controller
 SG_ BATT_07_PyroFuseBlown m6 : 48|2@1+ (1,0) [0|3] ""  NF_Controller
 SG_ BATT_07_vBrickUnderSev m6 : 62|2@1+ (1,0) [0|3] ""  NF_Controller
 SG_ BATT_07_chargePrechargeTimeout m6 : 60|2@1+ (1,0) [0|3] ""  NF_Controller
 SG_ BATT_07_ModuleThermFaultModerate m6 : 58|2@1+ (1,0) [0|3] ""  NF_Controller
 SG_ BATT_07_ModuleThermFaultWarning m6 : 56|2@1+ (1,0) [0|3] ""  NF_Controller
 SG_ BATT_08_SenseBrickImpHigh m7 : 2|2@1+ (1,0) [0|3] ""  NF_Controller
 SG_ BATT_08_AFEfault m7 : 0|2@1+ (1,0) [0|3] ""  NF_Controller
 SG_ BATT_08_AFEerror m7 : 14|2@1+ (1,0) [0|3] ""  NF_Controller
 SG_ BATT_08_HostMIA m7 : 12|2@1+ (1,0) [0|3] ""  NF_Controller
 SG_ BATT_08_TempAmbientOverSev m7 : 10|2@1+ (1,0) [0|3] ""  NF_Controller
 SG_ BATT_08_TempAmbientOverMod m7 : 8|2@1+ (1,0) [0|3] ""  NF_Controller
 SG_ BATT_08_TempAmbientOverWar m7 : 22|2@1+ (1,0) [0|3] ""  NF_Controller
 SG_ BATT_08_AbnormReset m7 : 20|2@1+ (1,0) [0|3] ""  NF_Controller
 SG_ BATT_08_SenseloadVoltErrorPri m7 : 18|2@1+ (1,0) [0|3] ""  NF_Controller
 SG_ BATT_08_CalibrationInvalid m7 : 16|2@1+ (1,0) [0|3] ""  NF_Controller
 SG_ BATT_08_TaskLockup m7 : 30|2@1+ (1,0) [0|3] ""  NF_Controller
 SG_ BATT_08_RAMover m7 : 28|2@1+ (1,0) [0|3] ""  NF_Controller
 SG_ BATT_08_BrickOverdischarge m7 : 26|2@1+ (1,0) [0|3] ""  NF_Controller
 SG_ BATT_08_BrickOvercharge m7 : 24|2@1+ (1,0) [0|3] ""  NF_Controller
 SG_ BATT_08_vBrickImbalance m7 : 38|2@1+ (1,0) [0|3] ""  NF_Controller
 SG_ BATT_08_TempBrickImbalance m7 : 36|2@1+ (1,0) [0|3] ""  NF_Controller
 SG_ BATT_08_CapPackLow m7 : 34|2@1+ (1,0) [0|3] ""  NF_Controller
 SG_ BATT_08_rBrickHigh m7 : 32|2@1+ (1,0) [0|3] ""  NF_Controller
 SG_ BATT_08_PowerpackInsuffErr m7 : 46|2@1+ (1,0) [0|3] ""  NF_Controller
 SG_ BATT_08_BrickSoftShort m7 : 44|2@1+ (1,0) [0|3] ""  NF_Controller
 SG_ BATT_08_chargeUndercurrent m7 : 42|2@1+ (1,0) [0|3] ""  NF_Controller
 SG_ BATT_08_HVILcurrentSourceError m7 : 40|2@1+ (1,0) [0|3] ""  NF_Controller
 SG_ BATT_08_SRS m7 : 54|2@1+ (1,0) [0|3] ""  NF_Controller
 SG_ BATT_08_IsolationExtWar m7 : 52|2@1+ (1,0) [0|3] ""  NF_Controller
 SG_ BATT_08_IsolationIntWar m7 : 50|2@1+ (1,0) [0|3] ""  NF_Controller
 SG_ BATT_08_PyroFuseBlown m7 : 48|2@1+ (1,0) [0|3] ""  NF_Controller
 SG_ BATT_08_vBrickUnderSev m7 : 62|2@1+ (1,0) [0|3] ""  NF_Controller
 SG_ BATT_08_chargePrechargeTimeout m7 : 60|2@1+ (1,0) [0|3] ""  NF_Controller
 SG_ BATT_08_ModuleThermFaultModerate m7 : 58|2@1+ (1,0) [0|3] ""  NF_Controller
 SG_ BATT_08_ModuleThermFaultWarning m7 : 56|2@1+ (1,0) [0|3] ""  NF_Controller
 SG_ BATT_09_SenseBrickImpHigh m8 : 2|2@1+ (1,0) [0|3] ""  NF_Controller
 SG_ BATT_09_AFEfault m8 : 0|2@1+ (1,0) [0|3] ""  NF_Controller
 SG_ BATT_09_AFEerror m8 : 14|2@1+ (1,0) [0|3] ""  NF_Controller
 SG_ BATT_09_HostMIA m8 : 12|2@1+ (1,0) [0|3] ""  NF_Controller
 SG_ BATT_09_TempAmbientOverSev m8 : 10|2@1+ (1,0) [0|3] ""  NF_Controller
 SG_ BATT_09_TempAmbientOverMod m8 : 8|2@1+ (1,0) [0|3] ""  NF_Controller
 SG_ BATT_09_TempAmbientOverWar m8 : 22|2@1+ (1,0) [0|3] ""  NF_Controller
 SG_ BATT_09_AbnormReset m8 : 20|2@1+ (1,0) [0|3] ""  NF_Controller
 SG_ BATT_09_SenseloadVoltErrorPri m8 : 18|2@1+ (1,0) [0|3] ""  NF_Controller
 SG_ BATT_09_CalibrationInvalid m8 : 16|2@1+ (1,0) [0|3] ""  NF_Controller
 SG_ BATT_09_TaskLockup m8 : 30|2@1+ (1,0) [0|3] ""  NF_Controller
 SG_ BATT_09_RAMover m8 : 28|2@1+ (1,0) [0|3] ""  NF_Controller
 SG_ BATT_09_BrickOverdischarge m8 : 26|2@1+ (1,0) [0|3] ""  NF_Controller
 SG_ BATT_09_BrickOvercharge m8 : 24|2@1+ (1,0) [0|3] ""  NF_Controller
 SG_ BATT_09_vBrickImbalance m8 : 38|2@1+ (1,0) [0|3] ""  NF_Controller
 SG_ BATT_09_TempBrickImbalance m8 : 36|2@1+ (1,0) [0|3] ""  NF_Controller
 SG_ BATT_09_CapPackLow m8 : 34|2@1+ (1,0) [0|3] ""  NF_Controller
 SG_ BATT_09_rBrickHigh m8 : 32|2@1+ (1,0) [0|3] ""  NF_Controller
 SG_ BATT_09_PowerpackInsuffErr m8 : 46|2@1+ (1,0) [0|3] ""  NF_Controller
 SG_ BATT_09_BrickSoftShort m8 : 44|2@1+ (1,0) [0|3] ""  NF_Controller
 SG_ BATT_09_chargeUndercurrent m8 : 42|2@1+ (1,0) [0|3] ""  NF_Controller
 SG_ BATT_09_HVILcurrentSourceError m8 : 40|2@1+ (1,0) [0|3] ""  NF_Controller
 SG_ BATT_09_SRS m8 : 54|2@1+ (1,0) [0|3] ""  NF_Controller
 SG_ BATT_09_IsolationExtWar m8 : 52|2@1+ (1,0) [0|3] ""  NF_Controller
 SG_ BATT_09_IsolationIntWar m8 : 50|2@1+ (1,0) [0|3] ""  NF_Controller
 SG_ BATT_09_PyroFuseBlown m8 : 48|2@1+ (1,0) [0|3] ""  NF_Controller
 SG_ BATT_09_vBrickUnderSev m8 : 62|2@1+ (1,0) [0|3] ""  NF_Controller
 SG_ BATT_09_chargePrechargeTimeout m8 : 60|2@1+ (1,0) [0|3] ""  NF_Controller
 SG_ BATT_09_ModuleThermFaultModerate m8 : 58|2@1+ (1,0) [0|3] ""  NF_Controller
 SG_ BATT_09_ModuleThermFaultWarning m8 : 56|2@1+ (1,0) [0|3] ""  NF_Controller
 SG_ BATT_10_SenseBrickImpHigh m9 : 2|2@1+ (1,0) [0|3] ""  NF_Controller
 SG_ BATT_10_AFEfault m9 : 0|2@1+ (1,0) [0|3] ""  NF_Controller
 SG_ BATT_10_AFEerror m9 : 14|2@1+ (1,0) [0|3] ""  NF_Controller
 SG_ BATT_10_HostMIA m9 : 12|2@1+ (1,0) [0|3] ""  NF_Controller
 SG_ BATT_10_TempAmbientOverSev m9 : 10|2@1+ (1,0) [0|3] ""  NF_Controller
 SG_ BATT_10_TempAmbientOverMod m9 : 8|2@1+ (1,0) [0|3] ""  NF_Controller
 SG_ BATT_10_TempAmbientOverWar m9 : 22|2@1+ (1,0) [0|3] ""  NF_Controller
 SG_ BATT_10_AbnormReset m9 : 20|2@1+ (1,0) [0|3] ""  NF_Controller
 SG_ BATT_10_SenseloadVoltErrorPri m9 : 18|2@1+ (1,0) [0|3] ""  NF_Controller
 SG_ BATT_10_CalibrationInvalid m9 : 16|2@1+ (1,0) [0|3] ""  NF_Controller
 SG_ BATT_10_TaskLockup m9 : 30|2@1+ (1,0) [0|3] ""  NF_Controller
 SG_ BATT_10_RAMover m9 : 28|2@1+ (1,0) [0|3] ""  NF_Controller
 SG_ BATT_10_BrickOverdischarge m9 : 26|2@1+ (1,0) [0|3] ""  NF_Controller
 SG_ BATT_10_BrickOvercharge m9 : 24|2@1+ (1,0) [0|3] ""  NF_Controller
 SG_ BATT_10_vBrickImbalance m9 : 38|2@1+ (1,0) [0|3] ""  NF_Controller
 SG_ BATT_10_TempBrickImbalance m9 : 36|2@1+ (1,0) [0|3] ""  NF_Controller
 SG_ BATT_10_CapPackLow m9 : 34|2@1+ (1,0) [0|3] ""  NF_Controller
 SG_ BATT_10_rBrickHigh m9 : 32|2@1+ (1,0) [0|3] ""  NF_Controller
 SG_ BATT_10_PowerpackInsuffErr m9 : 46|2@1+ (1,0) [0|3] ""  NF_Controller
 SG_ BATT_10_BrickSoftShort m9 : 44|2@1+ (1,0) [0|3] ""  NF_Controller
 SG_ BATT_10_chargeUndercurrent m9 : 42|2@1+ (1,0) [0|3] ""  NF_Controller
 SG_ BATT_10_HVILcurrentSourceError m9 : 40|2@1+ (1,0) [0|3] ""  NF_Controller
 SG_ BATT_10_SRS m9 : 54|2@1+ (1,0) [0|3] ""  NF_Controller
 SG_ BATT_10_IsolationExtWar m9 : 52|2@1+ (1,0) [0|3] ""  NF_Controller
 SG_ BATT_10_IsolationIntWar m9 : 50|2@1+ (1,0) [0|3] ""  NF_Controller
 SG_ BATT_10_PyroFuseBlown m9 : 48|2@1+ (1,0) [0|3] ""  NF_Controller
 SG_ BATT_10_vBrickUnderSev m9 : 62|2@1+ (1,0) [0|3] ""  NF_Controller
 SG_ BATT_10_chargePrechargeTimeout m9 : 60|2@1+ (1,0) [0|3] ""  NF_Controller
 SG_ BATT_10_ModuleThermFaultModerate m9 : 58|2@1+ (1,0) [0|3] ""  NF_Controller
 SG_ BATT_10_ModuleThermFaultWarning m9 : 56|2@1+ (1,0) [0|3] ""  NF_Controller
 SG_ BATT_11_SenseBrickImpHigh m10 : 2|2@1+ (1,0) [0|3] ""  NF_Controller
 SG_ BATT_11_AFEfault m10 : 0|2@1+ (1,0) [0|3] ""  NF_Controller
 SG_ BATT_11_AFEerror m10 : 14|2@1+ (1,0) [0|3] ""  NF_Controller
 SG_ BATT_11_HostMIA m10 : 12|2@1+ (1,0) [0|3] ""  NF_Controller
 SG_ BATT_11_TempAmbientOverSev m10 : 10|2@1+ (1,0) [0|3] ""  NF_Controller
 SG_ BATT_11_TempAmbientOverMod m10 : 8|2@1+ (1,0) [0|3] ""  NF_Controller
 SG_ BATT_11_TempAmbientOverWar m10 : 22|2@1+ (1,0) [0|3] ""  NF_Controller
 SG_ BATT_11_AbnormReset m10 : 20|2@1+ (1,0) [0|3] ""  NF_Controller
 SG_ BATT_11_SenseloadVoltErrorPri m10 : 18|2@1+ (1,0) [0|3] ""  NF_Controller
 SG_ BATT_11_CalibrationInvalid m10 : 16|2@1+ (1,0) [0|3] ""  NF_Controller
 SG_ BATT_11_TaskLockup m10 : 30|2@1+ (1,0) [0|3] ""  NF_Controller
 SG_ BATT_11_RAMover m10 : 28|2@1+ (1,0) [0|3] ""  NF_Controller
 SG_ BATT_11_BrickOverdischarge m10 : 26|2@1+ (1,0) [0|3] ""  NF_Controller
 SG_ BATT_11_BrickOvercharge m10 : 24|2@1+ (1,0) [0|3] ""  NF_Controller
 SG_ BATT_11_vBrickImbalance m10 : 38|2@1+ (1,0) [0|3] ""  NF_Controller
 SG_ BATT_11_TempBrickImbalance m10 : 36|2@1+ (1,0) [0|3] ""  NF_Controller
 SG_ BATT_11_CapPackLow m10 : 34|2@1+ (1,0) [0|3] ""  NF_Controller
 SG_ BATT_11_rBrickHigh m10 : 32|2@1+ (1,0) [0|3] ""  NF_Controller
 SG_ BATT_11_PowerpackInsuffErr m10 : 46|2@1+ (1,0) [0|3] ""  NF_Controller
 SG_ BATT_11_BrickSoftShort m10 : 44|2@1+ (1,0) [0|3] ""  NF_Controller
 SG_ BATT_11_chargeUndercurrent m10 : 42|2@1+ (1,0) [0|3] ""  NF_Controller
 SG_ BATT_11_HVILcurrentSourceError m10 : 40|2@1+ (1,0) [0|3] ""  NF_Controller
 SG_ BATT_11_SRS m10 : 54|2@1+ (1,0) [0|3] ""  NF_Controller
 SG_ BATT_11_IsolationExtWar m10 : 52|2@1+ (1,0) [0|3] ""  NF_Controller
 SG_ BATT_11_IsolationIntWar m10 : 50|2@1+ (1,0) [0|3] ""  NF_Controller
 SG_ BATT_11_PyroFuseBlown m10 : 48|2@1+ (1,0) [0|3] ""  NF_Controller
 SG_ BATT_11_vBrickUnderSev m10 : 62|2@1+ (1,0) [0|3] ""  NF_Controller
 SG_ BATT_11_chargePrechargeTimeout m10 : 60|2@1+ (1,0) [0|3] ""  NF_Controller
 SG_ BATT_11_ModuleThermFaultModerate m10 : 58|2@1+ (1,0) [0|3] ""  NF_Controller
 SG_ BATT_11_ModuleThermFaultWarning m10 : 56|2@1+ (1,0) [0|3] ""  NF_Controller
 SG_ BATT_12_SenseBrickImpHigh m11 : 2|2@1+ (1,0) [0|3] ""  NF_Controller
 SG_ BATT_12_AFEfault m11 : 0|2@1+ (1,0) [0|3] ""  NF_Controller
 SG_ BATT_12_AFEerror m11 : 14|2@1+ (1,0) [0|3] ""  NF_Controller
 SG_ BATT_12_HostMIA m11 : 12|2@1+ (1,0) [0|3] ""  NF_Controller
 SG_ BATT_12_TempAmbientOverSev m11 : 10|2@1+ (1,0) [0|3] ""  NF_Controller
 SG_ BATT_12_TempAmbientOverMod m11 : 8|2@1+ (1,0) [0|3] ""  NF_Controller
 SG_ BATT_12_TempAmbientOverWar m11 : 22|2@1+ (1,0) [0|3] ""  NF_Controller
 SG_ BATT_12_AbnormReset m11 : 20|2@1+ (1,0) [0|3] ""  NF_Controller
 SG_ BATT_12_SenseloadVoltErrorPri m11 : 18|2@1+ (1,0) [0|3] ""  NF_Controller
 SG_ BATT_12_CalibrationInvalid m11 : 16|2@1+ (1,0) [0|3] ""  NF_Controller
 SG_ BATT_12_TaskLockup m11 : 30|2@1+ (1,0) [0|3] ""  NF_Controller
 SG_ BATT_12_RAMover m11 : 28|2@1+ (1,0) [0|3] ""  NF_Controller
 SG_ BATT_12_BrickOverdischarge m11 : 26|2@1+ (1,0) [0|3] ""  NF_Controller
 SG_ BATT_12_BrickOvercharge m11 : 24|2@1+ (1,0) [0|3] ""  NF_Controller
 SG_ BATT_12_vBrickImbalance m11 : 38|2@1+ (1,0) [0|3] ""  NF_Controller
 SG_ BATT_12_TempBrickImbalance m11 : 36|2@1+ (1,0) [0|3] ""  NF_Controller
 SG_ BATT_12_CapPackLow m11 : 34|2@1+ (1,0) [0|3] ""  NF_Controller
 SG_ BATT_12_rBrickHigh m11 : 32|2@1+ (1,0) [0|3] ""  NF_Controller
 SG_ BATT_12_PowerpackInsuffErr m11 : 46|2@1+ (1,0) [0|3] ""  NF_Controller
 SG_ BATT_12_BrickSoftShort m11 : 44|2@1+ (1,0) [0|3] ""  NF_Controller
 SG_ BATT_12_chargeUndercurrent m11 : 42|2@1+ (1,0) [0|3] ""  NF_Controller
 SG_ BATT_12_HVILcurrentSourceError m11 : 40|2@1+ (1,0) [0|3] ""  NF_Controller
 SG_ BATT_12_SRS m11 : 54|2@1+ (1,0) [0|3] ""  NF_Controller
 SG_ BATT_12_IsolationExtWar m11 : 52|2@1+ (1,0) [0|3] ""  NF_Controller
 SG_ BATT_12_IsolationIntWar m11 : 50|2@1+ (1,0) [0|3] ""  NF_Controller
 SG_ BATT_12_PyroFuseBlown m11 : 48|2@1+ (1,0) [0|3] ""  NF_Controller
 SG_ BATT_12_vBrickUnderSev m11 : 62|2@1+ (1,0) [0|3] ""  NF_Controller
 SG_ BATT_12_chargePrechargeTimeout m11 : 60|2@1+ (1,0) [0|3] ""  NF_Controller
 SG_ BATT_12_ModuleThermFaultModerate m11 : 58|2@1+ (1,0) [0|3] ""  NF_Controller
 SG_ BATT_12_ModuleThermFaultWarning m11 : 56|2@1+ (1,0) [0|3] ""  NF_Controller
 SG_ BATT_13_SenseBrickImpHigh m12 : 2|2@1+ (1,0) [0|3] ""  NF_Controller
 SG_ BATT_13_AFEfault m12 : 0|2@1+ (1,0) [0|3] ""  NF_Controller
 SG_ BATT_13_AFEerror m12 : 14|2@1+ (1,0) [0|3] ""  NF_Controller
 SG_ BATT_13_HostMIA m12 : 12|2@1+ (1,0) [0|3] ""  NF_Controller
 SG_ BATT_13_TempAmbientOverSev m12 : 10|2@1+ (1,0) [0|3] ""  NF_Controller
 SG_ BATT_13_TempAmbientOverMod m12 : 8|2@1+ (1,0) [0|3] ""  NF_Controller
 SG_ BATT_13_TempAmbientOverWar m12 : 22|2@1+ (1,0) [0|3] ""  NF_Controller
 SG_ BATT_13_AbnormReset m12 : 20|2@1+ (1,0) [0|3] ""  NF_Controller
 SG_ BATT_13_SenseloadVoltErrorPri m12 : 18|2@1+ (1,0) [0|3] ""  NF_Controller
 SG_ BATT_13_CalibrationInvalid m12 : 16|2@1+ (1,0) [0|3] ""  NF_Controller
 SG_ BATT_13_TaskLockup m12 : 30|2@1+ (1,0) [0|3] ""  NF_Controller
 SG_ BATT_13_RAMover m12 : 28|2@1+ (1,0) [0|3] ""  NF_Controller
 SG_ BATT_13_BrickOverdischarge m12 : 26|2@1+ (1,0) [0|3] ""  NF_Controller
 SG_ BATT_13_BrickOvercharge m12 : 24|2@1+ (1,0) [0|3] ""  NF_Controller
 SG_ BATT_13_vBrickImbalance m12 : 38|2@1+ (1,0) [0|3] ""  NF_Controller
 SG_ BATT_13_TempBrickImbalance m12 : 36|2@1+ (1,0) [0|3] ""  NF_Controller
 SG_ BATT_13_CapPackLow m12 : 34|2@1+ (1,0) [0|3] ""  NF_Controller
 SG_ BATT_13_rBrickHigh m12 : 32|2@1+ (1,0) [0|3] ""  NF_Controller
 SG_ BATT_13_PowerpackInsuffErr m12 : 46|2@1+ (1,0) [0|3] ""  NF_Controller
 SG_ BATT_13_BrickSoftShort m12 : 44|2@1+ (1,0) [0|3] ""  NF_Controller
 SG_ BATT_13_chargeUndercurrent m12 : 42|2@1+ (1,0) [0|3] ""  NF_Controller
 SG_ BATT_13_HVILcurrentSourceError m12 : 40|2@1+ (1,0) [0|3] ""  NF_Controller
 SG_ BATT_13_SRS m12 : 54|2@1+ (1,0) [0|3] ""  NF_Controller
 SG_ BATT_13_IsolationExtWar m12 : 52|2@1+ (1,0) [0|3] ""  NF_Controller
 SG_ BATT_13_IsolationIntWar m12 : 50|2@1+ (1,0) [0|3] ""  NF_Controller
 SG_ BATT_13_PyroFuseBlown m12 : 48|2@1+ (1,0) [0|3] ""  NF_Controller
 SG_ BATT_13_vBrickUnderSev m12 : 62|2@1+ (1,0) [0|3] ""  NF_Controller
 SG_ BATT_13_chargePrechargeTimeout m12 : 60|2@1+ (1,0) [0|3] ""  NF_Controller
 SG_ BATT_13_ModuleThermFaultModerate m12 : 58|2@1+ (1,0) [0|3] ""  NF_Controller
 SG_ BATT_13_ModuleThermFaultWarning m12 : 56|2@1+ (1,0) [0|3] ""  NF_Controller
 SG_ BATT_14_SenseBrickImpHigh m13 : 2|2@1+ (1,0) [0|3] ""  NF_Controller
 SG_ BATT_14_AFEfault m13 : 0|2@1+ (1,0) [0|3] ""  NF_Controller
 SG_ BATT_14_AFEerror m13 : 14|2@1+ (1,0) [0|3] ""  NF_Controller
 SG_ BATT_14_HostMIA m13 : 12|2@1+ (1,0) [0|3] ""  NF_Controller
 SG_ BATT_14_TempAmbientOverSev m13 : 10|2@1+ (1,0) [0|3] ""  NF_Controller
 SG_ BATT_14_TempAmbientOverMod m13 : 8|2@1+ (1,0) [0|3] ""  NF_Controller
 SG_ BATT_14_TempAmbientOverWar m13 : 22|2@1+ (1,0) [0|3] ""  NF_Controller
 SG_ BATT_14_AbnormReset m13 : 20|2@1+ (1,0) [0|3] ""  NF_Controller
 SG_ BATT_14_SenseloadVoltErrorPri m13 : 18|2@1+ (1,0) [0|3] ""  NF_Controller
 SG_ BATT_14_CalibrationInvalid m13 : 16|2@1+ (1,0) [0|3] ""  NF_Controller
 SG_ BATT_14_TaskLockup m13 : 30|2@1+ (1,0) [0|3] ""  NF_Controller
 SG_ BATT_14_RAMover m13 : 28|2@1+ (1,0) [0|3] ""  NF_Controller
 SG_ BATT_14_BrickOverdischarge m13 : 26|2@1+ (1,0) [0|3] ""  NF_Controller
 SG_ BATT_14_BrickOvercharge m13 : 24|2@1+ (1,0) [0|3] ""  NF_Controller
 SG_ BATT_14_vBrickImbalance m13 : 38|2@1+ (1,0) [0|3] ""  NF_Controller
 SG_ BATT_14_TempBrickImbalance m13 : 36|2@1+ (1,0) [0|3] ""  NF_Controller
 SG_ BATT_14_CapPackLow m13 : 34|2@1+ (1,0) [0|3] ""  NF_Controller
 SG_ BATT_14_rBrickHigh m13 : 32|2@1+ (1,0) [0|3] ""  NF_Controller
 SG_ BATT_14_PowerpackInsuffErr m13 : 46|2@1+ (1,0) [0|3] ""  NF_Controller
 SG_ BATT_14_BrickSoftShort m13 : 44|2@1+ (1,0) [0|3] ""  NF_Controller
 SG_ BATT_14_chargeUndercurrent m13 : 42|2@1+ (1,0) [0|3] ""  NF_Controller
 SG_ BATT_14_HVILcurrentSourceError m13 : 40|2@1+ (1,0) [0|3] ""  NF_Controller
 SG_ BATT_14_SRS m13 : 54|2@1+ (1,0) [0|3] ""  NF_Controller
 SG_ BATT_14_IsolationExtWar m13 : 52|2@1+ (1,0) [0|3] ""  NF_Controller
 SG_ BATT_14_IsolationIntWar m13 : 50|2@1+ (1,0) [0|3] ""  NF_Controller
 SG_ BATT_14_PyroFuseBlown m13 : 48|2@1+ (1,0) [0|3] ""  NF_Controller
 SG_ BATT_14_vBrickUnderSev m13 : 62|2@1+ (1,0) [0|3] ""  NF_Controller
 SG_ BATT_14_chargePrechargeTimeout m13 : 60|2@1+ (1,0) [0|3] ""  NF_Controller
 SG_ BATT_14_ModuleThermFaultModerate m13 : 58|2@1+ (1,0) [0|3] ""  NF_Controller
 SG_ BATT_14_ModuleThermFaultWarning m13 : 56|2@1+ (1,0) [0|3] ""  NF_Controller
 SG_ BATT_15_SenseBrickImpHigh m14 : 2|2@1+ (1,0) [0|3] ""  NF_Controller
 SG_ BATT_15_AFEfault m14 : 0|2@1+ (1,0) [0|3] ""  NF_Controller
 SG_ BATT_15_AFEerror m14 : 14|2@1+ (1,0) [0|3] ""  NF_Controller
 SG_ BATT_15_HostMIA m14 : 12|2@1+ (1,0) [0|3] ""  NF_Controller
 SG_ BATT_15_TempAmbientOverSev m14 : 10|2@1+ (1,0) [0|3] ""  NF_Controller
 SG_ BATT_15_TempAmbientOverMod m14 : 8|2@1+ (1,0) [0|3] ""  NF_Controller
 SG_ BATT_15_TempAmbientOverWar m14 : 22|2@1+ (1,0) [0|3] ""  NF_Controller
 SG_ BATT_15_AbnormReset m14 : 20|2@1+ (1,0) [0|3] ""  NF_Controller
 SG_ BATT_15_SenseloadVoltErrorPri m14 : 18|2@1+ (1,0) [0|3] ""  NF_Controller
 SG_ BATT_15_CalibrationInvalid m14 : 16|2@1+ (1,0) [0|3] ""  NF_Controller
 SG_ BATT_15_TaskLockup m14 : 30|2@1+ (1,0) [0|3] ""  NF_Controller
 SG_ BATT_15_RAMover m14 : 28|2@1+ (1,0) [0|3] ""  NF_Controller
 SG_ BATT_15_BrickOverdischarge m14 : 26|2@1+ (1,0) [0|3] ""  NF_Controller
 SG_ BATT_15_BrickOvercharge m14 : 24|2@1+ (1,0) [0|3] ""  NF_Controller
 SG_ BATT_15_vBrickImbalance m14 : 38|2@1+ (1,0) [0|3] ""  NF_Controller
 SG_ BATT_15_TempBrickImbalance m14 : 36|2@1+ (1,0) [0|3] ""  NF_Controller
 SG_ BATT_15_CapPackLow m14 : 34|2@1+ (1,0) [0|3] ""  NF_Controller
 SG_ BATT_15_rBrickHigh m14 : 32|2@1+ (1,0) [0|3] ""  NF_Controller
 SG_ BATT_15_PowerpackInsuffErr m14 : 46|2@1+ (1,0) [0|3] ""  NF_Controller
 SG_ BATT_15_BrickSoftShort m14 : 44|2@1+ (1,0) [0|3] ""  NF_Controller
 SG_ BATT_15_chargeUndercurrent m14 : 42|2@1+ (1,0) [0|3] ""  NF_Controller
 SG_ BATT_15_HVILcurrentSourceError m14 : 40|2@1+ (1,0) [0|3] ""  NF_Controller
 SG_ BATT_15_SRS m14 : 54|2@1+ (1,0) [0|3] ""  NF_Controller
 SG_ BATT_15_IsolationExtWar m14 : 52|2@1+ (1,0) [0|3] ""  NF_Controller
 SG_ BATT_15_IsolationIntWar m14 : 50|2@1+ (1,0) [0|3] ""  NF_Controller
 SG_ BATT_15_PyroFuseBlown m14 : 48|2@1+ (1,0) [0|3] ""  NF_Controller
 SG_ BATT_15_vBrickUnderSev m14 : 62|2@1+ (1,0) [0|3] ""  NF_Controller
 SG_ BATT_15_chargePrechargeTimeout m14 : 60|2@1+ (1,0) [0|3] ""  NF_Controller
 SG_ BATT_15_ModuleThermFaultModerate m14 : 58|2@1+ (1,0) [0|3] ""  NF_Controller
 SG_ BATT_15_ModuleThermFaultWarning m14 : 56|2@1+ (1,0) [0|3] ""  NF_Controller
 SG_ multiplexor_batt_diag_B M : 4|4@1+ (1,0) [0|15] ""  NF_Controller

BA_DEF_ BO_  "GenMsgDiag" ENUM  "No","Yes";
BA_DEF_ SG_  "SigType" ENUM  "Default","Range","RangeSigned","ASCII","Discrete","Control","ReferencePGN","DTC","StringDelimiter","StringLength","StringLengthControl","MessageCounter","MessageChecksum";
BA_DEF_ SG_  "GenSigEVName" STRING ;
BA_DEF_ SG_  "GenSigILSupport" ENUM  "No","Yes";
BA_DEF_ SG_  "GenSigSendType" ENUM  "Cyclic","OnWrite","OnWriteWithRepetition","OnChange","OnChangeWithRepetition","IfActive","IfActiveWithRepetition","NoSigSendType";
BA_DEF_ BO_  "GenMsgFastOnStart" INT 0 100000;
BA_DEF_ SG_  "GenSigStartValue" INT 0 10000;
BA_DEF_ BO_  "GenMsgILSupport" ENUM  "No","Yes";
BA_DEF_ BO_  "GenMsgSendType" ENUM  "cyclic","NotUsed","IfActive","NotUsed","NotUsed","NotUsed","NotUsed","NotUsed","noMsgSendType";
BA_DEF_ BO_  "GenMsgRequestable" INT 0 1;
BA_DEF_ BO_  "GenMsgCycleTime" INT 0 3600000;
BA_DEF_ SG_  "SPN" INT 0 524287;
BA_DEF_ BO_  "VFrameFormat" ENUM  "StandardCAN","ExtendedCAN","reserved","J1939PG";
BA_DEF_ SG_  "SystemSignalLongSymbol" STRING ;
BA_DEF_DEF_  "GenMsgDiag" "No";
BA_DEF_DEF_  "SigType" "Default";
BA_DEF_DEF_  "GenSigEVName" "Env@Nodename_@Signame";
BA_DEF_DEF_  "GenSigILSupport" "Yes";
BA_DEF_DEF_  "GenSigSendType" "NoSigSendType";
BA_DEF_DEF_  "GenMsgFastOnStart" 0;
BA_DEF_DEF_  "GenSigStartValue" 0;
BA_DEF_DEF_  "GenMsgILSupport" "Yes";
BA_DEF_DEF_  "GenMsgSendType" "noMsgSendType";
BA_DEF_DEF_  "GenMsgRequestable" 1;
BA_DEF_DEF_  "GenMsgCycleTime" 0;
BA_DEF_DEF_  "SPN" 0;
BA_DEF_DEF_  "VFrameFormat" "J1939PG";
BA_DEF_DEF_  "SystemSignalLongSymbol" "";
BA_ "GenMsgSendType" BO_ 2499762788 0;
BA_ "VFrameFormat" BO_ 2499762788 1;
BA_ "GenSigStartValue" SG_ 2499762788 BATT_01_SenseBrickImpHigh 2;
BA_ "GenSigStartValue" SG_ 2499762788 BATT_01_AFEfault 2;
BA_ "GenSigStartValue" SG_ 2499762788 BATT_01_AFEerror 2;
BA_ "GenSigStartValue" SG_ 2499762788 BATT_01_HostMIA 2;
BA_ "GenSigStartValue" SG_ 2499762788 BATT_01_TempAmbientOverSev 2;
BA_ "GenSigStartValue" SG_ 2499762788 BATT_01_TempAmbientOverMod 2;
BA_ "GenSigStartValue" SG_ 2499762788 BATT_01_TempAmbientOverWar 2;
BA_ "GenSigStartValue" SG_ 2499762788 BATT_01_AbnormReset 2;
BA_ "GenSigStartValue" SG_ 2499762788 BATT_01_SenseloadVoltErrorPri 2;
BA_ "GenSigStartValue" SG_ 2499762788 BATT_01_CalibrationInvalid 2;
BA_ "GenSigStartValue" SG_ 2499762788 BATT_01_TaskLockup 2;
BA_ "GenSigStartValue" SG_ 2499762788 BATT_01_RAMover 2;
BA_ "GenSigStartValue" SG_ 2499762788 BATT_01_BrickOverdischarge 2;
BA_ "GenSigStartValue" SG_ 2499762788 BATT_01_BrickOvercharge 2;
BA_ "GenSigStartValue" SG_ 2499762788 BATT_01_vBrickImbalance 2;
BA_ "GenSigStartValue" SG_ 2499762788 BATT_01_TempBrickImbalance 2;
BA_ "GenSigStartValue" SG_ 2499762788 BATT_01_CapPackLow 2;
BA_ "GenSigStartValue" SG_ 2499762788 BATT_01_rBrickHigh 2;
BA_ "GenSigStartValue" SG_ 2499762788 BATT_01_PowerpackInsuffErr 2;
BA_ "GenSigStartValue" SG_ 2499762788 BATT_01_BrickSoftShort 2;
BA_ "GenSigStartValue" SG_ 2499762788 BATT_01_chargeUndercurrent 2;
BA_ "GenSigStartValue" SG_ 2499762788 BATT_01_HVILcurrentSourceError 2;
BA_ "GenSigStartValue" SG_ 2499762788 BATT_01_SRS 2;
BA_ "GenSigStartValue" SG_ 2499762788 BATT_01_IsolationExtWar 2;
BA_ "GenSigStartValue" SG_ 2499762788 BATT_01_IsolationIntWar 2;
BA_ "GenSigStartValue" SG_ 2499762788 BATT_01_PyroFuseBlown 2;
BA_ "GenSigStartValue" SG_ 2499762788 BATT_01_vBrickUnderSev 2;
BA_ "GenSigStartValue" SG_ 2499762788 BATT_01_chargePrechargeTimeout 2;
BA_ "GenSigStartValue" SG_ 2499762788 BATT_01_ModuleThermFaultModerate 2;
BA_ "GenSigStartValue" SG_ 2499762788 BATT_01_ModuleThermFaultWarning 2;
BA_ "GenSigStartValue" SG_ 2499762788 BATT_02_SenseBrickImpHigh 2;
BA_ "GenSigStartValue" SG_ 2499762788 BATT_02_AFEfault 2;
BA_ "GenSigStartValue" SG_ 2499762788 BATT_02_AFEerror 2;
BA_ "GenSigStartValue" SG_ 2499762788 BATT_02_HostMIA 2;
BA_ "GenSigStartValue" SG_ 2499762788 BATT_02_TempAmbientOverSev 2;
BA_ "GenSigStartValue" SG_ 2499762788 BATT_02_TempAmbientOverMod 2;
BA_ "GenSigStartValue" SG_ 2499762788 BATT_02_TempAmbientOverWar 2;
BA_ "GenSigStartValue" SG_ 2499762788 BATT_02_AbnormReset 2;
BA_ "GenSigStartValue" SG_ 2499762788 BATT_02_SenseloadVoltErrorPri 2;
BA_ "GenSigStartValue" SG_ 2499762788 BATT_02_CalibrationInvalid 2;
BA_ "GenSigStartValue" SG_ 2499762788 BATT_02_TaskLockup 2;
BA_ "GenSigStartValue" SG_ 2499762788 BATT_02_RAMover 2;
BA_ "GenSigStartValue" SG_ 2499762788 BATT_02_BrickOverdischarge 2;
BA_ "GenSigStartValue" SG_ 2499762788 BATT_02_BrickOvercharge 2;
BA_ "GenSigStartValue" SG_ 2499762788 BATT_02_vBrickImbalance 2;
BA_ "GenSigStartValue" SG_ 2499762788 BATT_02_TempBrickImbalance 2;
BA_ "GenSigStartValue" SG_ 2499762788 BATT_02_CapPackLow 2;
BA_ "GenSigStartValue" SG_ 2499762788 BATT_02_rBrickHigh 2;
BA_ "GenSigStartValue" SG_ 2499762788 BATT_02_PowerpackInsuffErr 2;
BA_ "GenSigStartValue" SG_ 2499762788 BATT_02_BrickSoftShort 2;
BA_ "GenSigStartValue" SG_ 2499762788 BATT_02_chargeUndercurrent 2;
BA_ "GenSigStartValue" SG_ 2499762788 BATT_02_HVILcurrentSourceError 2;
BA_ "GenSigStartValue" SG_ 2499762788 BATT_02_SRS 2;
BA_ "GenSigStartValue" SG_ 2499762788 BATT_02_IsolationExtWar 2;
BA_ "GenSigStartValue" SG_ 2499762788 BATT_02_IsolationIntWar 2;
BA_ "GenSigStartValue" SG_ 2499762788 BATT_02_PyroFuseBlown 2;
BA_ "GenSigStartValue" SG_ 2499762788 BATT_02_vBrickUnderSev 2;
BA_ "GenSigStartValue" SG_ 2499762788 BATT_02_chargePrechargeTimeout 2;
BA_ "GenSigStartValue" SG_ 2499762788 BATT_02_ModuleThermFaultModerate 2;
BA_ "GenSigStartValue" SG_ 2499762788 BATT_02_ModuleThermFaultWarning 2;
BA_ "GenSigStartValue" SG_ 2499762788 BATT_03_SenseBrickImpHigh 2;
BA_ "GenSigStartValue" SG_ 2499762788 BATT_03_AFEfault 2;
BA_ "GenSigStartValue" SG_ 2499762788 BATT_03_AFEerror 2;
BA_ "GenSigStartValue" SG_ 2499762788 BATT_03_HostMIA 2;
BA_ "GenSigStartValue" SG_ 2499762788 BATT_03_TempAmbientOverSev 2;
BA_ "GenSigStartValue" SG_ 2499762788 BATT_03_TempAmbientOverMod 2;
BA_ "GenSigStartValue" SG_ 2499762788 BATT_03_TempAmbientOverWar 2;
BA_ "GenSigStartValue" SG_ 2499762788 BATT_03_AbnormReset 2;
BA_ "GenSigStartValue" SG_ 2499762788 BATT_03_SenseloadVoltErrorPri 2;
BA_ "GenSigStartValue" SG_ 2499762788 BATT_03_CalibrationInvalid 2;
BA_ "GenSigStartValue" SG_ 2499762788 BATT_03_TaskLockup 2;
BA_ "GenSigStartValue" SG_ 2499762788 BATT_03_RAMover 2;
BA_ "GenSigStartValue" SG_ 2499762788 BATT_03_BrickOverdischarge 2;
BA_ "GenSigStartValue" SG_ 2499762788 BATT_03_BrickOvercharge 2;
BA_ "GenSigStartValue" SG_ 2499762788 BATT_03_vBrickImbalance 2;
BA_ "GenSigStartValue" SG_ 2499762788 BATT_03_TempBrickImbalance 2;
BA_ "GenSigStartValue" SG_ 2499762788 BATT_03_CapPackLow 2;
BA_ "GenSigStartValue" SG_ 2499762788 BATT_03_rBrickHigh 2;
BA_ "GenSigStartValue" SG_ 2499762788 BATT_03_PowerpackInsuffErr 2;
BA_ "GenSigStartValue" SG_ 2499762788 BATT_03_BrickSoftShort 2;
BA_ "GenSigStartValue" SG_ 2499762788 BATT_03_chargeUndercurrent 2;
BA_ "GenSigStartValue" SG_ 2499762788 BATT_03_HVILcurrentSourceError 2;
BA_ "GenSigStartValue" SG_ 2499762788 BATT_03_SRS 2;
BA_ "GenSigStartValue" SG_ 2499762788 BATT_03_IsolationExtWar 2;
BA_ "GenSigStartValue" SG_ 2499762788 BATT_03_IsolationIntWar 2;
BA_ "GenSigStartValue" SG_ 2499762788 BATT_03_PyroFuseBlown 2;
BA_ "GenSigStartValue" SG_ 2499762788 BATT_03_vBrickUnderSev 2;
BA_ "GenSigStartValue" SG_ 2499762788 BATT_03_chargePrechargeTimeout 2;
BA_ "GenSigStartValue" SG_ 2499762788 BATT_03_ModuleThermFaultModerate 2;
BA_ "GenSigStartValue" SG_ 2499762788 BATT_03_ModuleThermFaultWarning 2;
BA_ "GenSigStartValue" SG_ 2499762788 BATT_04_SenseBrickImpHigh 2;
BA_ "GenSigStartValue" SG_ 2499762788 BATT_04_AFEfault 2;
BA_ "GenSigStartValue" SG_ 2499762788 BATT_04_AFEerror 2;
BA_ "GenSigStartValue" SG_ 2499762788 BATT_04_HostMIA 2;
BA_ "GenSigStartValue" SG_ 2499762788 BATT_04_TempAmbientOverSev 2;
BA_ "GenSigStartValue" SG_ 2499762788 BATT_04_TempAmbientOverMod 2;
BA_ "GenSigStartValue" SG_ 2499762788 BATT_04_TempAmbientOverWar 2;
BA_ "GenSigStartValue" SG_ 2499762788 BATT_04_AbnormReset 2;
BA_ "GenSigStartValue" SG_ 2499762788 BATT_04_SenseloadVoltErrorPri 2;
BA_ "GenSigStartValue" SG_ 2499762788 BATT_04_CalibrationInvalid 2;
BA_ "GenSigStartValue" SG_ 2499762788 BATT_04_TaskLockup 2;
BA_ "GenSigStartValue" SG_ 2499762788 BATT_04_RAMover 2;
BA_ "GenSigStartValue" SG_ 2499762788 BATT_04_BrickOverdischarge 2;
BA_ "GenSigStartValue" SG_ 2499762788 BATT_04_BrickOvercharge 2;
BA_ "GenSigStartValue" SG_ 2499762788 BATT_04_vBrickImbalance 2;
BA_ "GenSigStartValue" SG_ 2499762788 BATT_04_TempBrickImbalance 2;
BA_ "GenSigStartValue" SG_ 2499762788 BATT_04_CapPackLow 2;
BA_ "GenSigStartValue" SG_ 2499762788 BATT_04_rBrickHigh 2;
BA_ "GenSigStartValue" SG_ 2499762788 BATT_04_PowerpackInsuffErr 2;
BA_ "GenSigStartValue" SG_ 2499762788 BATT_04_BrickSoftShort 2;
BA_ "GenSigStartValue" SG_ 2499762788 BATT_04_chargeUndercurrent 2;
BA_ "GenSigStartValue" SG_ 2499762788 BATT_04_HVILcurrentSourceError 2;
BA_ "GenSigStartValue" SG_ 2499762788 BATT_04_SRS 2;
BA_ "GenSigStartValue" SG_ 2499762788 BATT_04_IsolationExtWar 2;
BA_ "GenSigStartValue" SG_ 2499762788 BATT_04_IsolationIntWar 2;
BA_ "GenSigStartValue" SG_ 2499762788 BATT_04_PyroFuseBlown 2;
BA_ "GenSigStartValue" SG_ 2499762788 BATT_04_vBrickUnderSev 2;
BA_ "GenSigStartValue" SG_ 2499762788 BATT_04_chargePrechargeTimeout 2;
BA_ "GenSigStartValue" SG_ 2499762788 BATT_04_ModuleThermFaultModerate 2;
BA_ "GenSigStartValue" SG_ 2499762788 BATT_04_ModuleThermFaultWarning 2;
BA_ "GenSigStartValue" SG_ 2499762788 BATT_05_SenseBrickImpHigh 2;
BA_ "GenSigStartValue" SG_ 2499762788 BATT_05_AFEfault 2;
BA_ "GenSigStartValue" SG_ 2499762788 BATT_05_AFEerror 2;
BA_ "GenSigStartValue" SG_ 2499762788 BATT_05_HostMIA 2;
BA_ "GenSigStartValue" SG_ 2499762788 BATT_05_TempAmbientOverSev 2;
BA_ "GenSigStartValue" SG_ 2499762788 BATT_05_TempAmbientOverMod 2;
BA_ "GenSigStartValue" SG_ 2499762788 BATT_05_TempAmbientOverWar 2;
BA_ "GenSigStartValue" SG_ 2499762788 BATT_05_AbnormReset 2;
BA_ "GenSigStartValue" SG_ 2499762788 BATT_05_SenseloadVoltErrorPri 2;
BA_ "GenSigStartValue" SG_ 2499762788 BATT_05_CalibrationInvalid 2;
BA_ "GenSigStartValue" SG_ 2499762788 BATT_05_TaskLockup 2;
BA_ "GenSigStartValue" SG_ 2499762788 BATT_05_RAMover 2;
BA_ "GenSigStartValue" SG_ 2499762788 BATT_05_BrickOverdischarge 2;
BA_ "GenSigStartValue" SG_ 2499762788 BATT_05_BrickOvercharge 2;
BA_ "GenSigStartValue" SG_ 2499762788 BATT_05_vBrickImbalance 2;
BA_ "GenSigStartValue" SG_ 2499762788 BATT_05_TempBrickImbalance 2;
BA_ "GenSigStartValue" SG_ 2499762788 BATT_05_CapPackLow 2;
BA_ "GenSigStartValue" SG_ 2499762788 BATT_05_rBrickHigh 2;
BA_ "GenSigStartValue" SG_ 2499762788 BATT_05_PowerpackInsuffErr 2;
BA_ "GenSigStartValue" SG_ 2499762788 BATT_05_BrickSoftShort 2;
BA_ "GenSigStartValue" SG_ 2499762788 BATT_05_chargeUndercurrent 2;
BA_ "GenSigStartValue" SG_ 2499762788 BATT_05_HVILcurrentSourceError 2;
BA_ "GenSigStartValue" SG_ 2499762788 BATT_05_SRS 2;
BA_ "GenSigStartValue" SG_ 2499762788 BATT_05_IsolationExtWar 2;
BA_ "GenSigStartValue" SG_ 2499762788 BATT_05_IsolationIntWar 2;
BA_ "GenSigStartValue" SG_ 2499762788 BATT_05_PyroFuseBlown 2;
BA_ "GenSigStartValue" SG_ 2499762788 BATT_05_vBrickUnderSev 2;
BA_ "GenSigStartValue" SG_ 2499762788 BATT_05_chargePrechargeTimeout 2;
BA_ "GenSigStartValue" SG_ 2499762788 BATT_05_ModuleThermFaultModerate 2;
BA_ "GenSigStartValue" SG_ 2499762788 BATT_05_ModuleThermFaultWarning 2;
BA_ "GenSigStartValue" SG_ 2499762788 BATT_06_SenseBrickImpHigh 2;
BA_ "GenSigStartValue" SG_ 2499762788 BATT_06_AFEfault 2;
BA_ "GenSigStartValue" SG_ 2499762788 BATT_06_AFEerror 2;
BA_ "GenSigStartValue" SG_ 2499762788 BATT_06_HostMIA 2;
BA_ "GenSigStartValue" SG_ 2499762788 BATT_06_TempAmbientOverSev 2;
BA_ "GenSigStartValue" SG_ 2499762788 BATT_06_TempAmbientOverMod 2;
BA_ "GenSigStartValue" SG_ 2499762788 BATT_06_TempAmbientOverWar 2;
BA_ "GenSigStartValue" SG_ 2499762788 BATT_06_AbnormReset 2;
BA_ "GenSigStartValue" SG_ 2499762788 BATT_06_SenseloadVoltErrorPri 2;
BA_ "GenSigStartValue" SG_ 2499762788 BATT_06_CalibrationInvalid 2;
BA_ "GenSigStartValue" SG_ 2499762788 BATT_06_TaskLockup 2;
BA_ "GenSigStartValue" SG_ 2499762788 BATT_06_RAMover 2;
BA_ "GenSigStartValue" SG_ 2499762788 BATT_06_BrickOverdischarge 2;
BA_ "GenSigStartValue" SG_ 2499762788 BATT_06_BrickOvercharge 2;
BA_ "GenSigStartValue" SG_ 2499762788 BATT_06_vBrickImbalance 2;
BA_ "GenSigStartValue" SG_ 2499762788 BATT_06_TempBrickImbalance 2;
BA_ "GenSigStartValue" SG_ 2499762788 BATT_06_CapPackLow 2;
BA_ "GenSigStartValue" SG_ 2499762788 BATT_06_rBrickHigh 2;
BA_ "GenSigStartValue" SG_ 2499762788 BATT_06_PowerpackInsuffErr 2;
BA_ "GenSigStartValue" SG_ 2499762788 BATT_06_BrickSoftShort 2;
BA_ "GenSigStartValue" SG_ 2499762788 BATT_06_chargeUndercurrent 2;
BA_ "GenSigStartValue" SG_ 2499762788 BATT_06_HVILcurrentSourceError 2;
BA_ "GenSigStartValue" SG_ 2499762788 BATT_06_SRS 2;
BA_ "GenSigStartValue" SG_ 2499762788 BATT_06_IsolationExtWar 2;
BA_ "GenSigStartValue" SG_ 2499762788 BATT_06_IsolationIntWar 2;
BA_ "GenSigStartValue" SG_ 2499762788 BATT_06_PyroFuseBlown 2;
BA_ "GenSigStartValue" SG_ 2499762788 BATT_06_vBrickUnderSev 2;
BA_ "GenSigStartValue" SG_ 2499762788 BATT_06_chargePrechargeTimeout 2;
BA_ "GenSigStartValue" SG_ 2499762788 BATT_06_ModuleThermFaultModerate 2;
BA_ "GenSigStartValue" SG_ 2499762788 BATT_06_ModuleThermFaultWarning 2;
BA_ "GenSigStartValue" SG_ 2499762788 BATT_07_SenseBrickImpHigh 2;
BA_ "GenSigStartValue" SG_ 2499762788 BATT_07_AFEfault 2;
BA_ "GenSigStartValue" SG_ 2499762788 BATT_07_AFEerror 2;
BA_ "GenSigStartValue" SG_ 2499762788 BATT_07_HostMIA 2;
BA_ "GenSigStartValue" SG_ 2499762788 BATT_07_TempAmbientOverSev 2;
BA_ "GenSigStartValue" SG_ 2499762788 BATT_07_TempAmbientOverMod 2;
BA_ "GenSigStartValue" SG_ 2499762788 BATT_07_TempAmbientOverWar 2;
BA_ "GenSigStartValue" SG_ 2499762788 BATT_07_AbnormReset 2;
BA_ "GenSigStartValue" SG_ 2499762788 BATT_07_SenseloadVoltErrorPri 2;
BA_ "GenSigStartValue" SG_ 2499762788 BATT_07_CalibrationInvalid 2;
BA_ "GenSigStartValue" SG_ 2499762788 BATT_07_TaskLockup 2;
BA_ "GenSigStartValue" SG_ 2499762788 BATT_07_RAMover 2;
BA_ "GenSigStartValue" SG_ 2499762788 BATT_07_BrickOverdischarge 2;
BA_ "GenSigStartValue" SG_ 2499762788 BATT_07_BrickOvercharge 2;
BA_ "GenSigStartValue" SG_ 2499762788 BATT_07_vBrickImbalance 2;
BA_ "GenSigStartValue" SG_ 2499762788 BATT_07_TempBrickImbalance 2;
BA_ "GenSigStartValue" SG_ 2499762788 BATT_07_CapPackLow 2;
BA_ "GenSigStartValue" SG_ 2499762788 BATT_07_rBrickHigh 2;
BA_ "GenSigStartValue" SG_ 2499762788 BATT_07_PowerpackInsuffErr 2;
BA_ "GenSigStartValue" SG_ 2499762788 BATT_07_BrickSoftShort 2;
BA_ "GenSigStartValue" SG_ 2499762788 BATT_07_chargeUndercurrent 2;
BA_ "GenSigStartValue" SG_ 2499762788 BATT_07_HVILcurrentSourceError 2;
BA_ "GenSigStartValue" SG_ 2499762788 BATT_07_SRS 2;
BA_ "GenSigStartValue" SG_ 2499762788 BATT_07_IsolationExtWar 2;
BA_ "GenSigStartValue" SG_ 2499762788 BATT_07_IsolationIntWar 2;
BA_ "GenSigStartValue" SG_ 2499762788 BATT_07_PyroFuseBlown 2;
BA_ "GenSigStartValue" SG_ 2499762788 BATT_07_vBrickUnderSev 2;
BA_ "GenSigStartValue" SG_ 2499762788 BATT_07_chargePrechargeTimeout 2;
BA_ "GenSigStartValue" SG_ 2499762788 BATT_07_ModuleThermFaultModerate 2;
BA_ "GenSigStartValue" SG_ 2499762788 BATT_07_ModuleThermFaultWarning 2;
BA_ "GenSigStartValue" SG_ 2499762788 BATT_08_SenseBrickImpHigh 2;
BA_ "GenSigStartValue" SG_ 2499762788 BATT_08_AFEfault 2;
BA_ "GenSigStartValue" SG_ 2499762788 BATT_08_AFEerror 2;
BA_ "GenSigStartValue" SG_ 2499762788 BATT_08_HostMIA 2;
BA_ "GenSigStartValue" SG_ 2499762788 BATT_08_TempAmbientOverSev 2;
BA_ "GenSigStartValue" SG_ 2499762788 BATT_08_TempAmbientOverMod 2;
BA_ "GenSigStartValue" SG_ 2499762788 BATT_08_TempAmbientOverWar 2;
BA_ "GenSigStartValue" SG_ 2499762788 BATT_08_AbnormReset 2;
BA_ "GenSigStartValue" SG_ 2499762788 BATT_08_SenseloadVoltErrorPri 2;
BA_ "GenSigStartValue" SG_ 2499762788 BATT_08_CalibrationInvalid 2;
BA_ "GenSigStartValue" SG_ 2499762788 BATT_08_TaskLockup 2;
BA_ "GenSigStartValue" SG_ 2499762788 BATT_08_RAMover 2;
BA_ "GenSigStartValue" SG_ 2499762788 BATT_08_BrickOverdischarge 2;
BA_ "GenSigStartValue" SG_ 2499762788 BATT_08_BrickOvercharge 2;
BA_ "GenSigStartValue" SG_ 2499762788 BATT_08_vBrickImbalance 2;
BA_ "GenSigStartValue" SG_ 2499762788 BATT_08_TempBrickImbalance 2;
BA_ "GenSigStartValue" SG_ 2499762788 BATT_08_CapPackLow 2;
BA_ "GenSigStartValue" SG_ 2499762788 BATT_08_rBrickHigh 2;
BA_ "GenSigStartValue" SG_ 2499762788 BATT_08_PowerpackInsuffErr 2;
BA_ "GenSigStartValue" SG_ 2499762788 BATT_08_BrickSoftShort 2;
BA_ "GenSigStartValue" SG_ 2499762788 BATT_08_chargeUndercurrent 2;
BA_ "GenSigStartValue" SG_ 2499762788 BATT_08_HVILcurrentSourceError 2;
BA_ "GenSigStartValue" SG_ 2499762788 BATT_08_SRS 2;
BA_ "GenSigStartValue" SG_ 2499762788 BATT_08_IsolationExtWar 2;
BA_ "GenSigStartValue" SG_ 2499762788 BATT_08_IsolationIntWar 2;
BA_ "GenSigStartValue" SG_ 2499762788 BATT_08_PyroFuseBlown 2;
BA_ "GenSigStartValue" SG_ 2499762788 BATT_08_vBrickUnderSev 2;
BA_ "GenSigStartValue" SG_ 2499762788 BATT_08_chargePrechargeTimeout 2;
BA_ "GenSigStartValue" SG_ 2499762788 BATT_08_ModuleThermFaultModerate 2;
BA_ "GenSigStartValue" SG_ 2499762788 BATT_08_ModuleThermFaultWarning 2;
BA_ "GenSigStartValue" SG_ 2499762788 BATT_09_SenseBrickImpHigh 2;
BA_ "GenSigStartValue" SG_ 2499762788 BATT_09_AFEfault 2;
BA_ "GenSigStartValue" SG_ 2499762788 BATT_09_AFEerror 2;
BA_ "GenSigStartValue" SG_ 2499762788 BATT_09_HostMIA 2;
BA_ "GenSigStartValue" SG_ 2499762788 BATT_09_TempAmbientOverSev 2;
BA_ "GenSigStartValue" SG_ 2499762788 BATT_09_TempAmbientOverMod 2;
BA_ "GenSigStartValue" SG_ 2499762788 BATT_09_TempAmbientOverWar 2;
BA_ "GenSigStartValue" SG_ 2499762788 BATT_09_AbnormReset 2;
BA_ "GenSigStartValue" SG_ 2499762788 BATT_09_SenseloadVoltErrorPri 2;
BA_ "GenSigStartValue" SG_ 2499762788 BATT_09_CalibrationInvalid 2;
BA_ "GenSigStartValue" SG_ 2499762788 BATT_09_TaskLockup 2;
BA_ "GenSigStartValue" SG_ 2499762788 BATT_09_RAMover 2;
BA_ "GenSigStartValue" SG_ 2499762788 BATT_09_BrickOverdischarge 2;
BA_ "GenSigStartValue" SG_ 2499762788 BATT_09_BrickOvercharge 2;
BA_ "GenSigStartValue" SG_ 2499762788 BATT_09_vBrickImbalance 2;
BA_ "GenSigStartValue" SG_ 2499762788 BATT_09_TempBrickImbalance 2;
BA_ "GenSigStartValue" SG_ 2499762788 BATT_09_CapPackLow 2;
BA_ "GenSigStartValue" SG_ 2499762788 BATT_09_rBrickHigh 2;
BA_ "GenSigStartValue" SG_ 2499762788 BATT_09_PowerpackInsuffErr 2;
BA_ "GenSigStartValue" SG_ 2499762788 BATT_09_BrickSoftShort 2;
BA_ "GenSigStartValue" SG_ 2499762788 BATT_09_chargeUndercurrent 2;
BA_ "GenSigStartValue" SG_ 2499762788 BATT_09_HVILcurrentSourceError 2;
BA_ "GenSigStartValue" SG_ 2499762788 BATT_09_SRS 2;
BA_ "GenSigStartValue" SG_ 2499762788 BATT_09_IsolationExtWar 2;
BA_ "GenSigStartValue" SG_ 2499762788 BATT_09_IsolationIntWar 2;
BA_ "GenSigStartValue" SG_ 2499762788 BATT_09_PyroFuseBlown 2;
BA_ "GenSigStartValue" SG_ 2499762788 BATT_09_vBrickUnderSev 2;
BA_ "GenSigStartValue" SG_ 2499762788 BATT_09_chargePrechargeTimeout 2;
BA_ "GenSigStartValue" SG_ 2499762788 BATT_09_ModuleThermFaultModerate 2;
BA_ "GenSigStartValue" SG_ 2499762788 BATT_09_ModuleThermFaultWarning 2;
BA_ "GenSigStartValue" SG_ 2499762788 BATT_10_SenseBrickImpHigh 2;
BA_ "GenSigStartValue" SG_ 2499762788 BATT_10_AFEfault 2;
BA_ "GenSigStartValue" SG_ 2499762788 BATT_10_AFEerror 2;
BA_ "GenSigStartValue" SG_ 2499762788 BATT_10_HostMIA 2;
BA_ "GenSigStartValue" SG_ 2499762788 BATT_10_TempAmbientOverSev 2;
BA_ "GenSigStartValue" SG_ 2499762788 BATT_10_TempAmbientOverMod 2;
BA_ "GenSigStartValue" SG_ 2499762788 BATT_10_TempAmbientOverWar 2;
BA_ "GenSigStartValue" SG_ 2499762788 BATT_10_AbnormReset 2;
BA_ "GenSigStartValue" SG_ 2499762788 BATT_10_SenseloadVoltErrorPri 2;
BA_ "GenSigStartValue" SG_ 2499762788 BATT_10_CalibrationInvalid 2;
BA_ "GenSigStartValue" SG_ 2499762788 BATT_10_TaskLockup 2;
BA_ "GenSigStartValue" SG_ 2499762788 BATT_10_RAMover 2;
BA_ "GenSigStartValue" SG_ 2499762788 BATT_10_BrickOverdischarge 2;
BA_ "GenSigStartValue" SG_ 2499762788 BATT_10_BrickOvercharge 2;
BA_ "GenSigStartValue" SG_ 2499762788 BATT_10_vBrickImbalance 2;
BA_ "GenSigStartValue" SG_ 2499762788 BATT_10_TempBrickImbalance 2;
BA_ "GenSigStartValue" SG_ 2499762788 BATT_10_CapPackLow 2;
BA_ "GenSigStartValue" SG_ 2499762788 BATT_10_rBrickHigh 2;
BA_ "GenSigStartValue" SG_ 2499762788 BATT_10_PowerpackInsuffErr 2;
BA_ "GenSigStartValue" SG_ 2499762788 BATT_10_BrickSoftShort 2;
BA_ "GenSigStartValue" SG_ 2499762788 BATT_10_chargeUndercurrent 2;
BA_ "GenSigStartValue" SG_ 2499762788 BATT_10_HVILcurrentSourceError 2;
BA_ "GenSigStartValue" SG_ 2499762788 BATT_10_SRS 2;
BA_ "GenSigStartValue" SG_ 2499762788 BATT_10_IsolationExtWar 2;
BA_ "GenSigStartValue" SG_ 2499762788 BATT_10_IsolationIntWar 2;
BA_ "GenSigStartValue" SG_ 2499762788 BATT_10_PyroFuseBlown 2;
BA_ "GenSigStartValue" SG_ 2499762788 BATT_10_vBrickUnderSev 2;
BA_ "GenSigStartValue" SG_ 2499762788 BATT_10_chargePrechargeTimeout 2;
BA_ "GenSigStartValue" SG_ 2499762788 BATT_10_ModuleThermFaultModerate 2;
BA_ "GenSigStartValue" SG_ 2499762788 BATT_10_ModuleThermFaultWarning 2;
BA_ "GenSigStartValue" SG_ 2499762788 BATT_11_SenseBrickImpHigh 2;
BA_ "GenSigStartValue" SG_ 2499762788 BATT_11_AFEfault 2;
BA_ "GenSigStartValue" SG_ 2499762788 BATT_11_AFEerror 2;
BA_ "GenSigStartValue" SG_ 2499762788 BATT_11_HostMIA 2;
BA_ "GenSigStartValue" SG_ 2499762788 BATT_11_TempAmbientOverSev 2;
BA_ "GenSigStartValue" SG_ 2499762788 BATT_11_TempAmbientOverMod 2;
BA_ "GenSigStartValue" SG_ 2499762788 BATT_11_TempAmbientOverWar 2;
BA_ "GenSigStartValue" SG_ 2499762788 BATT_11_AbnormReset 2;
BA_ "GenSigStartValue" SG_ 2499762788 BATT_11_SenseloadVoltErrorPri 2;
BA_ "GenSigStartValue" SG_ 2499762788 BATT_11_CalibrationInvalid 2;
BA_ "GenSigStartValue" SG_ 2499762788 BATT_11_TaskLockup 2;
BA_ "GenSigStartValue" SG_ 2499762788 BATT_11_RAMover 2;
BA_ "GenSigStartValue" SG_ 2499762788 BATT_11_BrickOverdischarge 2;
BA_ "GenSigStartValue" SG_ 2499762788 BATT_11_BrickOvercharge 2;
BA_ "GenSigStartValue" SG_ 2499762788 BATT_11_vBrickImbalance 2;
BA_ "GenSigStartValue" SG_ 2499762788 BATT_11_TempBrickImbalance 2;
BA_ "GenSigStartValue" SG_ 2499762788 BATT_11_CapPackLow 2;
BA_ "GenSigStartValue" SG_ 2499762788 BATT_11_rBrickHigh 2;
BA_ "GenSigStartValue" SG_ 2499762788 BATT_11_PowerpackInsuffErr 2;
BA_ "GenSigStartValue" SG_ 2499762788 BATT_11_BrickSoftShort 2;
BA_ "GenSigStartValue" SG_ 2499762788 BATT_11_chargeUndercurrent 2;
BA_ "GenSigStartValue" SG_ 2499762788 BATT_11_HVILcurrentSourceError 2;
BA_ "GenSigStartValue" SG_ 2499762788 BATT_11_SRS 2;
BA_ "GenSigStartValue" SG_ 2499762788 BATT_11_IsolationExtWar 2;
BA_ "GenSigStartValue" SG_ 2499762788 BATT_11_IsolationIntWar 2;
BA_ "GenSigStartValue" SG_ 2499762788 BATT_11_PyroFuseBlown 2;
BA_ "GenSigStartValue" SG_ 2499762788 BATT_11_vBrickUnderSev 2;
BA_ "GenSigStartValue" SG_ 2499762788 BATT_11_chargePrechargeTimeout 2;
BA_ "GenSigStartValue" SG_ 2499762788 BATT_11_ModuleThermFaultModerate 2;
BA_ "GenSigStartValue" SG_ 2499762788 BATT_11_ModuleThermFaultWarning 2;
BA_ "GenSigStartValue" SG_ 2499762788 BATT_12_SenseBrickImpHigh 2;
BA_ "GenSigStartValue" SG_ 2499762788 BATT_12_AFEfault 2;
BA_ "GenSigStartValue" SG_ 2499762788 BATT_12_AFEerror 2;
BA_ "GenSigStartValue" SG_ 2499762788 BATT_12_HostMIA 2;
BA_ "GenSigStartValue" SG_ 2499762788 BATT_12_TempAmbientOverSev 2;
BA_ "GenSigStartValue" SG_ 2499762788 BATT_12_TempAmbientOverMod 2;
BA_ "GenSigStartValue" SG_ 2499762788 BATT_12_TempAmbientOverWar 2;
BA_ "GenSigStartValue" SG_ 2499762788 BATT_12_AbnormReset 2;
BA_ "GenSigStartValue" SG_ 2499762788 BATT_12_SenseloadVoltErrorPri 2;
BA_ "GenSigStartValue" SG_ 2499762788 BATT_12_CalibrationInvalid 2;
BA_ "GenSigStartValue" SG_ 2499762788 BATT_12_TaskLockup 2;
BA_ "GenSigStartValue" SG_ 2499762788 BATT_12_RAMover 2;
BA_ "GenSigStartValue" SG_ 2499762788 BATT_12_BrickOverdischarge 2;
BA_ "GenSigStartValue" SG_ 2499762788 BATT_12_BrickOvercharge 2;
BA_ "GenSigStartValue" SG_ 2499762788 BATT_12_vBrickImbalance 2;
BA_ "GenSigStartValue" SG_ 2499762788 BATT_12_TempBrickImbalance 2;
BA_ "GenSigStartValue" SG_ 2499762788 BATT_12_CapPackLow 2;
BA_ "GenSigStartValue" SG_ 2499762788 BATT_12_rBrickHigh 2;
BA_ "GenSigStartValue" SG_ 2499762788 BATT_12_PowerpackInsuffErr 2;
BA_ "GenSigStartValue" SG_ 2499762788 BATT_12_BrickSoftShort 2;
BA_ "GenSigStartValue" SG_ 2499762788 BATT_12_chargeUndercurrent 2;
BA_ "GenSigStartValue" SG_ 2499762788 BATT_12_HVILcurrentSourceError 2;
BA_ "GenSigStartValue" SG_ 2499762788 BATT_12_SRS 2;
BA_ "GenSigStartValue" SG_ 2499762788 BATT_12_IsolationExtWar 2;
BA_ "GenSigStartValue" SG_ 2499762788 BATT_12_IsolationIntWar 2;
BA_ "GenSigStartValue" SG_ 2499762788 BATT_12_PyroFuseBlown 2;
BA_ "GenSigStartValue" SG_ 2499762788 BATT_12_vBrickUnderSev 2;
BA_ "GenSigStartValue" SG_ 2499762788 BATT_12_chargePrechargeTimeout 2;
BA_ "GenSigStartValue" SG_ 2499762788 BATT_12_ModuleThermFaultModerate 2;
BA_ "GenSigStartValue" SG_ 2499762788 BATT_12_ModuleThermFaultWarning 2;
BA_ "GenSigStartValue" SG_ 2499762788 BATT_13_SenseBrickImpHigh 2;
BA_ "GenSigStartValue" SG_ 2499762788 BATT_13_AFEfault 2;
BA_ "GenSigStartValue" SG_ 2499762788 BATT_13_AFEerror 2;
BA_ "GenSigStartValue" SG_ 2499762788 BATT_13_HostMIA 2;
BA_ "GenSigStartValue" SG_ 2499762788 BATT_13_TempAmbientOverSev 2;
BA_ "GenSigStartValue" SG_ 2499762788 BATT_13_TempAmbientOverMod 2;
BA_ "GenSigStartValue" SG_ 2499762788 BATT_13_TempAmbientOverWar 2;
BA_ "GenSigStartValue" SG_ 2499762788 BATT_13_AbnormReset 2;
BA_ "GenSigStartValue" SG_ 2499762788 BATT_13_SenseloadVoltErrorPri 2;
BA_ "GenSigStartValue" SG_ 2499762788 BATT_13_CalibrationInvalid 2;
BA_ "GenSigStartValue" SG_ 2499762788 BATT_13_TaskLockup 2;
BA_ "GenSigStartValue" SG_ 2499762788 BATT_13_RAMover 2;
BA_ "GenSigStartValue" SG_ 2499762788 BATT_13_BrickOverdischarge 2;
BA_ "GenSigStartValue" SG_ 2499762788 BATT_13_BrickOvercharge 2;
BA_ "GenSigStartValue" SG_ 2499762788 BATT_13_vBrickImbalance 2;
BA_ "GenSigStartValue" SG_ 2499762788 BATT_13_TempBrickImbalance 2;
BA_ "GenSigStartValue" SG_ 2499762788 BATT_13_CapPackLow 2;
BA_ "GenSigStartValue" SG_ 2499762788 BATT_13_rBrickHigh 2;
BA_ "GenSigStartValue" SG_ 2499762788 BATT_13_PowerpackInsuffErr 2;
BA_ "GenSigStartValue" SG_ 2499762788 BATT_13_BrickSoftShort 2;
BA_ "GenSigStartValue" SG_ 2499762788 BATT_13_chargeUndercurrent 2;
BA_ "GenSigStartValue" SG_ 2499762788 BATT_13_HVILcurrentSourceError 2;
BA_ "GenSigStartValue" SG_ 2499762788 BATT_13_SRS 2;
BA_ "GenSigStartValue" SG_ 2499762788 BATT_13_IsolationExtWar 2;
BA_ "GenSigStartValue" SG_ 2499762788 BATT_13_IsolationIntWar 2;
BA_ "GenSigStartValue" SG_ 2499762788 BATT_13_PyroFuseBlown 2;
BA_ "GenSigStartValue" SG_ 2499762788 BATT_13_vBrickUnderSev 2;
BA_ "GenSigStartValue" SG_ 2499762788 BATT_13_chargePrechargeTimeout 2;
BA_ "GenSigStartValue" SG_ 2499762788 BATT_13_ModuleThermFaultModerate 2;
BA_ "GenSigStartValue" SG_ 2499762788 BATT_13_ModuleThermFaultWarning 2;
BA_ "GenSigStartValue" SG_ 2499762788 BATT_14_SenseBrickImpHigh 2;
BA_ "GenSigStartValue" SG_ 2499762788 BATT_14_AFEfault 2;
BA_ "GenSigStartValue" SG_ 2499762788 BATT_14_AFEerror 2;
BA_ "GenSigStartValue" SG_ 2499762788 BATT_14_HostMIA 2;
BA_ "GenSigStartValue" SG_ 2499762788 BATT_14_TempAmbientOverSev 2;
BA_ "GenSigStartValue" SG_ 2499762788 BATT_14_TempAmbientOverMod 2;
BA_ "GenSigStartValue" SG_ 2499762788 BATT_14_TempAmbientOverWar 2;
BA_ "GenSigStartValue" SG_ 2499762788 BATT_14_AbnormReset 2;
BA_ "GenSigStartValue" SG_ 2499762788 BATT_14_SenseloadVoltErrorPri 2;
BA_ "GenSigStartValue" SG_ 2499762788 BATT_14_CalibrationInvalid 2;
BA_ "GenSigStartValue" SG_ 2499762788 BATT_14_TaskLockup 2;
BA_ "GenSigStartValue" SG_ 2499762788 BATT_14_RAMover 2;
BA_ "GenSigStartValue" SG_ 2499762788 BATT_14_BrickOverdischarge 2;
BA_ "GenSigStartValue" SG_ 2499762788 BATT_14_BrickOvercharge 2;
BA_ "GenSigStartValue" SG_ 2499762788 BATT_14_vBrickImbalance 2;
BA_ "GenSigStartValue" SG_ 2499762788 BATT_14_TempBrickImbalance 2;
BA_ "GenSigStartValue" SG_ 2499762788 BATT_14_CapPackLow 2;
BA_ "GenSigStartValue" SG_ 2499762788 BATT_14_rBrickHigh 2;
BA_ "GenSigStartValue" SG_ 2499762788 BATT_14_PowerpackInsuffErr 2;
BA_ "GenSigStartValue" SG_ 2499762788 BATT_14_BrickSoftShort 2;
BA_ "GenSigStartValue" SG_ 2499762788 BATT_14_chargeUndercurrent 2;
BA_ "GenSigStartValue" SG_ 2499762788 BATT_14_HVILcurrentSourceError 2;
BA_ "GenSigStartValue" SG_ 2499762788 BATT_14_SRS 2;
BA_ "GenSigStartValue" SG_ 2499762788 BATT_14_IsolationExtWar 2;
BA_ "GenSigStartValue" SG_ 2499762788 BATT_14_IsolationIntWar 2;
BA_ "GenSigStartValue" SG_ 2499762788 BATT_14_PyroFuseBlown 2;
BA_ "GenSigStartValue" SG_ 2499762788 BATT_14_vBrickUnderSev 2;
BA_ "GenSigStartValue" SG_ 2499762788 BATT_14_chargePrechargeTimeout 2;
BA_ "GenSigStartValue" SG_ 2499762788 BATT_14_ModuleThermFaultModerate 2;
BA_ "GenSigStartValue" SG_ 2499762788 BATT_14_ModuleThermFaultWarning 2;
BA_ "GenSigStartValue" SG_ 2499762788 BATT_15_SenseBrickImpHigh 2;
BA_ "GenSigStartValue" SG_ 2499762788 BATT_15_AFEfault 2;
BA_ "GenSigStartValue" SG_ 2499762788 BATT_15_AFEerror 2;
BA_ "GenSigStartValue" SG_ 2499762788 BATT_15_HostMIA 2;
BA_ "GenSigStartValue" SG_ 2499762788 BATT_15_TempAmbientOverSev 2;
BA_ "GenSigStartValue" SG_ 2499762788 BATT_15_TempAmbientOverMod 2;
BA_ "GenSigStartValue" SG_ 2499762788 BATT_15_TempAmbientOverWar 2;
BA_ "GenSigStartValue" SG_ 2499762788 BATT_15_AbnormReset 2;
BA_ "GenSigStartValue" SG_ 2499762788 BATT_15_SenseloadVoltErrorPri 2;
BA_ "GenSigStartValue" SG_ 2499762788 BATT_15_CalibrationInvalid 2;
BA_ "GenSigStartValue" SG_ 2499762788 BATT_15_TaskLockup 2;
BA_ "GenSigStartValue" SG_ 2499762788 BATT_15_RAMover 2;
BA_ "GenSigStartValue" SG_ 2499762788 BATT_15_BrickOverdischarge 2;
BA_ "GenSigStartValue" SG_ 2499762788 BATT_15_BrickOvercharge 2;
BA_ "GenSigStartValue" SG_ 2499762788 BATT_15_vBrickImbalance 2;
BA_ "GenSigStartValue" SG_ 2499762788 BATT_15_TempBrickImbalance 2;
BA_ "GenSigStartValue" SG_ 2499762788 BATT_15_CapPackLow 2;
BA_ "GenSigStartValue" SG_ 2499762788 BATT_15_rBrickHigh 2;
BA_ "GenSigStartValue" SG_ 2499762788 BATT_15_PowerpackInsuffErr 2;
BA_ "GenSigStartValue" SG_ 2499762788 BATT_15_BrickSoftShort 2;
BA_ "GenSigStartValue" SG_ 2499762788 BATT_15_chargeUndercurrent 2;
BA_ "GenSigStartValue" SG_ 2499762788 BATT_15_HVILcurrentSourceError 2;
BA_ "GenSigStartValue" SG_ 2499762788 BATT_15_SRS 2;
BA_ "GenSigStartValue" SG_ 2499762788 BATT_15_IsolationExtWar 2;
BA_ "GenSigStartValue" SG_ 2499762788 BATT_15_IsolationIntWar 2;
BA_ "GenSigStartValue" SG_ 2499762788 BATT_15_PyroFuseBlown 2;
BA_ "GenSigStartValue" SG_ 2499762788 BATT_15_vBrickUnderSev 2;
BA_ "GenSigStartValue" SG_ 2499762788 BATT_15_chargePrechargeTimeout 2;
BA_ "GenSigStartValue" SG_ 2499762788 BATT_15_ModuleThermFaultModerate 2;
BA_ "GenSigStartValue" SG_ 2499762788 BATT_15_ModuleThermFaultWarning 2;
VAL_ 2499762788 BATT_01_SenseBrickImpHigh 3 "Error" 2 "SNA" 1 "Active" 0 "Inactive" ;
VAL_ 2499762788 BATT_01_AFEfault 3 "Error" 2 "SNA" 1 "Active" 0 "Inactive" ;
VAL_ 2499762788 BATT_01_AFEerror 3 "Error" 2 "SNA" 1 "Active" 0 "Inactive" ;
VAL_ 2499762788 BATT_01_HostMIA 3 "Error" 2 "SNA" 1 "Active" 0 "Inactive" ;
VAL_ 2499762788 BATT_01_TempAmbientOverSev 3 "Error" 2 "SNA" 1 "Active" 0 "Inactive" ;
VAL_ 2499762788 BATT_01_TempAmbientOverMod 3 "Error" 2 "SNA" 1 "Active" 0 "Inactive" ;
VAL_ 2499762788 BATT_01_TempAmbientOverWar 3 "Error" 2 "SNA" 1 "Active" 0 "Inactive" ;
VAL_ 2499762788 BATT_01_AbnormReset 3 "Error" 2 "SNA" 1 "Active" 0 "Inactive" ;
VAL_ 2499762788 BATT_01_SenseloadVoltErrorPri 3 "Error" 2 "SNA" 1 "Active" 0 "Inactive" ;
VAL_ 2499762788 BATT_01_CalibrationInvalid 3 "Error" 2 "SNA" 1 "Active" 0 "Inactive" ;
VAL_ 2499762788 BATT_01_TaskLockup 3 "Error" 2 "SNA" 1 "Active" 0 "Inactive" ;
VAL_ 2499762788 BATT_01_RAMover 3 "Error" 2 "SNA" 1 "Active" 0 "Inactive" ;
VAL_ 2499762788 BATT_01_BrickOverdischarge 3 "Error" 2 "SNA" 1 "Active" 0 "Inactive" ;
VAL_ 2499762788 BATT_01_BrickOvercharge 3 "Error" 2 "SNA" 1 "Active" 0 "Inactive" ;
VAL_ 2499762788 BATT_01_vBrickImbalance 3 "Error" 2 "SNA" 1 "Active" 0 "Inactive" ;
VAL_ 2499762788 BATT_01_TempBrickImbalance 3 "Error" 2 "SNA" 1 "Active" 0 "Inactive" ;
VAL_ 2499762788 BATT_01_CapPackLow 3 "Error" 2 "SNA" 1 "Active" 0 "Inactive" ;
VAL_ 2499762788 BATT_01_rBrickHigh 3 "Error" 2 "SNA" 1 "Active" 0 "Inactive" ;
VAL_ 2499762788 BATT_01_PowerpackInsuffErr 3 "Error" 2 "SNA" 1 "Active" 0 "Inactive" ;
VAL_ 2499762788 BATT_01_BrickSoftShort 3 "Error" 2 "SNA" 1 "Active" 0 "Inactive" ;
VAL_ 2499762788 BATT_01_chargeUndercurrent 3 "Error" 2 "SNA" 1 "Active" 0 "Inactive" ;
VAL_ 2499762788 BATT_01_HVILcurrentSourceError 3 "Error" 2 "SNA" 1 "Active" 0 "Inactive" ;
VAL_ 2499762788 BATT_01_SRS 3 "Error" 2 "SNA" 1 "Active" 0 "Inactive" ;
VAL_ 2499762788 BATT_01_IsolationExtWar 3 "Error" 2 "SNA" 1 "Active" 0 "Inactive" ;
VAL_ 2499762788 BATT_01_IsolationIntWar 3 "Error" 2 "SNA" 1 "Active" 0 "Inactive" ;
VAL_ 2499762788 BATT_01_PyroFuseBlown 3 "Error" 2 "SNA" 1 "Active" 0 "Inactive" ;
VAL_ 2499762788 BATT_01_vBrickUnderSev 3 "Error" 2 "SNA" 1 "Active" 0 "Inactive" ;
VAL_ 2499762788 BATT_01_chargePrechargeTimeout 3 "Error" 2 "SNA" 1 "Active" 0 "Inactive" ;
VAL_ 2499762788 BATT_01_ModuleThermFaultModerate 3 "Error" 2 "SNA" 1 "Active" 0 "Inactive" ;
VAL_ 2499762788 BATT_01_ModuleThermFaultWarning 3 "Error" 2 "SNA" 1 "Active" 0 "Inactive" ;
VAL_ 2499762788 BATT_02_SenseBrickImpHigh 3 "Error" 2 "SNA" 1 "Active" 0 "Inactive" ;
VAL_ 2499762788 BATT_02_AFEfault 3 "Error" 2 "SNA" 1 "Active" 0 "Inactive" ;
VAL_ 2499762788 BATT_02_AFEerror 3 "Error" 2 "SNA" 1 "Active" 0 "Inactive" ;
VAL_ 2499762788 BATT_02_HostMIA 3 "Error" 2 "SNA" 1 "Active" 0 "Inactive" ;
VAL_ 2499762788 BATT_02_TempAmbientOverSev 3 "Error" 2 "SNA" 1 "Active" 0 "Inactive" ;
VAL_ 2499762788 BATT_02_TempAmbientOverMod 3 "Error" 2 "SNA" 1 "Active" 0 "Inactive" ;
VAL_ 2499762788 BATT_02_TempAmbientOverWar 3 "Error" 2 "SNA" 1 "Active" 0 "Inactive" ;
VAL_ 2499762788 BATT_02_AbnormReset 3 "Error" 2 "SNA" 1 "Active" 0 "Inactive" ;
VAL_ 2499762788 BATT_02_SenseloadVoltErrorPri 3 "Error" 2 "SNA" 1 "Active" 0 "Inactive" ;
VAL_ 2499762788 BATT_02_CalibrationInvalid 3 "Error" 2 "SNA" 1 "Active" 0 "Inactive" ;
VAL_ 2499762788 BATT_02_TaskLockup 3 "Error" 2 "SNA" 1 "Active" 0 "Inactive" ;
VAL_ 2499762788 BATT_02_RAMover 3 "Error" 2 "SNA" 1 "Active" 0 "Inactive" ;
VAL_ 2499762788 BATT_02_BrickOverdischarge 3 "Error" 2 "SNA" 1 "Active" 0 "Inactive" ;
VAL_ 2499762788 BATT_02_BrickOvercharge 3 "Error" 2 "SNA" 1 "Active" 0 "Inactive" ;
VAL_ 2499762788 BATT_02_vBrickImbalance 3 "Error" 2 "SNA" 1 "Active" 0 "Inactive" ;
VAL_ 2499762788 BATT_02_TempBrickImbalance 3 "Error" 2 "SNA" 1 "Active" 0 "Inactive" ;
VAL_ 2499762788 BATT_02_CapPackLow 3 "Error" 2 "SNA" 1 "Active" 0 "Inactive" ;
VAL_ 2499762788 BATT_02_rBrickHigh 3 "Error" 2 "SNA" 1 "Active" 0 "Inactive" ;
VAL_ 2499762788 BATT_02_PowerpackInsuffErr 3 "Error" 2 "SNA" 1 "Active" 0 "Inactive" ;
VAL_ 2499762788 BATT_02_BrickSoftShort 3 "Error" 2 "SNA" 1 "Active" 0 "Inactive" ;
VAL_ 2499762788 BATT_02_chargeUndercurrent 3 "Error" 2 "SNA" 1 "Active" 0 "Inactive" ;
VAL_ 2499762788 BATT_02_HVILcurrentSourceError 3 "Error" 2 "SNA" 1 "Active" 0 "Inactive" ;
VAL_ 2499762788 BATT_02_SRS 3 "Error" 2 "SNA" 1 "Active" 0 "Inactive" ;
VAL_ 2499762788 BATT_02_IsolationExtWar 3 "Error" 2 "SNA" 1 "Active" 0 "Inactive" ;
VAL_ 2499762788 BATT_02_IsolationIntWar 3 "Error" 2 "SNA" 1 "Active" 0 "Inactive" ;
VAL_ 2499762788 BATT_02_PyroFuseBlown 3 "Error" 2 "SNA" 1 "Active" 0 "Inactive" ;
VAL_ 2499762788 BATT_02_vBrickUnderSev 3 "Error" 2 "SNA" 1 "Active" 0 "Inactive" ;
VAL_ 2499762788 BATT_02_chargePrechargeTimeout 3 "Error" 2 "SNA" 1 "Active" 0 "Inactive" ;
VAL_ 2499762788 BATT_02_ModuleThermFaultModerate 3 "Error" 2 "SNA" 1 "Active" 0 "Inactive" ;
VAL_ 2499762788 BATT_02_ModuleThermFaultWarning 3 "Error" 2 "SNA" 1 "Active" 0 "Inactive" ;
VAL_ 2499762788 BATT_03_SenseBrickImpHigh 3 "Error" 2 "SNA" 1 "Active" 0 "Inactive" ;
VAL_ 2499762788 BATT_03_AFEfault 3 "Error" 2 "SNA" 1 "Active" 0 "Inactive" ;
VAL_ 2499762788 BATT_03_AFEerror 3 "Error" 2 "SNA" 1 "Active" 0 "Inactive" ;
VAL_ 2499762788 BATT_03_HostMIA 3 "Error" 2 "SNA" 1 "Active" 0 "Inactive" ;
VAL_ 2499762788 BATT_03_TempAmbientOverSev 3 "Error" 2 "SNA" 1 "Active" 0 "Inactive" ;
VAL_ 2499762788 BATT_03_TempAmbientOverMod 3 "Error" 2 "SNA" 1 "Active" 0 "Inactive" ;
VAL_ 2499762788 BATT_03_TempAmbientOverWar 3 "Error" 2 "SNA" 1 "Active" 0 "Inactive" ;
VAL_ 2499762788 BATT_03_AbnormReset 3 "Error" 2 "SNA" 1 "Active" 0 "Inactive" ;
VAL_ 2499762788 BATT_03_SenseloadVoltErrorPri 3 "Error" 2 "SNA" 1 "Active" 0 "Inactive" ;
VAL_ 2499762788 BATT_03_CalibrationInvalid 3 "Error" 2 "SNA" 1 "Active" 0 "Inactive" ;
VAL_ 2499762788 BATT_03_TaskLockup 3 "Error" 2 "SNA" 1 "Active" 0 "Inactive" ;
VAL_ 2499762788 BATT_03_RAMover 3 "Error" 2 "SNA" 1 "Active" 0 "Inactive" ;
VAL_ 2499762788 BATT_03_BrickOverdischarge 3 "Error" 2 "SNA" 1 "Active" 0 "Inactive" ;
VAL_ 2499762788 BATT_03_BrickOvercharge 3 "Error" 2 "SNA" 1 "Active" 0 "Inactive" ;
VAL_ 2499762788 BATT_03_vBrickImbalance 3 "Error" 2 "SNA" 1 "Active" 0 "Inactive" ;
VAL_ 2499762788 BATT_03_TempBrickImbalance 3 "Error" 2 "SNA" 1 "Active" 0 "Inactive" ;
VAL_ 2499762788 BATT_03_CapPackLow 3 "Error" 2 "SNA" 1 "Active" 0 "Inactive" ;
VAL_ 2499762788 BATT_03_rBrickHigh 3 "Error" 2 "SNA" 1 "Active" 0 "Inactive" ;
VAL_ 2499762788 BATT_03_PowerpackInsuffErr 3 "Error" 2 "SNA" 1 "Active" 0 "Inactive" ;
VAL_ 2499762788 BATT_03_BrickSoftShort 3 "Error" 2 "SNA" 1 "Active" 0 "Inactive" ;
VAL_ 2499762788 BATT_03_chargeUndercurrent 3 "Error" 2 "SNA" 1 "Active" 0 "Inactive" ;
VAL_ 2499762788 BATT_03_HVILcurrentSourceError 3 "Error" 2 "SNA" 1 "Active" 0 "Inactive" ;
VAL_ 2499762788 BATT_03_SRS 3 "Error" 2 "SNA" 1 "Active" 0 "Inactive" ;
VAL_ 2499762788 BATT_03_IsolationExtWar 3 "Error" 2 "SNA" 1 "Active" 0 "Inactive" ;
VAL_ 2499762788 BATT_03_IsolationIntWar 3 "Error" 2 "SNA" 1 "Active" 0 "Inactive" ;
VAL_ 2499762788 BATT_03_PyroFuseBlown 3 "Error" 2 "SNA" 1 "Active" 0 "Inactive" ;
VAL_ 2499762788 BATT_03_vBrickUnderSev 3 "Error" 2 "SNA" 1 "Active" 0 "Inactive" ;
VAL_ 2499762788 BATT_03_chargePrechargeTimeout 3 "Error" 2 "SNA" 1 "Active" 0 "Inactive" ;
VAL_ 2499762788 BATT_03_ModuleThermFaultModerate 3 "Error" 2 "SNA" 1 "Active" 0 "Inactive" ;
VAL_ 2499762788 BATT_03_ModuleThermFaultWarning 3 "Error" 2 "SNA" 1 "Active" 0 "Inactive" ;
VAL_ 2499762788 BATT_04_SenseBrickImpHigh 3 "Error" 2 "SNA" 1 "Active" 0 "Inactive" ;
VAL_ 2499762788 BATT_04_AFEfault 3 "Error" 2 "SNA" 1 "Active" 0 "Inactive" ;
VAL_ 2499762788 BATT_04_AFEerror 3 "Error" 2 "SNA" 1 "Active" 0 "Inactive" ;
VAL_ 2499762788 BATT_04_HostMIA 3 "Error" 2 "SNA" 1 "Active" 0 "Inactive" ;
VAL_ 2499762788 BATT_04_TempAmbientOverSev 3 "Error" 2 "SNA" 1 "Active" 0 "Inactive" ;
VAL_ 2499762788 BATT_04_TempAmbientOverMod 3 "Error" 2 "SNA" 1 "Active" 0 "Inactive" ;
VAL_ 2499762788 BATT_04_TempAmbientOverWar 3 "Error" 2 "SNA" 1 "Active" 0 "Inactive" ;
VAL_ 2499762788 BATT_04_AbnormReset 3 "Error" 2 "SNA" 1 "Active" 0 "Inactive" ;
VAL_ 2499762788 BATT_04_SenseloadVoltErrorPri 3 "Error" 2 "SNA" 1 "Active" 0 "Inactive" ;
VAL_ 2499762788 BATT_04_CalibrationInvalid 3 "Error" 2 "SNA" 1 "Active" 0 "Inactive" ;
VAL_ 2499762788 BATT_04_TaskLockup 3 "Error" 2 "SNA" 1 "Active" 0 "Inactive" ;
VAL_ 2499762788 BATT_04_RAMover 3 "Error" 2 "SNA" 1 "Active" 0 "Inactive" ;
VAL_ 2499762788 BATT_04_BrickOverdischarge 3 "Error" 2 "SNA" 1 "Active" 0 "Inactive" ;
VAL_ 2499762788 BATT_04_BrickOvercharge 3 "Error" 2 "SNA" 1 "Active" 0 "Inactive" ;
VAL_ 2499762788 BATT_04_vBrickImbalance 3 "Error" 2 "SNA" 1 "Active" 0 "Inactive" ;
VAL_ 2499762788 BATT_04_TempBrickImbalance 3 "Error" 2 "SNA" 1 "Active" 0 "Inactive" ;
VAL_ 2499762788 BATT_04_CapPackLow 3 "Error" 2 "SNA" 1 "Active" 0 "Inactive" ;
VAL_ 2499762788 BATT_04_rBrickHigh 3 "Error" 2 "SNA" 1 "Active" 0 "Inactive" ;
VAL_ 2499762788 BATT_04_PowerpackInsuffErr 3 "Error" 2 "SNA" 1 "Active" 0 "Inactive" ;
VAL_ 2499762788 BATT_04_BrickSoftShort 3 "Error" 2 "SNA" 1 "Active" 0 "Inactive" ;
VAL_ 2499762788 BATT_04_chargeUndercurrent 3 "Error" 2 "SNA" 1 "Active" 0 "Inactive" ;
VAL_ 2499762788 BATT_04_HVILcurrentSourceError 3 "Error" 2 "SNA" 1 "Active" 0 "Inactive" ;
VAL_ 2499762788 BATT_04_SRS 3 "Error" 2 "SNA" 1 "Active" 0 "Inactive" ;
VAL_ 2499762788 BATT_04_IsolationExtWar 3 "Error" 2 "SNA" 1 "Active" 0 "Inactive" ;
VAL_ 2499762788 BATT_04_IsolationIntWar 3 "Error" 2 "SNA" 1 "Active" 0 "Inactive" ;
VAL_ 2499762788 BATT_04_PyroFuseBlown 3 "Error" 2 "SNA" 1 "Active" 0 "Inactive" ;
VAL_ 2499762788 BATT_04_vBrickUnderSev 3 "Error" 2 "SNA" 1 "Active" 0 "Inactive" ;
VAL_ 2499762788 BATT_04_chargePrechargeTimeout 3 "Error" 2 "SNA" 1 "Active" 0 "Inactive" ;
VAL_ 2499762788 BATT_04_ModuleThermFaultModerate 3 "Error" 2 "SNA" 1 "Active" 0 "Inactive" ;
VAL_ 2499762788 BATT_04_ModuleThermFaultWarning 3 "Error" 2 "SNA" 1 "Active" 0 "Inactive" ;
VAL_ 2499762788 BATT_05_SenseBrickImpHigh 3 "Error" 2 "SNA" 1 "Active" 0 "Inactive" ;
VAL_ 2499762788 BATT_05_AFEfault 3 "Error" 2 "SNA" 1 "Active" 0 "Inactive" ;
VAL_ 2499762788 BATT_05_AFEerror 3 "Error" 2 "SNA" 1 "Active" 0 "Inactive" ;
VAL_ 2499762788 BATT_05_HostMIA 3 "Error" 2 "SNA" 1 "Active" 0 "Inactive" ;
VAL_ 2499762788 BATT_05_TempAmbientOverSev 3 "Error" 2 "SNA" 1 "Active" 0 "Inactive" ;
VAL_ 2499762788 BATT_05_TempAmbientOverMod 3 "Error" 2 "SNA" 1 "Active" 0 "Inactive" ;
VAL_ 2499762788 BATT_05_TempAmbientOverWar 3 "Error" 2 "SNA" 1 "Active" 0 "Inactive" ;
VAL_ 2499762788 BATT_05_AbnormReset 3 "Error" 2 "SNA" 1 "Active" 0 "Inactive" ;
VAL_ 2499762788 BATT_05_SenseloadVoltErrorPri 3 "Error" 2 "SNA" 1 "Active" 0 "Inactive" ;
VAL_ 2499762788 BATT_05_CalibrationInvalid 3 "Error" 2 "SNA" 1 "Active" 0 "Inactive" ;
VAL_ 2499762788 BATT_05_TaskLockup 3 "Error" 2 "SNA" 1 "Active" 0 "Inactive" ;
VAL_ 2499762788 BATT_05_RAMover 3 "Error" 2 "SNA" 1 "Active" 0 "Inactive" ;
VAL_ 2499762788 BATT_05_BrickOverdischarge 3 "Error" 2 "SNA" 1 "Active" 0 "Inactive" ;
VAL_ 2499762788 BATT_05_BrickOvercharge 3 "Error" 2 "SNA" 1 "Active" 0 "Inactive" ;
VAL_ 2499762788 BATT_05_vBrickImbalance 3 "Error" 2 "SNA" 1 "Active" 0 "Inactive" ;
VAL_ 2499762788 BATT_05_TempBrickImbalance 3 "Error" 2 "SNA" 1 "Active" 0 "Inactive" ;
VAL_ 2499762788 BATT_05_CapPackLow 3 "Error" 2 "SNA" 1 "Active" 0 "Inactive" ;
VAL_ 2499762788 BATT_05_rBrickHigh 3 "Error" 2 "SNA" 1 "Active" 0 "Inactive" ;
VAL_ 2499762788 BATT_05_PowerpackInsuffErr 3 "Error" 2 "SNA" 1 "Active" 0 "Inactive" ;
VAL_ 2499762788 BATT_05_BrickSoftShort 3 "Error" 2 "SNA" 1 "Active" 0 "Inactive" ;
VAL_ 2499762788 BATT_05_chargeUndercurrent 3 "Error" 2 "SNA" 1 "Active" 0 "Inactive" ;
VAL_ 2499762788 BATT_05_HVILcurrentSourceError 3 "Error" 2 "SNA" 1 "Active" 0 "Inactive" ;
VAL_ 2499762788 BATT_05_SRS 3 "Error" 2 "SNA" 1 "Active" 0 "Inactive" ;
VAL_ 2499762788 BATT_05_IsolationExtWar 3 "Error" 2 "SNA" 1 "Active" 0 "Inactive" ;
VAL_ 2499762788 BATT_05_IsolationIntWar 3 "Error" 2 "SNA" 1 "Active" 0 "Inactive" ;
VAL_ 2499762788 BATT_05_PyroFuseBlown 3 "Error" 2 "SNA" 1 "Active" 0 "Inactive" ;
VAL_ 2499762788 BATT_05_vBrickUnderSev 3 "Error" 2 "SNA" 1 "Active" 0 "Inactive" ;
VAL_ 2499762788 BATT_05_chargePrechargeTimeout 3 "Error" 2 "SNA" 1 "Active" 0 "Inactive" ;
VAL_ 2499762788 BATT_05_ModuleThermFaultModerate 3 "Error" 2 "SNA" 1 "Active" 0 "Inactive" ;
VAL_ 2499762788 BATT_05_ModuleThermFaultWarning 3 "Error" 2 "SNA" 1 "Active" 0 "Inactive" ;
VAL_ 2499762788 BATT_06_SenseBrickImpHigh 3 "Error" 2 "SNA" 1 "Active" 0 "Inactive" ;
VAL_ 2499762788 BATT_06_AFEfault 3 "Error" 2 "SNA" 1 "Active" 0 "Inactive" ;
VAL_ 2499762788 BATT_06_AFEerror 3 "Error" 2 "SNA" 1 "Active" 0 "Inactive" ;
VAL_ 2499762788 BATT_06_HostMIA 3 "Error" 2 "SNA" 1 "Active" 0 "Inactive" ;
VAL_ 2499762788 BATT_06_TempAmbientOverSev 3 "Error" 2 "SNA" 1 "Active" 0 "Inactive" ;
VAL_ 2499762788 BATT_06_TempAmbientOverMod 3 "Error" 2 "SNA" 1 "Active" 0 "Inactive" ;
VAL_ 2499762788 BATT_06_TempAmbientOverWar 3 "Error" 2 "SNA" 1 "Active" 0 "Inactive" ;
VAL_ 2499762788 BATT_06_AbnormReset 3 "Error" 2 "SNA" 1 "Active" 0 "Inactive" ;
VAL_ 2499762788 BATT_06_SenseloadVoltErrorPri 3 "Error" 2 "SNA" 1 "Active" 0 "Inactive" ;
VAL_ 2499762788 BATT_06_CalibrationInvalid 3 "Error" 2 "SNA" 1 "Active" 0 "Inactive" ;
VAL_ 2499762788 BATT_06_TaskLockup 3 "Error" 2 "SNA" 1 "Active" 0 "Inactive" ;
VAL_ 2499762788 BATT_06_RAMover 3 "Error" 2 "SNA" 1 "Active" 0 "Inactive" ;
VAL_ 2499762788 BATT_06_BrickOverdischarge 3 "Error" 2 "SNA" 1 "Active" 0 "Inactive" ;
VAL_ 2499762788 BATT_06_BrickOvercharge 3 "Error" 2 "SNA" 1 "Active" 0 "Inactive" ;
VAL_ 2499762788 BATT_06_vBrickImbalance 3 "Error" 2 "SNA" 1 "Active" 0 "Inactive" ;
VAL_ 2499762788 BATT_06_TempBrickImbalance 3 "Error" 2 "SNA" 1 "Active" 0 "Inactive" ;
VAL_ 2499762788 BATT_06_CapPackLow 3 "Error" 2 "SNA" 1 "Active" 0 "Inactive" ;
VAL_ 2499762788 BATT_06_rBrickHigh 3 "Error" 2 "SNA" 1 "Active" 0 "Inactive" ;
VAL_ 2499762788 BATT_06_PowerpackInsuffErr 3 "Error" 2 "SNA" 1 "Active" 0 "Inactive" ;
VAL_ 2499762788 BATT_06_BrickSoftShort 3 "Error" 2 "SNA" 1 "Active" 0 "Inactive" ;
VAL_ 2499762788 BATT_06_chargeUndercurrent 3 "Error" 2 "SNA" 1 "Active" 0 "Inactive" ;
VAL_ 2499762788 BATT_06_HVILcurrentSourceError 3 "Error" 2 "SNA" 1 "Active" 0 "Inactive" ;
VAL_ 2499762788 BATT_06_SRS 3 "Error" 2 "SNA" 1 "Active" 0 "Inactive" ;
VAL_ 2499762788 BATT_06_IsolationExtWar 3 "Error" 2 "SNA" 1 "Active" 0 "Inactive" ;
VAL_ 2499762788 BATT_06_IsolationIntWar 3 "Error" 2 "SNA" 1 "Active" 0 "Inactive" ;
VAL_ 2499762788 BATT_06_PyroFuseBlown 3 "Error" 2 "SNA" 1 "Active" 0 "Inactive" ;
VAL_ 2499762788 BATT_06_vBrickUnderSev 3 "Error" 2 "SNA" 1 "Active" 0 "Inactive" ;
VAL_ 2499762788 BATT_06_chargePrechargeTimeout 3 "Error" 2 "SNA" 1 "Active" 0 "Inactive" ;
VAL_ 2499762788 BATT_06_ModuleThermFaultModerate 3 "Error" 2 "SNA" 1 "Active" 0 "Inactive" ;
VAL_ 2499762788 BATT_06_ModuleThermFaultWarning 3 "Error" 2 "SNA" 1 "Active" 0 "Inactive" ;
VAL_ 2499762788 BATT_07_SenseBrickImpHigh 3 "Error" 2 "SNA" 1 "Active" 0 "Inactive" ;
VAL_ 2499762788 BATT_07_AFEfault 3 "Error" 2 "SNA" 1 "Active" 0 "Inactive" ;
VAL_ 2499762788 BATT_07_AFEerror 3 "Error" 2 "SNA" 1 "Active" 0 "Inactive" ;
VAL_ 2499762788 BATT_07_HostMIA 3 "Error" 2 "SNA" 1 "Active" 0 "Inactive" ;
VAL_ 2499762788 BATT_07_TempAmbientOverSev 3 "Error" 2 "SNA" 1 "Active" 0 "Inactive" ;
VAL_ 2499762788 BATT_07_TempAmbientOverMod 3 "Error" 2 "SNA" 1 "Active" 0 "Inactive" ;
VAL_ 2499762788 BATT_07_TempAmbientOverWar 3 "Error" 2 "SNA" 1 "Active" 0 "Inactive" ;
VAL_ 2499762788 BATT_07_AbnormReset 3 "Error" 2 "SNA" 1 "Active" 0 "Inactive" ;
VAL_ 2499762788 BATT_07_SenseloadVoltErrorPri 3 "Error" 2 "SNA" 1 "Active" 0 "Inactive" ;
VAL_ 2499762788 BATT_07_CalibrationInvalid 3 "Error" 2 "SNA" 1 "Active" 0 "Inactive" ;
VAL_ 2499762788 BATT_07_TaskLockup 3 "Error" 2 "SNA" 1 "Active" 0 "Inactive" ;
VAL_ 2499762788 BATT_07_RAMover 3 "Error" 2 "SNA" 1 "Active" 0 "Inactive" ;
VAL_ 2499762788 BATT_07_BrickOverdischarge 3 "Error" 2 "SNA" 1 "Active" 0 "Inactive" ;
VAL_ 2499762788 BATT_07_BrickOvercharge 3 "Error" 2 "SNA" 1 "Active" 0 "Inactive" ;
VAL_ 2499762788 BATT_07_vBrickImbalance 3 "Error" 2 "SNA" 1 "Active" 0 "Inactive" ;
VAL_ 2499762788 BATT_07_TempBrickImbalance 3 "Error" 2 "SNA" 1 "Active" 0 "Inactive" ;
VAL_ 2499762788 BATT_07_CapPackLow 3 "Error" 2 "SNA" 1 "Active" 0 "Inactive" ;
VAL_ 2499762788 BATT_07_rBrickHigh 3 "Error" 2 "SNA" 1 "Active" 0 "Inactive" ;
VAL_ 2499762788 BATT_07_PowerpackInsuffErr 3 "Error" 2 "SNA" 1 "Active" 0 "Inactive" ;
VAL_ 2499762788 BATT_07_BrickSoftShort 3 "Error" 2 "SNA" 1 "Active" 0 "Inactive" ;
VAL_ 2499762788 BATT_07_chargeUndercurrent 3 "Error" 2 "SNA" 1 "Active" 0 "Inactive" ;
VAL_ 2499762788 BATT_07_HVILcurrentSourceError 3 "Error" 2 "SNA" 1 "Active" 0 "Inactive" ;
VAL_ 2499762788 BATT_07_SRS 3 "Error" 2 "SNA" 1 "Active" 0 "Inactive" ;
VAL_ 2499762788 BATT_07_IsolationExtWar 3 "Error" 2 "SNA" 1 "Active" 0 "Inactive" ;
VAL_ 2499762788 BATT_07_IsolationIntWar 3 "Error" 2 "SNA" 1 "Active" 0 "Inactive" ;
VAL_ 2499762788 BATT_07_PyroFuseBlown 3 "Error" 2 "SNA" 1 "Active" 0 "Inactive" ;
VAL_ 2499762788 BATT_07_vBrickUnderSev 3 "Error" 2 "SNA" 1 "Active" 0 "Inactive" ;
VAL_ 2499762788 BATT_07_chargePrechargeTimeout 3 "Error" 2 "SNA" 1 "Active" 0 "Inactive" ;
VAL_ 2499762788 BATT_07_ModuleThermFaultModerate 3 "Error" 2 "SNA" 1 "Active" 0 "Inactive" ;
VAL_ 2499762788 BATT_07_ModuleThermFaultWarning 3 "Error" 2 "SNA" 1 "Active" 0 "Inactive" ;
VAL_ 2499762788 BATT_08_SenseBrickImpHigh 3 "Error" 2 "SNA" 1 "Active" 0 "Inactive" ;
VAL_ 2499762788 BATT_08_AFEfault 3 "Error" 2 "SNA" 1 "Active" 0 "Inactive" ;
VAL_ 2499762788 BATT_08_AFEerror 3 "Error" 2 "SNA" 1 "Active" 0 "Inactive" ;
VAL_ 2499762788 BATT_08_HostMIA 3 "Error" 2 "SNA" 1 "Active" 0 "Inactive" ;
VAL_ 2499762788 BATT_08_TempAmbientOverSev 3 "Error" 2 "SNA" 1 "Active" 0 "Inactive" ;
VAL_ 2499762788 BATT_08_TempAmbientOverMod 3 "Error" 2 "SNA" 1 "Active" 0 "Inactive" ;
VAL_ 2499762788 BATT_08_TempAmbientOverWar 3 "Error" 2 "SNA" 1 "Active" 0 "Inactive" ;
VAL_ 2499762788 BATT_08_AbnormReset 3 "Error" 2 "SNA" 1 "Active" 0 "Inactive" ;
VAL_ 2499762788 BATT_08_SenseloadVoltErrorPri 3 "Error" 2 "SNA" 1 "Active" 0 "Inactive" ;
VAL_ 2499762788 BATT_08_CalibrationInvalid 3 "Error" 2 "SNA" 1 "Active" 0 "Inactive" ;
VAL_ 2499762788 BATT_08_TaskLockup 3 "Error" 2 "SNA" 1 "Active" 0 "Inactive" ;
VAL_ 2499762788 BATT_08_RAMover 3 "Error" 2 "SNA" 1 "Active" 0 "Inactive" ;
VAL_ 2499762788 BATT_08_BrickOverdischarge 3 "Error" 2 "SNA" 1 "Active" 0 "Inactive" ;
VAL_ 2499762788 BATT_08_BrickOvercharge 3 "Error" 2 "SNA" 1 "Active" 0 "Inactive" ;
VAL_ 2499762788 BATT_08_vBrickImbalance 3 "Error" 2 "SNA" 1 "Active" 0 "Inactive" ;
VAL_ 2499762788 BATT_08_TempBrickImbalance 3 "Error" 2 "SNA" 1 "Active" 0 "Inactive" ;
VAL_ 2499762788 BATT_08_CapPackLow 3 "Error" 2 "SNA" 1 "Active" 0 "Inactive" ;
VAL_ 2499762788 BATT_08_rBrickHigh 3 "Error" 2 "SNA" 1 "Active" 0 "Inactive" ;
VAL_ 2499762788 BATT_08_PowerpackInsuffErr 3 "Error" 2 "SNA" 1 "Active" 0 "Inactive" ;
VAL_ 2499762788 BATT_08_BrickSoftShort 3 "Error" 2 "SNA" 1 "Active" 0 "Inactive" ;
VAL_ 2499762788 BATT_08_chargeUndercurrent 3 "Error" 2 "SNA" 1 "Active" 0 "Inactive" ;
VAL_ 2499762788 BATT_08_HVILcurrentSourceError 3 "Error" 2 "SNA" 1 "Active" 0 "Inactive" ;
VAL_ 2499762788 BATT_08_SRS 3 "Error" 2 "SNA" 1 "Active" 0 "Inactive" ;
VAL_ 2499762788 BATT_08_IsolationExtWar 3 "Error" 2 "SNA" 1 "Active" 0 "Inactive" ;
VAL_ 2499762788 BATT_08_IsolationIntWar 3 "Error" 2 "SNA" 1 "Active" 0 "Inactive" ;
VAL_ 2499762788 BATT_08_PyroFuseBlown 3 "Error" 2 "SNA" 1 "Active" 0 "Inactive" ;
VAL_ 2499762788 BATT_08_vBrickUnderSev 3 "Error" 2 "SNA" 1 "Active" 0 "Inactive" ;
VAL_ 2499762788 BATT_08_chargePrechargeTimeout 3 "Error" 2 "SNA" 1 "Active" 0 "Inactive" ;
VAL_ 2499762788 BATT_08_ModuleThermFaultModerate 3 "Error" 2 "SNA" 1 "Active" 0 "Inactive" ;
VAL_ 2499762788 BATT_08_ModuleThermFaultWarning 3 "Error" 2 "SNA" 1 "Active" 0 "Inactive" ;
VAL_ 2499762788 BATT_09_SenseBrickImpHigh 3 "Error" 2 "SNA" 1 "Active" 0 "Inactive" ;
VAL_ 2499762788 BATT_09_AFEfault 3 "Error" 2 "SNA" 1 "Active" 0 "Inactive" ;
VAL_ 2499762788 BATT_09_AFEerror 3 "Error" 2 "SNA" 1 "Active" 0 "Inactive" ;
VAL_ 2499762788 BATT_09_HostMIA 3 "Error" 2 "SNA" 1 "Active" 0 "Inactive" ;
VAL_ 2499762788 BATT_09_TempAmbientOverSev 3 "Error" 2 "SNA" 1 "Active" 0 "Inactive" ;
VAL_ 2499762788 BATT_09_TempAmbientOverMod 3 "Error" 2 "SNA" 1 "Active" 0 "Inactive" ;
VAL_ 2499762788 BATT_09_TempAmbientOverWar 3 "Error" 2 "SNA" 1 "Active" 0 "Inactive" ;
VAL_ 2499762788 BATT_09_AbnormReset 3 "Error" 2 "SNA" 1 "Active" 0 "Inactive" ;
VAL_ 2499762788 BATT_09_SenseloadVoltErrorPri 3 "Error" 2 "SNA" 1 "Active" 0 "Inactive" ;
VAL_ 2499762788 BATT_09_CalibrationInvalid 3 "Error" 2 "SNA" 1 "Active" 0 "Inactive" ;
VAL_ 2499762788 BATT_09_TaskLockup 3 "Error" 2 "SNA" 1 "Active" 0 "Inactive" ;
VAL_ 2499762788 BATT_09_RAMover 3 "Error" 2 "SNA" 1 "Active" 0 "Inactive" ;
VAL_ 2499762788 BATT_09_BrickOverdischarge 3 "Error" 2 "SNA" 1 "Active" 0 "Inactive" ;
VAL_ 2499762788 BATT_09_BrickOvercharge 3 "Error" 2 "SNA" 1 "Active" 0 "Inactive" ;
VAL_ 2499762788 BATT_09_vBrickImbalance 3 "Error" 2 "SNA" 1 "Active" 0 "Inactive" ;
VAL_ 2499762788 BATT_09_TempBrickImbalance 3 "Error" 2 "SNA" 1 "Active" 0 "Inactive" ;
VAL_ 2499762788 BATT_09_CapPackLow 3 "Error" 2 "SNA" 1 "Active" 0 "Inactive" ;
VAL_ 2499762788 BATT_09_rBrickHigh 3 "Error" 2 "SNA" 1 "Active" 0 "Inactive" ;
VAL_ 2499762788 BATT_09_PowerpackInsuffErr 3 "Error" 2 "SNA" 1 "Active" 0 "Inactive" ;
VAL_ 2499762788 BATT_09_BrickSoftShort 3 "Error" 2 "SNA" 1 "Active" 0 "Inactive" ;
VAL_ 2499762788 BATT_09_chargeUndercurrent 3 "Error" 2 "SNA" 1 "Active" 0 "Inactive" ;
VAL_ 2499762788 BATT_09_HVILcurrentSourceError 3 "Error" 2 "SNA" 1 "Active" 0 "Inactive" ;
VAL_ 2499762788 BATT_09_SRS 3 "Error" 2 "SNA" 1 "Active" 0 "Inactive" ;
VAL_ 2499762788 BATT_09_IsolationExtWar 3 "Error" 2 "SNA" 1 "Active" 0 "Inactive" ;
VAL_ 2499762788 BATT_09_IsolationIntWar 3 "Error" 2 "SNA" 1 "Active" 0 "Inactive" ;
VAL_ 2499762788 BATT_09_PyroFuseBlown 3 "Error" 2 "SNA" 1 "Active" 0 "Inactive" ;
VAL_ 2499762788 BATT_09_vBrickUnderSev 3 "Error" 2 "SNA" 1 "Active" 0 "Inactive" ;
VAL_ 2499762788 BATT_09_chargePrechargeTimeout 3 "Error" 2 "SNA" 1 "Active" 0 "Inactive" ;
VAL_ 2499762788 BATT_09_ModuleThermFaultModerate 3 "Error" 2 "SNA" 1 "Active" 0 "Inactive" ;
VAL_ 2499762788 BATT_09_ModuleThermFaultWarning 3 "Error" 2 "SNA" 1 "Active" 0 "Inactive" ;
VAL_ 2499762788 BATT_10_SenseBrickImpHigh 3 "Error" 2 "SNA" 1 "Active" 0 "Inactive" ;
VAL_ 2499762788 BATT_10_AFEfault 3 "Error" 2 "SNA" 1 "Active" 0 "Inactive" ;
VAL_ 2499762788 BATT_10_AFEerror 3 "Error" 2 "SNA" 1 "Active" 0 "Inactive" ;
VAL_ 2499762788 BATT_10_HostMIA 3 "Error" 2 "SNA" 1 "Active" 0 "Inactive" ;
VAL_ 2499762788 BATT_10_TempAmbientOverSev 3 "Error" 2 "SNA" 1 "Active" 0 "Inactive" ;
VAL_ 2499762788 BATT_10_TempAmbientOverMod 3 "Error" 2 "SNA" 1 "Active" 0 "Inactive" ;
VAL_ 2499762788 BATT_10_TempAmbientOverWar 3 "Error" 2 "SNA" 1 "Active" 0 "Inactive" ;
VAL_ 2499762788 BATT_10_AbnormReset 3 "Error" 2 "SNA" 1 "Active" 0 "Inactive" ;
VAL_ 2499762788 BATT_10_SenseloadVoltErrorPri 3 "Error" 2 "SNA" 1 "Active" 0 "Inactive" ;
VAL_ 2499762788 BATT_10_CalibrationInvalid 3 "Error" 2 "SNA" 1 "Active" 0 "Inactive" ;
VAL_ 2499762788 BATT_10_TaskLockup 3 "Error" 2 "SNA" 1 "Active" 0 "Inactive" ;
VAL_ 2499762788 BATT_10_RAMover 3 "Error" 2 "SNA" 1 "Active" 0 "Inactive" ;
VAL_ 2499762788 BATT_10_BrickOverdischarge 3 "Error" 2 "SNA" 1 "Active" 0 "Inactive" ;
VAL_ 2499762788 BATT_10_BrickOvercharge 3 "Error" 2 "SNA" 1 "Active" 0 "Inactive" ;
VAL_ 2499762788 BATT_10_vBrickImbalance 3 "Error" 2 "SNA" 1 "Active" 0 "Inactive" ;
VAL_ 2499762788 BATT_10_TempBrickImbalance 3 "Error" 2 "SNA" 1 "Active" 0 "Inactive" ;
VAL_ 2499762788 BATT_10_CapPackLow 3 "Error" 2 "SNA" 1 "Active" 0 "Inactive" ;
VAL_ 2499762788 BATT_10_rBrickHigh 3 "Error" 2 "SNA" 1 "Active" 0 "Inactive" ;
VAL_ 2499762788 BATT_10_PowerpackInsuffErr 3 "Error" 2 "SNA" 1 "Active" 0 "Inactive" ;
VAL_ 2499762788 BATT_10_BrickSoftShort 3 "Error" 2 "SNA" 1 "Active" 0 "Inactive" ;
VAL_ 2499762788 BATT_10_chargeUndercurrent 3 "Error" 2 "SNA" 1 "Active" 0 "Inactive" ;
VAL_ 2499762788 BATT_10_HVILcurrentSourceError 3 "Error" 2 "SNA" 1 "Active" 0 "Inactive" ;
VAL_ 2499762788 BATT_10_SRS 3 "Error" 2 "SNA" 1 "Active" 0 "Inactive" ;
VAL_ 2499762788 BATT_10_IsolationExtWar 3 "Error" 2 "SNA" 1 "Active" 0 "Inactive" ;
VAL_ 2499762788 BATT_10_IsolationIntWar 3 "Error" 2 "SNA" 1 "Active" 0 "Inactive" ;
VAL_ 2499762788 BATT_10_PyroFuseBlown 3 "Error" 2 "SNA" 1 "Active" 0 "Inactive" ;
VAL_ 2499762788 BATT_10_vBrickUnderSev 3 "Error" 2 "SNA" 1 "Active" 0 "Inactive" ;
VAL_ 2499762788 BATT_10_chargePrechargeTimeout 3 "Error" 2 "SNA" 1 "Active" 0 "Inactive" ;
VAL_ 2499762788 BATT_10_ModuleThermFaultModerate 3 "Error" 2 "SNA" 1 "Active" 0 "Inactive" ;
VAL_ 2499762788 BATT_10_ModuleThermFaultWarning 3 "Error" 2 "SNA" 1 "Active" 0 "Inactive" ;
VAL_ 2499762788 BATT_11_SenseBrickImpHigh 3 "Error" 2 "SNA" 1 "Active" 0 "Inactive" ;
VAL_ 2499762788 BATT_11_AFEfault 3 "Error" 2 "SNA" 1 "Active" 0 "Inactive" ;
VAL_ 2499762788 BATT_11_AFEerror 3 "Error" 2 "SNA" 1 "Active" 0 "Inactive" ;
VAL_ 2499762788 BATT_11_HostMIA 3 "Error" 2 "SNA" 1 "Active" 0 "Inactive" ;
VAL_ 2499762788 BATT_11_TempAmbientOverSev 3 "Error" 2 "SNA" 1 "Active" 0 "Inactive" ;
VAL_ 2499762788 BATT_11_TempAmbientOverMod 3 "Error" 2 "SNA" 1 "Active" 0 "Inactive" ;
VAL_ 2499762788 BATT_11_TempAmbientOverWar 3 "Error" 2 "SNA" 1 "Active" 0 "Inactive" ;
VAL_ 2499762788 BATT_11_AbnormReset 3 "Error" 2 "SNA" 1 "Active" 0 "Inactive" ;
VAL_ 2499762788 BATT_11_SenseloadVoltErrorPri 3 "Error" 2 "SNA" 1 "Active" 0 "Inactive" ;
VAL_ 2499762788 BATT_11_CalibrationInvalid 3 "Error" 2 "SNA" 1 "Active" 0 "Inactive" ;
VAL_ 2499762788 BATT_11_TaskLockup 3 "Error" 2 "SNA" 1 "Active" 0 "Inactive" ;
VAL_ 2499762788 BATT_11_RAMover 3 "Error" 2 "SNA" 1 "Active" 0 "Inactive" ;
VAL_ 2499762788 BATT_11_BrickOverdischarge 3 "Error" 2 "SNA" 1 "Active" 0 "Inactive" ;
VAL_ 2499762788 BATT_11_BrickOvercharge 3 "Error" 2 "SNA" 1 "Active" 0 "Inactive" ;
VAL_ 2499762788 BATT_11_vBrickImbalance 3 "Error" 2 "SNA" 1 "Active" 0 "Inactive" ;
VAL_ 2499762788 BATT_11_TempBrickImbalance 3 "Error" 2 "SNA" 1 "Active" 0 "Inactive" ;
VAL_ 2499762788 BATT_11_CapPackLow 3 "Error" 2 "SNA" 1 "Active" 0 "Inactive" ;
VAL_ 2499762788 BATT_11_rBrickHigh 3 "Error" 2 "SNA" 1 "Active" 0 "Inactive" ;
VAL_ 2499762788 BATT_11_PowerpackInsuffErr 3 "Error" 2 "SNA" 1 "Active" 0 "Inactive" ;
VAL_ 2499762788 BATT_11_BrickSoftShort 3 "Error" 2 "SNA" 1 "Active" 0 "Inactive" ;
VAL_ 2499762788 BATT_11_chargeUndercurrent 3 "Error" 2 "SNA" 1 "Active" 0 "Inactive" ;
VAL_ 2499762788 BATT_11_HVILcurrentSourceError 3 "Error" 2 "SNA" 1 "Active" 0 "Inactive" ;
VAL_ 2499762788 BATT_11_SRS 3 "Error" 2 "SNA" 1 "Active" 0 "Inactive" ;
VAL_ 2499762788 BATT_11_IsolationExtWar 3 "Error" 2 "SNA" 1 "Active" 0 "Inactive" ;
VAL_ 2499762788 BATT_11_IsolationIntWar 3 "Error" 2 "SNA" 1 "Active" 0 "Inactive" ;
VAL_ 2499762788 BATT_11_PyroFuseBlown 3 "Error" 2 "SNA" 1 "Active" 0 "Inactive" ;
VAL_ 2499762788 BATT_11_vBrickUnderSev 3 "Error" 2 "SNA" 1 "Active" 0 "Inactive" ;
VAL_ 2499762788 BATT_11_chargePrechargeTimeout 3 "Error" 2 "SNA" 1 "Active" 0 "Inactive" ;
VAL_ 2499762788 BATT_11_ModuleThermFaultModerate 3 "Error" 2 "SNA" 1 "Active" 0 "Inactive" ;
VAL_ 2499762788 BATT_11_ModuleThermFaultWarning 3 "Error" 2 "SNA" 1 "Active" 0 "Inactive" ;
VAL_ 2499762788 BATT_12_SenseBrickImpHigh 3 "Error" 2 "SNA" 1 "Active" 0 "Inactive" ;
VAL_ 2499762788 BATT_12_AFEfault 3 "Error" 2 "SNA" 1 "Active" 0 "Inactive" ;
VAL_ 2499762788 BATT_12_AFEerror 3 "Error" 2 "SNA" 1 "Active" 0 "Inactive" ;
VAL_ 2499762788 BATT_12_HostMIA 3 "Error" 2 "SNA" 1 "Active" 0 "Inactive" ;
VAL_ 2499762788 BATT_12_TempAmbientOverSev 3 "Error" 2 "SNA" 1 "Active" 0 "Inactive" ;
VAL_ 2499762788 BATT_12_TempAmbientOverMod 3 "Error" 2 "SNA" 1 "Active" 0 "Inactive" ;
VAL_ 2499762788 BATT_12_TempAmbientOverWar 3 "Error" 2 "SNA" 1 "Active" 0 "Inactive" ;
VAL_ 2499762788 BATT_12_AbnormReset 3 "Error" 2 "SNA" 1 "Active" 0 "Inactive" ;
VAL_ 2499762788 BATT_12_SenseloadVoltErrorPri 3 "Error" 2 "SNA" 1 "Active" 0 "Inactive" ;
VAL_ 2499762788 BATT_12_CalibrationInvalid 3 "Error" 2 "SNA" 1 "Active" 0 "Inactive" ;
VAL_ 2499762788 BATT_12_TaskLockup 3 "Error" 2 "SNA" 1 "Active" 0 "Inactive" ;
VAL_ 2499762788 BATT_12_RAMover 3 "Error" 2 "SNA" 1 "Active" 0 "Inactive" ;
VAL_ 2499762788 BATT_12_BrickOverdischarge 3 "Error" 2 "SNA" 1 "Active" 0 "Inactive" ;
VAL_ 2499762788 BATT_12_BrickOvercharge 3 "Error" 2 "SNA" 1 "Active" 0 "Inactive" ;
VAL_ 2499762788 BATT_12_vBrickImbalance 3 "Error" 2 "SNA" 1 "Active" 0 "Inactive" ;
VAL_ 2499762788 BATT_12_TempBrickImbalance 3 "Error" 2 "SNA" 1 "Active" 0 "Inactive" ;
VAL_ 2499762788 BATT_12_CapPackLow 3 "Error" 2 "SNA" 1 "Active" 0 "Inactive" ;
VAL_ 2499762788 BATT_12_rBrickHigh 3 "Error" 2 "SNA" 1 "Active" 0 "Inactive" ;
VAL_ 2499762788 BATT_12_PowerpackInsuffErr 3 "Error" 2 "SNA" 1 "Active" 0 "Inactive" ;
VAL_ 2499762788 BATT_12_BrickSoftShort 3 "Error" 2 "SNA" 1 "Active" 0 "Inactive" ;
VAL_ 2499762788 BATT_12_chargeUndercurrent 3 "Error" 2 "SNA" 1 "Active" 0 "Inactive" ;
VAL_ 2499762788 BATT_12_HVILcurrentSourceError 3 "Error" 2 "SNA" 1 "Active" 0 "Inactive" ;
VAL_ 2499762788 BATT_12_SRS 3 "Error" 2 "SNA" 1 "Active" 0 "Inactive" ;
VAL_ 2499762788 BATT_12_IsolationExtWar 3 "Error" 2 "SNA" 1 "Active" 0 "Inactive" ;
VAL_ 2499762788 BATT_12_IsolationIntWar 3 "Error" 2 "SNA" 1 "Active" 0 "Inactive" ;
VAL_ 2499762788 BATT_12_PyroFuseBlown 3 "Error" 2 "SNA" 1 "Active" 0 "Inactive" ;
VAL_ 2499762788 BATT_12_vBrickUnderSev 3 "Error" 2 "SNA" 1 "Active" 0 "Inactive" ;
VAL_ 2499762788 BATT_12_chargePrechargeTimeout 3 "Error" 2 "SNA" 1 "Active" 0 "Inactive" ;
VAL_ 2499762788 BATT_12_ModuleThermFaultModerate 3 "Error" 2 "SNA" 1 "Active" 0 "Inactive" ;
VAL_ 2499762788 BATT_12_ModuleThermFaultWarning 3 "Error" 2 "SNA" 1 "Active" 0 "Inactive" ;
VAL_ 2499762788 BATT_13_SenseBrickImpHigh 3 "Error" 2 "SNA" 1 "Active" 0 "Inactive" ;
VAL_ 2499762788 BATT_13_AFEfault 3 "Error" 2 "SNA" 1 "Active" 0 "Inactive" ;
VAL_ 2499762788 BATT_13_AFEerror 3 "Error" 2 "SNA" 1 "Active" 0 "Inactive" ;
VAL_ 2499762788 BATT_13_HostMIA 3 "Error" 2 "SNA" 1 "Active" 0 "Inactive" ;
VAL_ 2499762788 BATT_13_TempAmbientOverSev 3 "Error" 2 "SNA" 1 "Active" 0 "Inactive" ;
VAL_ 2499762788 BATT_13_TempAmbientOverMod 3 "Error" 2 "SNA" 1 "Active" 0 "Inactive" ;
VAL_ 2499762788 BATT_13_TempAmbientOverWar 3 "Error" 2 "SNA" 1 "Active" 0 "Inactive" ;
VAL_ 2499762788 BATT_13_AbnormReset 3 "Error" 2 "SNA" 1 "Active" 0 "Inactive" ;
VAL_ 2499762788 BATT_13_SenseloadVoltErrorPri 3 "Error" 2 "SNA" 1 "Active" 0 "Inactive" ;
VAL_ 2499762788 BATT_13_CalibrationInvalid 3 "Error" 2 "SNA" 1 "Active" 0 "Inactive" ;
VAL_ 2499762788 BATT_13_TaskLockup 3 "Error" 2 "SNA" 1 "Active" 0 "Inactive" ;
VAL_ 2499762788 BATT_13_RAMover 3 "Error" 2 "SNA" 1 "Active" 0 "Inactive" ;
VAL_ 2499762788 BATT_13_BrickOverdischarge 3 "Error" 2 "SNA" 1 "Active" 0 "Inactive" ;
VAL_ 2499762788 BATT_13_BrickOvercharge 3 "Error" 2 "SNA" 1 "Active" 0 "Inactive" ;
VAL_ 2499762788 BATT_13_vBrickImbalance 3 "Error" 2 "SNA" 1 "Active" 0 "Inactive" ;
VAL_ 2499762788 BATT_13_TempBrickImbalance 3 "Error" 2 "SNA" 1 "Active" 0 "Inactive" ;
VAL_ 2499762788 BATT_13_CapPackLow 3 "Error" 2 "SNA" 1 "Active" 0 "Inactive" ;
VAL_ 2499762788 BATT_13_rBrickHigh 3 "Error" 2 "SNA" 1 "Active" 0 "Inactive" ;
VAL_ 2499762788 BATT_13_PowerpackInsuffErr 3 "Error" 2 "SNA" 1 "Active" 0 "Inactive" ;
VAL_ 2499762788 BATT_13_BrickSoftShort 3 "Error" 2 "SNA" 1 "Active" 0 "Inactive" ;
VAL_ 2499762788 BATT_13_chargeUndercurrent 3 "Error" 2 "SNA" 1 "Active" 0 "Inactive" ;
VAL_ 2499762788 BATT_13_HVILcurrentSourceError 3 "Error" 2 "SNA" 1 "Active" 0 "Inactive" ;
VAL_ 2499762788 BATT_13_SRS 3 "Error" 2 "SNA" 1 "Active" 0 "Inactive" ;
VAL_ 2499762788 BATT_13_IsolationExtWar 3 "Error" 2 "SNA" 1 "Active" 0 "Inactive" ;
VAL_ 2499762788 BATT_13_IsolationIntWar 3 "Error" 2 "SNA" 1 "Active" 0 "Inactive" ;
VAL_ 2499762788 BATT_13_PyroFuseBlown 3 "Error" 2 "SNA" 1 "Active" 0 "Inactive" ;
VAL_ 2499762788 BATT_13_vBrickUnderSev 3 "Error" 2 "SNA" 1 "Active" 0 "Inactive" ;
VAL_ 2499762788 BATT_13_chargePrechargeTimeout 3 "Error" 2 "SNA" 1 "Active" 0 "Inactive" ;
VAL_ 2499762788 BATT_13_ModuleThermFaultModerate 3 "Error" 2 "SNA" 1 "Active" 0 "Inactive" ;
VAL_ 2499762788 BATT_13_ModuleThermFaultWarning 3 "Error" 2 "SNA" 1 "Active" 0 "Inactive" ;
VAL_ 2499762788 BATT_14_SenseBrickImpHigh 3 "Error" 2 "SNA" 1 "Active" 0 "Inactive" ;
VAL_ 2499762788 BATT_14_AFEfault 3 "Error" 2 "SNA" 1 "Active" 0 "Inactive" ;
VAL_ 2499762788 BATT_14_AFEerror 3 "Error" 2 "SNA" 1 "Active" 0 "Inactive" ;
VAL_ 2499762788 BATT_14_HostMIA 3 "Error" 2 "SNA" 1 "Active" 0 "Inactive" ;
VAL_ 2499762788 BATT_14_TempAmbientOverSev 3 "Error" 2 "SNA" 1 "Active" 0 "Inactive" ;
VAL_ 2499762788 BATT_14_TempAmbientOverMod 3 "Error" 2 "SNA" 1 "Active" 0 "Inactive" ;
VAL_ 2499762788 BATT_14_TempAmbientOverWar 3 "Error" 2 "SNA" 1 "Active" 0 "Inactive" ;
VAL_ 2499762788 BATT_14_AbnormReset 3 "Error" 2 "SNA" 1 "Active" 0 "Inactive" ;
VAL_ 2499762788 BATT_14_SenseloadVoltErrorPri 3 "Error" 2 "SNA" 1 "Active" 0 "Inactive" ;
VAL_ 2499762788 BATT_14_CalibrationInvalid 3 "Error" 2 "SNA" 1 "Active" 0 "Inactive" ;
VAL_ 2499762788 BATT_14_TaskLockup 3 "Error" 2 "SNA" 1 "Active" 0 "Inactive" ;
VAL_ 2499762788 BATT_14_RAMover 3 "Error" 2 "SNA" 1 "Active" 0 "Inactive" ;
VAL_ 2499762788 BATT_14_BrickOverdischarge 3 "Error" 2 "SNA" 1 "Active" 0 "Inactive" ;
VAL_ 2499762788 BATT_14_BrickOvercharge 3 "Error" 2 "SNA" 1 "Active" 0 "Inactive" ;
VAL_ 2499762788 BATT_14_vBrickImbalance 3 "Error" 2 "SNA" 1 "Active" 0 "Inactive" ;
VAL_ 2499762788 BATT_14_TempBrickImbalance 3 "Error" 2 "SNA" 1 "Active" 0 "Inactive" ;
VAL_ 2499762788 BATT_14_CapPackLow 3 "Error" 2 "SNA" 1 "Active" 0 "Inactive" ;
VAL_ 2499762788 BATT_14_rBrickHigh 3 "Error" 2 "SNA" 1 "Active" 0 "Inactive" ;
VAL_ 2499762788 BATT_14_PowerpackInsuffErr 3 "Error" 2 "SNA" 1 "Active" 0 "Inactive" ;
VAL_ 2499762788 BATT_14_BrickSoftShort 3 "Error" 2 "SNA" 1 "Active" 0 "Inactive" ;
VAL_ 2499762788 BATT_14_chargeUndercurrent 3 "Error" 2 "SNA" 1 "Active" 0 "Inactive" ;
VAL_ 2499762788 BATT_14_HVILcurrentSourceError 3 "Error" 2 "SNA" 1 "Active" 0 "Inactive" ;
VAL_ 2499762788 BATT_14_SRS 3 "Error" 2 "SNA" 1 "Active" 0 "Inactive" ;
VAL_ 2499762788 BATT_14_IsolationExtWar 3 "Error" 2 "SNA" 1 "Active" 0 "Inactive" ;
VAL_ 2499762788 BATT_14_IsolationIntWar 3 "Error" 2 "SNA" 1 "Active" 0 "Inactive" ;
VAL_ 2499762788 BATT_14_PyroFuseBlown 3 "Error" 2 "SNA" 1 "Active" 0 "Inactive" ;
VAL_ 2499762788 BATT_14_vBrickUnderSev 3 "Error" 2 "SNA" 1 "Active" 0 "Inactive" ;
VAL_ 2499762788 BATT_14_chargePrechargeTimeout 3 "Error" 2 "SNA" 1 "Active" 0 "Inactive" ;
VAL_ 2499762788 BATT_14_ModuleThermFaultModerate 3 "Error" 2 "SNA" 1 "Active" 0 "Inactive" ;
VAL_ 2499762788 BATT_14_ModuleThermFaultWarning 3 "Error" 2 "SNA" 1 "Active" 0 "Inactive" ;
VAL_ 2499762788 BATT_15_SenseBrickImpHigh 3 "Error" 2 "SNA" 1 "Active" 0 "Inactive" ;
VAL_ 2499762788 BATT_15_AFEfault 3 "Error" 2 "SNA" 1 "Active" 0 "Inactive" ;
VAL_ 2499762788 BATT_15_AFEerror 3 "Error" 2 "SNA" 1 "Active" 0 "Inactive" ;
VAL_ 2499762788 BATT_15_HostMIA 3 "Error" 2 "SNA" 1 "Active" 0 "Inactive" ;
VAL_ 2499762788 BATT_15_TempAmbientOverSev 3 "Error" 2 "SNA" 1 "Active" 0 "Inactive" ;
VAL_ 2499762788 BATT_15_TempAmbientOverMod 3 "Error" 2 "SNA" 1 "Active" 0 "Inactive" ;
VAL_ 2499762788 BATT_15_TempAmbientOverWar 3 "Error" 2 "SNA" 1 "Active" 0 "Inactive" ;
VAL_ 2499762788 BATT_15_AbnormReset 3 "Error" 2 "SNA" 1 "Active" 0 "Inactive" ;
VAL_ 2499762788 BATT_15_SenseloadVoltErrorPri 3 "Error" 2 "SNA" 1 "Active" 0 "Inactive" ;
VAL_ 2499762788 BATT_15_CalibrationInvalid 3 "Error" 2 "SNA" 1 "Active" 0 "Inactive" ;
VAL_ 2499762788 BATT_15_TaskLockup 3 "Error" 2 "SNA" 1 "Active" 0 "Inactive" ;
VAL_ 2499762788 BATT_15_RAMover 3 "Error" 2 "SNA" 1 "Active" 0 "Inactive" ;
VAL_ 2499762788 BATT_15_BrickOverdischarge 3 "Error" 2 "SNA" 1 "Active" 0 "Inactive" ;
VAL_ 2499762788 BATT_15_BrickOvercharge 3 "Error" 2 "SNA" 1 "Active" 0 "Inactive" ;
VAL_ 2499762788 BATT_15_vBrickImbalance 3 "Error" 2 "SNA" 1 "Active" 0 "Inactive" ;
VAL_ 2499762788 BATT_15_TempBrickImbalance 3 "Error" 2 "SNA" 1 "Active" 0 "Inactive" ;
VAL_ 2499762788 BATT_15_CapPackLow 3 "Error" 2 "SNA" 1 "Active" 0 "Inactive" ;
VAL_ 2499762788 BATT_15_rBrickHigh 3 "Error" 2 "SNA" 1 "Active" 0 "Inactive" ;
VAL_ 2499762788 BATT_15_PowerpackInsuffErr 3 "Error" 2 "SNA" 1 "Active" 0 "Inactive" ;
VAL_ 2499762788 BATT_15_BrickSoftShort 3 "Error" 2 "SNA" 1 "Active" 0 "Inactive" ;
VAL_ 2499762788 BATT_15_chargeUndercurrent 3 "Error" 2 "SNA" 1 "Active" 0 "Inactive" ;
VAL_ 2499762788 BATT_15_HVILcurrentSourceError 3 "Error" 2 "SNA" 1 "Active" 0 "Inactive" ;
VAL_ 2499762788 BATT_15_SRS 3 "Error" 2 "SNA" 1 "Active" 0 "Inactive" ;
VAL_ 2499762788 BATT_15_IsolationExtWar 3 "Error" 2 "SNA" 1 "Active" 0 "Inactive" ;
VAL_ 2499762788 BATT_15_IsolationIntWar 3 "Error" 2 "SNA" 1 "Active" 0 "Inactive" ;
VAL_ 2499762788 BATT_15_PyroFuseBlown 3 "Error" 2 "SNA" 1 "Active" 0 "Inactive" ;
VAL_ 2499762788 BATT_15_vBrickUnderSev 3 "Error" 2 "SNA" 1 "Active" 0 "Inactive" ;
VAL_ 2499762788 BATT_15_chargePrechargeTimeout 3 "Error" 2 "SNA" 1 "Active" 0 "Inactive" ;
VAL_ 2499762788 BATT_15_ModuleThermFaultModerate 3 "Error" 2 "SNA" 1 "Active" 0 "Inactive" ;
VAL_ 2499762788 BATT_15_ModuleThermFaultWarning 3 "Error" 2 "SNA" 1 "Active" 0 "Inactive" ;
