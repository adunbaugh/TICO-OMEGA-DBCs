VERSION ""

NS_ :

BS_:

BU_: AHLM ASBS CBC DIAGNOST DPDM DTCM ECM EHPS ESC ESL ESM ETM GPF HCP IC IRCM OCM ORC PTS RF_HUB SCCM SGW TBM TCM TPM

BO_ 948 VehCfgCSM2: 8 CBC
 SG_ VC_AIRBAG_ON_CSO : 46|1@1+ (1,0) [0|0] ""  IC,RF_HUB,SGW
 SG_ VC_AUTO_SS_CSO : 54|1@1+ (1,0) [0|0] ""  RF_HUB,SGW
 SG_ VC_BSM_TRLR_CSO : 53|1@1+ (1,0) [0|0] ""  RF_HUB,SGW
 SG_ VC_DOORS_OFF_ACC_DLY_CSO : 50|1@1+ (1,0) [0|0] ""  RF_HUB,SGW
 SG_ VC_EPB_ON_CSO : 45|1@1+ (1,0) [0|0] ""  RF_HUB,SGW
 SG_ VC_FCW_SW_CSO : 47|1@1+ (1,0) [0|0] ""  RF_HUB,SGW
 SG_ VC_FCW_WARN_BRK_CSO : 49|1@1+ (1,0) [0|0] ""  RF_HUB,SGW
 SG_ VC_FLSH_LMP_SLDR_CSO : 40|1@1+ (1,0) [0|0] ""  RF_HUB,SGW
 SG_ VC_FUEL_SAV_CSO : 14|1@1+ (1,0) [0|0] ""  RF_HUB,SGW
 SG_ VC_HANDS_FREE_LFT_CSO : 18|1@1+ (1,0) [0|0] ""  RF_HUB,SGW
 SG_ VC_HANDS_FREE_SLDR_CSO : 19|1@1+ (1,0) [0|0] ""  RF_HUB,SGW
 SG_ VC_HOLD_N_GO_CSO : 16|1@1+ (1,0) [0|0] ""  RF_HUB,SGW
 SG_ VC_LDW_ON_CSO : 43|1@1+ (1,0) [0|0] ""  RF_HUB,SGW
 SG_ VC_PADDLE_SHIFT_CSO : 39|1@1+ (1,0) [0|0] ""  RF_HUB,SGW
 SG_ VC_PCS_CSO : 52|1@1+ (1,0) [0|0] ""  RF_HUB,SGW
 SG_ VC_PRK_ASST_TYPE_CSO : 44|1@1+ (1,0) [0|0] ""  RF_HUB,SGW
 SG_ VC_PWR_FLD_MRR_CSO : 17|1@1+ (1,0) [0|0] ""  RF_HUB,SGW
 SG_ VC_RDY_DRV_CSO : 55|1@1+ (1,0) [0|0] ""  RF_HUB,SGW
 SG_ VC_REAR_CMRA_DLY_CSO : 2|1@1+ (1,0) [0|0] ""  RF_HUB,SGW
 SG_ VC_RKE_MEM_CSO : 3|1@1+ (1,0) [0|0] ""  RF_HUB,SGW
 SG_ VC_RKE_UNLK_CSO : 4|1@1+ (1,0) [0|0] ""  RF_HUB,SGW
 SG_ VC_SLD_DR_ALRT_CSO : 22|1@1+ (1,0) [0|0] ""  RF_HUB,SGW
 SG_ VC_SLD_DR_CHM_CSO : 37|1@1+ (1,0) [0|0] ""  RF_HUB,SGW
 SG_ VC_SPEED_CSO : 5|1@1+ (1,0) [0|0] ""  RF_HUB,SGW
 SG_ VC_SPEED_WARNING_CSO : 41|2@1+ (1,0) [0|0] ""  RF_HUB,SGW
 SG_ VC_SVC_DELAY_CSO : 21|1@1+ (1,0) [0|0] ""  RF_HUB,SGW
 SG_ VC_SVC_GRIDLINES_CSO : 20|1@1+ (1,0) [0|0] ""  RF_HUB,SGW
 SG_ VC_TEEN_AUTO_HB_CSO : 33|1@1+ (1,0) [0|0] ""  RF_HUB,SGW
 SG_ VC_TEEN_BLIND_SPOT_CSO : 31|1@1+ (1,0) [0|0] ""  RF_HUB,SGW
 SG_ VC_TEEN_FCW_BRK_CSO : 24|1@1+ (1,0) [0|0] ""  RF_HUB,SGW
 SG_ VC_TEEN_FCW_SENS_CSO : 23|1@1+ (1,0) [0|0] ""  RF_HUB,SGW
 SG_ VC_TEEN_FT_PRK_VOL_CSO : 26|1@1+ (1,0) [0|0] ""  RF_HUB,SGW
 SG_ VC_TEEN_FUEL_POPUP_CSO : 30|1@1+ (1,0) [0|0] ""  RF_HUB,SGW
 SG_ VC_TEEN_FUEL_WRN_CSO : 29|1@1+ (1,0) [0|0] ""  RF_HUB,SGW
 SG_ VC_TEEN_LGHT_WPR_CSO : 34|1@1+ (1,0) [0|0] ""  RF_HUB,SGW
 SG_ VC_TEEN_MAX_SPEED_CSO : 28|1@1+ (1,0) [0|0] ""  RF_HUB,SGW
 SG_ VC_TEEN_PLG_CHIME_CSO : 36|1@1+ (1,0) [0|0] ""  RF_HUB,SGW
 SG_ VC_TEEN_PRK_ASST_BRK_CSO : 51|1@1+ (1,0) [0|0] ""  RF_HUB,SGW
 SG_ VC_TEEN_PRK_ASST_CSO : 25|1@1+ (1,0) [0|0] ""  RF_HUB,SGW
 SG_ VC_TEEN_RAIN_WPR_CSO : 32|1@1+ (1,0) [0|0] ""  RF_HUB,SGW
 SG_ VC_TEEN_RR_PRK_VOL_CSO : 27|1@1+ (1,0) [0|0] ""  RF_HUB,SGW
 SG_ VC_TEEN_SLD_DR_ALRT_CSO : 35|1@1+ (1,0) [0|0] ""  RF_HUB,SGW
 SG_ VC_TEEN_SLD_DR_CHM_CSO : 38|1@1+ (1,0) [0|0] ""  RF_HUB,SGW
 SG_ VC_TEMP_CSO : 15|1@1+ (1,0) [0|0] ""  RF_HUB,SGW
 SG_ VC_TLT_MRR_CSO : 6|1@1+ (1,0) [0|0] ""  RF_HUB,SGW
 SG_ VC_TORQUE_CSO : 7|1@1+ (1,0) [0|0] ""  RF_HUB,SGW
 SG_ VC_TRLR_CSO : 8|1@1+ (1,0) [0|0] ""  RF_HUB,SGW
 SG_ VC_TRLR_NAME_CSO : 9|1@1+ (1,0) [0|0] ""  RF_HUB,SGW
 SG_ VC_TRLR_TYPE_CSO : 10|1@1+ (1,0) [0|0] ""  RF_HUB,SGW
 SG_ VC_TRNS_MD_CSO : 11|1@1+ (1,0) [0|0] ""  RF_HUB,SGW
 SG_ VC_US_METRIC_CSO : 12|1@1+ (1,0) [0|0] ""  RF_HUB,SGW
 SG_ VC_VehCfgCSO2_Stat : 0|2@1+ (1,0) [0|0] ""  IC,RF_HUB,SGW
 SG_ VC_WHL_ALGN_CSO : 13|1@1+ (1,0) [0|0] ""  RF_HUB,SGW

BO_ 950 VehCfgCSM2_BU: 8 RF_HUB
 SG_ VC_BU_AIRBAG_ON_CSO : 46|1@1+ (1,0) [0|0] ""  CBC,SGW
 SG_ VC_BU_AUTO_SS_CSO : 54|1@1+ (1,0) [0|0] ""  CBC,SGW
 SG_ VC_BU_BSM_TRLR_CSO : 53|1@1+ (1,0) [0|0] ""  CBC,SGW
 SG_ VC_BU_DOORS_OFF_ACC_DLY_CSO : 50|1@1+ (1,0) [0|0] ""  CBC,SGW
 SG_ VC_BU_EPB_ON_CSO : 45|1@1+ (1,0) [0|0] ""  CBC,SGW
 SG_ VC_BU_FCW_SW_CSO : 47|1@1+ (1,0) [0|0] ""  CBC,SGW
 SG_ VC_BU_FCW_WARN_BRK_CSO : 49|1@1+ (1,0) [0|0] ""  CBC,SGW
 SG_ VC_BU_FLSH_LMP_SLDR_CSO : 40|1@1+ (1,0) [0|0] ""  CBC,SGW
 SG_ VC_BU_FUEL_SAV_CSO : 14|1@1+ (1,0) [0|0] ""  CBC,SGW
 SG_ VC_BU_HANDS_FREE_LFT_CSO : 18|1@1+ (1,0) [0|0] ""  CBC,SGW
 SG_ VC_BU_HANDS_FREE_SLDR_CSO : 19|1@1+ (1,0) [0|0] ""  CBC,SGW
 SG_ VC_BU_HOLD_N_GO_CSO : 16|1@1+ (1,0) [0|0] ""  CBC,SGW
 SG_ VC_BU_LDW_ON_CSO : 43|1@1+ (1,0) [0|0] ""  CBC,SGW
 SG_ VC_BU_PADDLE_SHIFT_CSO : 39|1@1+ (1,0) [0|0] ""  CBC,SGW
 SG_ VC_BU_PCS_CSO : 52|1@1+ (1,0) [0|0] ""  CBC,SGW
 SG_ VC_BU_PRK_ASST_TYPE_CSO : 44|1@1+ (1,0) [0|0] ""  CBC,SGW
 SG_ VC_BU_PWR_FLD_MRR_CSO : 17|1@1+ (1,0) [0|0] ""  CBC,SGW
 SG_ VC_BU_RDY_DRV_CSO : 55|1@1+ (1,0) [0|0] ""  CBC,SGW
 SG_ VC_BU_REAR_CMRA_DLY_CSO : 2|1@1+ (1,0) [0|0] ""  CBC,SGW
 SG_ VC_BU_RKE_MEM_CSO : 3|1@1+ (1,0) [0|0] ""  CBC,SGW
 SG_ VC_BU_RKE_UNLK_CSO : 4|1@1+ (1,0) [0|0] ""  CBC,SGW
 SG_ VC_BU_SLD_DR_ALRT_CSO : 22|1@1+ (1,0) [0|0] ""  CBC,SGW
 SG_ VC_BU_SLD_DR_CHM_CSO : 37|1@1+ (1,0) [0|0] ""  CBC,SGW
 SG_ VC_BU_SPEED_CSO : 5|1@1+ (1,0) [0|0] ""  CBC,SGW
 SG_ VC_BU_SPEED_WARNING_CSO : 41|2@1+ (1,0) [0|0] ""  CBC,SGW
 SG_ VC_BU_SVC_DELAY_CSO : 21|1@1+ (1,0) [0|0] ""  CBC,SGW
 SG_ VC_BU_SVC_GRIDLINES_CSO : 20|1@1+ (1,0) [0|0] ""  CBC,SGW
 SG_ VC_BU_TEEN_AUTO_HB_CSO : 33|1@1+ (1,0) [0|0] ""  CBC,SGW
 SG_ VC_BU_TEEN_BLIND_SPOT_CSO : 31|1@1+ (1,0) [0|0] ""  CBC,SGW
 SG_ VC_BU_TEEN_FCW_BRK_CSO : 24|1@1+ (1,0) [0|0] ""  CBC,SGW
 SG_ VC_BU_TEEN_FCW_SENS_CSO : 23|1@1+ (1,0) [0|0] ""  CBC,SGW
 SG_ VC_BU_TEEN_FT_PRK_VOL_CSO : 26|1@1+ (1,0) [0|0] ""  CBC,SGW
 SG_ VC_BU_TEEN_FUEL_POPUP_CSO : 30|1@1+ (1,0) [0|0] ""  CBC,SGW
 SG_ VC_BU_TEEN_FUEL_WRN_CSO : 29|1@1+ (1,0) [0|0] ""  CBC,SGW
 SG_ VC_BU_TEEN_LGHT_WPR_CSO : 34|1@1+ (1,0) [0|0] ""  CBC,SGW
 SG_ VC_BU_TEEN_MAX_SPEED_CSO : 28|1@1+ (1,0) [0|0] ""  CBC,SGW
 SG_ VC_BU_TEEN_PLG_CHIME_CSO : 36|1@1+ (1,0) [0|0] ""  CBC,SGW
 SG_ VC_BU_TEEN_PRK_ASST_BRK_CSO : 51|1@1+ (1,0) [0|0] ""  CBC,SGW
 SG_ VC_BU_TEEN_PRK_ASST_CSO : 25|1@1+ (1,0) [0|0] ""  CBC,SGW
 SG_ VC_BU_TEEN_RAIN_WPR_CSO : 32|1@1+ (1,0) [0|0] ""  CBC,SGW
 SG_ VC_BU_TEEN_RR_PRK_VOL_CSO : 27|1@1+ (1,0) [0|0] ""  CBC,SGW
 SG_ VC_BU_TEEN_SLD_DR_ALRT_CSO : 35|1@1+ (1,0) [0|0] ""  CBC,SGW
 SG_ VC_BU_TEEN_SLD_DR_CHM_CSO : 38|1@1+ (1,0) [0|0] ""  CBC,SGW
 SG_ VC_BU_TEMP_CSO : 15|1@1+ (1,0) [0|0] ""  CBC,SGW
 SG_ VC_BU_TLT_MRR_CSO : 6|1@1+ (1,0) [0|0] ""  CBC,SGW
 SG_ VC_BU_TORQUE_CSO : 7|1@1+ (1,0) [0|0] ""  CBC,SGW
 SG_ VC_BU_TRLR_CSO : 8|1@1+ (1,0) [0|0] ""  CBC,SGW
 SG_ VC_BU_TRLR_NAME_CSO : 9|1@1+ (1,0) [0|0] ""  CBC,SGW
 SG_ VC_BU_TRLR_TYPE_CSO : 10|1@1+ (1,0) [0|0] ""  CBC,SGW
 SG_ VC_BU_TRNS_MD_CSO : 11|1@1+ (1,0) [0|0] ""  CBC,SGW
 SG_ VC_BU_US_METRIC_CSO : 12|1@1+ (1,0) [0|0] ""  CBC,SGW
 SG_ VC_BU_VehCfgCSO2_Stat : 0|2@1+ (1,0) [0|0] ""  CBC,SGW
 SG_ VC_BU_WHL_ALGN_CSO : 13|1@1+ (1,0) [0|0] ""  CBC,SGW

BO_ 962 VehCfgCSM3: 8 CBC
 SG_ VC_3RD_ROW_LOCK_CSO : 45|1@1+ (1,0) [0|0] ""  RF_HUB
 SG_ VC_AL_FFC_OR_PLUS_CSO : 40|1@1+ (1,0) [0|0] ""  RF_HUB
 SG_ VC_AL_OR_PLUS_CSO : 41|1@1+ (1,0) [0|0] ""  RF_HUB
 SG_ VC_AUTO_STOP_START_CSO : 63|1@1+ (1,0) [0|0] ""  RF_HUB
 SG_ VC_Auto_Activ_PerfPage_CSO : 44|1@1+ (1,0) [0|0] ""  RF_HUB
 SG_ VC_BACKUP_ALARM_CSO : 2|1@1+ (1,0) [0|0] ""  RF_HUB
 SG_ VC_BUZZER_VOLUME_LEVEL_CSO : 54|1@1+ (1,0) [0|0] ""  RF_HUB
 SG_ VC_CHARGE_LOW_POPUP_CSO : 46|1@1+ (1,0) [0|0] ""  RF_HUB,SGW
 SG_ VC_CHMSL_DYN_CNTR_CSO : 7|1@1+ (1,0) [0|0] ""  RF_HUB
 SG_ VC_ESAVE_BATT_LVL_CSO : 11|1@1+ (1,0) [0|0] ""  RF_HUB,SGW
 SG_ VC_ESAVE_CSO : 10|1@1+ (1,0) [0|0] ""  RF_HUB,SGW
 SG_ VC_EXTERNAL_LIGHT_SENSOR_CSO : 53|1@1+ (1,0) [0|0] ""  RF_HUB
 SG_ VC_FFC_GRIDLINES_CSO : 48|1@1+ (1,0) [0|0] ""  RF_HUB
 SG_ VC_FOBIK_SAFE_CSO : 32|1@1+ (1,0) [0|0] ""  RF_HUB
 SG_ VC_FOB_LEFT_VEHICLE_CHIME_CSO : 33|1@1+ (1,0) [0|0] ""  RF_HUB
 SG_ VC_FT_PK_LOOSE_SHIP_CSO : 8|1@1+ (1,0) [0|0] ""  RF_HUB
 SG_ VC_HWRSS_CSO : 4|1@1+ (1,0) [0|0] ""  RF_HUB
 SG_ VC_LIFT_GATE_RELEASE_CSO : 37|1@1+ (1,0) [0|0] ""  RF_HUB
 SG_ VC_LKA_SENS_CSO : 57|1@1+ (1,0) [0|0] ""  RF_HUB
 SG_ VC_LKA_STRN_CSO : 58|1@1+ (1,0) [0|0] ""  RF_HUB
 SG_ VC_LKA_WARNING_CSO : 56|1@1+ (1,0) [0|0] ""  RF_HUB
 SG_ VC_PANIC_ALARM_CSO : 35|1@1+ (1,0) [0|0] ""  RF_HUB
 SG_ VC_PEB_CSO : 51|1@1+ (1,0) [0|0] ""  RF_HUB
 SG_ VC_POWER_SIDE_STEP_CSO : 61|1@1+ (1,0) [0|0] ""  RF_HUB
 SG_ VC_RR_CARGO_GUIDE_LGT_CSO : 3|1@1+ (1,0) [0|0] ""  RF_HUB
 SG_ VC_RR_PK_LOOSE_SHIP_CSO : 9|1@1+ (1,0) [0|0] ""  RF_HUB
 SG_ VC_RVC_CVPM_DGRID_CSO : 49|1@1+ (1,0) [0|0] ""  RF_HUB
 SG_ VC_RVC_CVPM_SGRID_CSO : 50|1@1+ (1,0) [0|0] ""  RF_HUB
 SG_ VC_SECURE_PARK_CSO : 36|1@1+ (1,0) [0|0] ""  RF_HUB
 SG_ VC_SEIU_INPUT_WIRE_CSO : 5|1@1+ (1,0) [0|0] ""  RF_HUB
 SG_ VC_SEIU_RPM_CSO : 6|1@1+ (1,0) [0|0] ""  RF_HUB
 SG_ VC_SPEED_THRESHOLD_CSO : 52|1@1+ (1,0) [0|0] ""  RF_HUB
 SG_ VC_THEFT_ALARM_CSO : 34|1@1+ (1,0) [0|0] ""  RF_HUB
 SG_ VC_TIRE_FILL_ALERT_CSO : 60|1@1+ (1,0) [0|0] ""  RF_HUB
 SG_ VC_TRAILER_LENGTH_BLIND_SPOT_CSO : 62|1@1+ (1,0) [0|0] ""  RF_HUB
 SG_ VC_TRUNK_UNLOCK_ENABLE_CSO : 55|1@1+ (1,0) [0|0] ""  RF_HUB
 SG_ VC_TSI_CSO : 59|1@1+ (1,0) [0|0] ""  RF_HUB
 SG_ VC_TSR_WARNING_MODE_CSO : 42|1@1+ (1,0) [0|0] ""  RF_HUB
 SG_ VC_TSR_WARNING_MODE_OFFSET_CSO : 43|1@1+ (1,0) [0|0] ""  RF_HUB
 SG_ VC_VISM_KEEP_AWAKE_CSO : 38|1@1+ (1,0) [0|0] ""  RF_HUB
 SG_ VC_VehCfgCSO3_Stat : 0|2@1+ (1,0) [0|0] ""  RF_HUB,SGW
 SG_ VC_WIRELESS_CHARGER_CSO : 47|1@1+ (1,0) [0|0] ""  RF_HUB,SGW

BO_ 963 VehCfgCSM3_BU: 8 RF_HUB
 SG_ VC_BU_3RD_ROW_LOCK_CSO : 45|1@1+ (1,0) [0|0] ""  CBC
 SG_ VC_BU_AL_FFC_OR_PLUS_CSO : 40|1@1+ (1,0) [0|0] ""  CBC
 SG_ VC_BU_AL_OR_PLUS_CSO : 41|1@1+ (1,0) [0|0] ""  CBC
 SG_ VC_BU_AUTO_STOP_START_CSO : 63|1@1+ (1,0) [0|0] ""  CBC
 SG_ VC_BU_Auto_Activ_PerfPage_CSO : 44|1@1+ (1,0) [0|0] ""  CBC
 SG_ VC_BU_BACKUP_ALARM_CSO : 2|1@1+ (1,0) [0|0] ""  CBC
 SG_ VC_BU_BUZZER_VOLUME_LEVEL_CSO : 54|1@1+ (1,0) [0|0] ""  CBC
 SG_ VC_BU_CHARGE_LOW_POPUP_CSO : 46|1@1+ (1,0) [0|0] ""  CBC,SGW
 SG_ VC_BU_CHMSL_DYN_CNTR_CSO : 7|1@1+ (1,0) [0|0] ""  CBC
 SG_ VC_BU_ESAVE_BATT_LVL_CSO : 11|1@1+ (1,0) [0|0] ""  CBC,SGW
 SG_ VC_BU_ESAVE_CSO : 10|1@1+ (1,0) [0|0] ""  CBC,SGW
 SG_ VC_BU_EXTERNAL_LIGHT_SENSOR_CSO : 53|1@1+ (1,0) [0|0] ""  CBC
 SG_ VC_BU_FFC_GRIDLINES_CSO : 48|1@1+ (1,0) [0|0] ""  CBC
 SG_ VC_BU_FOBIK_SAFE_CSO : 32|1@1+ (1,0) [0|0] ""  CBC
 SG_ VC_BU_FOB_LEFT_VEHICLE_CHIME_CSO : 33|1@1+ (1,0) [0|0] ""  CBC
 SG_ VC_BU_FT_PK_LOOSE_SHIP_CSO : 8|1@1+ (1,0) [0|0] ""  CBC
 SG_ VC_BU_HWRSS_CSO : 4|1@1+ (1,0) [0|0] ""  CBC
 SG_ VC_BU_LIFT_GATE_RELEASE_CSO : 37|1@1+ (1,0) [0|0] ""  CBC
 SG_ VC_BU_LKA_SENS_CSO : 57|1@1+ (1,0) [0|0] ""  CBC
 SG_ VC_BU_LKA_STRN_CSO : 58|1@1+ (1,0) [0|0] ""  CBC
 SG_ VC_BU_LKA_WARNING_CSO : 56|1@1+ (1,0) [0|0] ""  CBC
 SG_ VC_BU_PANIC_ALARM_CSO : 35|1@1+ (1,0) [0|0] ""  CBC
 SG_ VC_BU_PEB_CSO : 51|1@1+ (1,0) [0|0] ""  CBC
 SG_ VC_BU_POWER_SIDE_STEP_CSO : 61|1@1+ (1,0) [0|0] ""  CBC
 SG_ VC_BU_RR_CARGO_GUIDE_LGT_CSO : 3|1@1+ (1,0) [0|0] ""  CBC
 SG_ VC_BU_RR_PK_LOOSE_SHIP_CSO : 9|1@1+ (1,0) [0|0] ""  CBC
 SG_ VC_BU_RVC_CVPM_DGRID_CSO : 49|1@1+ (1,0) [0|0] ""  CBC
 SG_ VC_BU_RVC_CVPM_SGRID_CSO : 50|1@1+ (1,0) [0|0] ""  CBC
 SG_ VC_BU_SECURE_PARK_CSO : 36|1@1+ (1,0) [0|0] ""  CBC
 SG_ VC_BU_SEIU_INPUT_WIRE_CSO : 5|1@1+ (1,0) [0|0] ""  CBC
 SG_ VC_BU_SEIU_RPM_CSO : 6|1@1+ (1,0) [0|0] ""  CBC
 SG_ VC_BU_SPEED_THRESHOLD_CSO : 52|1@1+ (1,0) [0|0] ""  CBC
 SG_ VC_BU_THEFT_ALARM_CSO : 34|1@1+ (1,0) [0|0] ""  CBC
 SG_ VC_BU_TIRE_FILL_ALERT_CSO : 60|1@1+ (1,0) [0|0] ""  CBC
 SG_ VC_BU_TRAILER_LENGTH_BLIND_SPOT_ : 62|1@1+ (1,0) [0|0] ""  CBC
 SG_ VC_BU_TRUNK_UNLOCK_ENABLE_CSO : 55|1@1+ (1,0) [0|0] ""  CBC
 SG_ VC_BU_TSI_CSO : 59|1@1+ (1,0) [0|0] ""  CBC
 SG_ VC_BU_TSR_WARNING_MODE_CSO : 42|1@1+ (1,0) [0|0] ""  CBC
 SG_ VC_BU_TSR_WARNING_MODE_OFFSET_CS : 43|1@1+ (1,0) [0|0] ""  CBC
 SG_ VC_BU_VISM_KEEP_AWAKE_CSO : 38|1@1+ (1,0) [0|0] ""  CBC
 SG_ VC_BU_VehCfgCSO3_Stat : 0|2@1+ (1,0) [0|0] ""  CBC,SGW
 SG_ VC_BU_WIRELESS_CHARGER_CSO : 47|1@1+ (1,0) [0|0] ""  CBC,SGW

BO_ 2047 WAKE_SGW: 1 SGW
 SG_ WAKE_SGW_Signal : 0|8@1+ (1,0) [0|0] "" Vector__XXX

BO_ 47 WHEEL_SPEED_2: 8 ESC
 SG_ BrkPdlRawStat : 33|10@0+ (0.0048828125,0) [0|4.9951171875] "Volts"  ECM,ETM,SGW,TBM
 SG_ RAW_OBD_VEHACCEL_X : 48|8@1+ (0.08,-10.24) [-10.24|10.16] "m/s²"  ECM,SGW

CM_ SG_ 948 VC_AIRBAG_ON_CSO "Passenger airbag on/off customer setting menu present. Present = 1.";
CM_ SG_ 948 VC_AUTO_SS_CSO "Automatic side step customer settings menu. Present = 1";
CM_ SG_ 948 VC_BSM_TRLR_CSO "Blind spot with trailer customer settings menu. Present = 1";
CM_ SG_ 948 VC_DOORS_OFF_ACC_DLY_CSO "Doors & engine off power delay customer settings menu backup. Present = 1";
CM_ SG_ 948 VC_EPB_ON_CSO "EPB on/off customer setting menu present. Present = 1.";
CM_ SG_ 948 VC_FCW_SW_CSO "FCW Switch customer setting menu present.  Present = 1";
CM_ SG_ 948 VC_FCW_WARN_BRK_CSO "FCW single setting (warning and brake) customer setting menu.  Present = 1";
CM_ SG_ 948 VC_FLSH_LMP_SLDR_CSO "Flash lamps with sliding door customer settings menu; Present = [1]";
CM_ SG_ 948 VC_FUEL_SAV_CSO "Fuel Saver settings menu; Present = [1]";
CM_ SG_ 948 VC_HANDS_FREE_LFT_CSO "Hands free liftgate customer setting menu: Present = 1";
CM_ SG_ 948 VC_HANDS_FREE_SLDR_CSO "Hands free sliding door customer setting menu: Present = 1";
CM_ SG_ 948 VC_HOLD_N_GO_CSO "Hold and go customer setting menu: Present = 1";
CM_ SG_ 948 VC_LDW_ON_CSO "LDW on/off customer setting menu present.  Present = 1.";
CM_ SG_ 948 VC_PADDLE_SHIFT_CSO "Paddle shifter customer setting menu present.  Present = [1]";
CM_ SG_ 948 VC_PCS_CSO "Auto on passenger comfort customer settings menu. Present = 1";
CM_ SG_ 948 VC_PRK_ASST_TYPE_CSO "Park assist type customer setting menu present. Present = 1.";
CM_ SG_ 948 VC_PWR_FLD_MRR_CSO "Power folding mirror customer setting menu: Present = 1";
CM_ SG_ 948 VC_RDY_DRV_CSO "Disable ready to drive popup customer settings menu. Present = 1";
CM_ SG_ 948 VC_REAR_CMRA_DLY_CSO "Rear view camera delay customer settings menu; Present = [1]";
CM_ SG_ 948 VC_RKE_MEM_CSO "RKE linked to memory customer settings menu; Present = [1]";
CM_ SG_ 948 VC_RKE_UNLK_CSO "RKE unlock customer settings menu; Present = [1]";
CM_ SG_ 948 VC_SLD_DR_ALRT_CSO "Sliding door alert customer setting menu: Present = 1";
CM_ SG_ 948 VC_SLD_DR_CHM_CSO "Sliding door chime customer setting menu present: Present = 1";
CM_ SG_ 948 VC_SPEED_CSO "Speed unit customer settings menu; Present = [1]";
CM_ SG_ 948 VC_SPEED_WARNING_CSO "Speed warning  customer setting";
CM_ SG_ 948 VC_SVC_DELAY_CSO "Surround view camera delay customer setting menu: Present = 1";
CM_ SG_ 948 VC_SVC_GRIDLINES_CSO "Surround view camera gridlines customer setting menu: Present = 1";
CM_ SG_ 948 VC_TEEN_AUTO_HB_CSO "Teen key automatic highbeam customer setting menu: Present = 1";
CM_ SG_ 948 VC_TEEN_BLIND_SPOT_CSO "Teen key blind spot customer setting menu: Present = 1";
CM_ SG_ 948 VC_TEEN_FCW_BRK_CSO "Teen key FCW braking customer setting menu: Present = 1";
CM_ SG_ 948 VC_TEEN_FCW_SENS_CSO "Teen key FCW sensitivity customer setting menu: Present = 1";
CM_ SG_ 948 VC_TEEN_FT_PRK_VOL_CSO "Teen key front park assist chime volume customer setting menu: Present = 1";
CM_ SG_ 948 VC_TEEN_FUEL_POPUP_CSO "Teen key fuel pop-up customer setting menu: Present = 1";
CM_ SG_ 948 VC_TEEN_FUEL_WRN_CSO "Teen key early fuel warning customer setting menu: Present = 1";
CM_ SG_ 948 VC_TEEN_LGHT_WPR_CSO "Teen key lights on with wipers customer setting menu: Present = 1";
CM_ SG_ 948 VC_TEEN_MAX_SPEED_CSO "Teen key max speed customer setting menu: Present = 1";
CM_ SG_ 948 VC_TEEN_PLG_CHIME_CSO "Teen key power lift gate chime customer setting menu: Present = 1";
CM_ SG_ 948 VC_TEEN_PRK_ASST_BRK_CSO "Teen key park assist brake customer settings menu.  Present = 1";
CM_ SG_ 948 VC_TEEN_PRK_ASST_CSO "Teen key park assist customer setting menu: Present = 1";
CM_ SG_ 948 VC_TEEN_RAIN_WPR_CSO "Teen key rain sensitive wiper customer setting menu: Present = 1";
CM_ SG_ 948 VC_TEEN_RR_PRK_VOL_CSO "Teen key rear park assist chime volume customer setting menu: Present = 1";
CM_ SG_ 948 VC_TEEN_SLD_DR_ALRT_CSO "Teen key sliding door alert customer setting menu: Present = 1";
CM_ SG_ 948 VC_TEEN_SLD_DR_CHM_CSO "Teen key sliding door chime customer setting menu present: Present = 1";
CM_ SG_ 948 VC_TEMP_CSO "Temperature Unit settings menu; Present = [1]";
CM_ SG_ 948 VC_TLT_MRR_CSO "Tilt mirror in reverse customer settings menu; Present = [1]";
CM_ SG_ 948 VC_TORQUE_CSO "Torque unit customer settings menu; Present = [1]";
CM_ SG_ 948 VC_TRLR_CSO "Trailer selected customer settings menu; Present = [1]";
CM_ SG_ 948 VC_TRLR_NAME_CSO "Trailer name customer settings menu; Present = [1]";
CM_ SG_ 948 VC_TRLR_TYPE_CSO "Trailer type customer settings menu; Present = [1]";
CM_ SG_ 948 VC_TRNS_MD_CSO "Transport mode customer settings menu; Present = [1]";
CM_ SG_ 948 VC_US_METRIC_CSO "US metric customer settings menu; Present = [1]";
CM_ SG_ 948 VC_VehCfgCSO2_Stat "Configuration message CSO2 status";
CM_ SG_ 948 VC_WHL_ALGN_CSO "Wheel alignment customer settings menu; Present = [1]";
CM_ SG_ 950 VC_BU_AIRBAG_ON_CSO "Backup for Passenger airbag on/off customer setting menu present. Present = 1.";
CM_ SG_ 950 VC_BU_AUTO_SS_CSO "Backup for Automatic side step customer settings menu. Present = 1";
CM_ SG_ 950 VC_BU_BSM_TRLR_CSO "Backup for Blind spot with trailer customer settings menu. Present = 1.";
CM_ SG_ 950 VC_BU_DOORS_OFF_ACC_DLY_CSO "Backup for Doors & engine off power delay customer settings menu backup. Present = 1";
CM_ SG_ 950 VC_BU_EPB_ON_CSO "Backup for EPB on/off customer setting menu present. Present = 1.";
CM_ SG_ 950 VC_BU_FCW_SW_CSO "Backup for FCW Switch customer setting menu present.  Present = 1";
CM_ SG_ 950 VC_BU_FCW_WARN_BRK_CSO "Backup for FCW single setting (warning and brake) customer setting menu.  Present = 1";
CM_ SG_ 950 VC_BU_FLSH_LMP_SLDR_CSO "Backup for flash lamps with sliding door customer settings menu; Present = [1]";
CM_ SG_ 950 VC_BU_FUEL_SAV_CSO "Backup for Fuel Saver settings menu; Present = [1]";
CM_ SG_ 950 VC_BU_HANDS_FREE_LFT_CSO "Backup for Hands free liftgate customer setting menu: Present = 1";
CM_ SG_ 950 VC_BU_HANDS_FREE_SLDR_CSO "Backup for Hands free sliding door customer setting menu: Present = 1";
CM_ SG_ 950 VC_BU_HOLD_N_GO_CSO "Backup for Hold and go customer setting menu: Present = 1";
CM_ SG_ 950 VC_BU_LDW_ON_CSO "Backup for LDW on/off customer setting menu present.  Present = 1.";
CM_ SG_ 950 VC_BU_PADDLE_SHIFT_CSO "Backup for paddle shifter customer setting menu present.  Present = [1]";
CM_ SG_ 950 VC_BU_PCS_CSO "Backup for Auto on passenger comfort customer settings menu. Present = 1";
CM_ SG_ 950 VC_BU_PRK_ASST_TYPE_CSO "Backup for Park assist type customer setting menu present. Present = 1.";
CM_ SG_ 950 VC_BU_PWR_FLD_MRR_CSO "Backup for Power folding mirror customer setting menu: Present = 1";
CM_ SG_ 950 VC_BU_RDY_DRV_CSO "Backup for disable ready to drive popup customer settings menu.  Present = 1";
CM_ SG_ 950 VC_BU_REAR_CMRA_DLY_CSO "Backup for Rear view camera delay customer settings menu";
CM_ SG_ 950 VC_BU_RKE_MEM_CSO "Backup for RKE linked to memory customer settings menu";
CM_ SG_ 950 VC_BU_RKE_UNLK_CSO "Backup for RKE unlock customer settings menu";
CM_ SG_ 950 VC_BU_SLD_DR_ALRT_CSO "Backup for Sliding door alert customer setting menu: Present = 1";
CM_ SG_ 950 VC_BU_SLD_DR_CHM_CSO "Backup for Sliding door chime customer setting menu present: Present = 1";
CM_ SG_ 950 VC_BU_SPEED_CSO "Backup for Speed unit customer settings menu";
CM_ SG_ 950 VC_BU_SPEED_WARNING_CSO "Backup for Speed warning  customer setting";
CM_ SG_ 950 VC_BU_SVC_DELAY_CSO "Backup for Surround view camera delay customer setting menu: Present = 1";
CM_ SG_ 950 VC_BU_SVC_GRIDLINES_CSO "Backup for Surround view camera gridlines customer setting menu: Present = 1";
CM_ SG_ 950 VC_BU_TEEN_AUTO_HB_CSO "Backup for Teen key automatic highbeam customer setting menu: Present = 1";
CM_ SG_ 950 VC_BU_TEEN_BLIND_SPOT_CSO "Backup for Teen key blind spot customer setting menu: Present = 1";
CM_ SG_ 950 VC_BU_TEEN_FCW_BRK_CSO "Backup for Teen key FCW braking customer setting menu: Present = 1";
CM_ SG_ 950 VC_BU_TEEN_FCW_SENS_CSO "Backup for Teen key FCW sensitivity customer setting menu: Present = 1";
CM_ SG_ 950 VC_BU_TEEN_FT_PRK_VOL_CSO "Backup for Teen key front park assist chime volume customer setting menu: Present = 1";
CM_ SG_ 950 VC_BU_TEEN_FUEL_POPUP_CSO "Backup for Teen key fuel pop-up customer setting menu: Present = 1";
CM_ SG_ 950 VC_BU_TEEN_FUEL_WRN_CSO "Backup for Teen key early fuel warning customer setting menu: Present = 1";
CM_ SG_ 950 VC_BU_TEEN_LGHT_WPR_CSO "Backup for Teen key lights on with wipers customer setting menu: Present = 1";
CM_ SG_ 950 VC_BU_TEEN_MAX_SPEED_CSO "Backup for Teen key max speed customer setting menu: Present = 1";
CM_ SG_ 950 VC_BU_TEEN_PLG_CHIME_CSO "Backup for Teen key power lift gate chime customer setting menu: Present = 1";
CM_ SG_ 950 VC_BU_TEEN_PRK_ASST_BRK_CSO "Backup teen key park assist brake customer settings menu.  Present = 1";
CM_ SG_ 950 VC_BU_TEEN_PRK_ASST_CSO "Backup for Teen key park assist customer setting menu: Present = 1";
CM_ SG_ 950 VC_BU_TEEN_RAIN_WPR_CSO "Backup for Teen key rain sensitive wiper customer setting menu: Present = 1";
CM_ SG_ 950 VC_BU_TEEN_RR_PRK_VOL_CSO "Backup for Teen key rear park assist chime volume customer setting menu: Present = 1";
CM_ SG_ 950 VC_BU_TEEN_SLD_DR_ALRT_CSO "Backup for Teen key sliding door alert customer setting menu: Present = 1";
CM_ SG_ 950 VC_BU_TEEN_SLD_DR_CHM_CSO "Backup for Teen key sliding door chime customer setting menu present: Present = 1";
CM_ SG_ 950 VC_BU_TEMP_CSO "Backup for Temperature Unit settings menu; Present = [1]";
CM_ SG_ 950 VC_BU_TLT_MRR_CSO "Backup for Tilt mirror in reverse customer settings menu";
CM_ SG_ 950 VC_BU_TORQUE_CSO "Backup for Torque unit customer settings menu";
CM_ SG_ 950 VC_BU_TRLR_CSO "Backup for Trailer selected customer settings menu";
CM_ SG_ 950 VC_BU_TRLR_NAME_CSO "Backup for Trailer name customer settings menu";
CM_ SG_ 950 VC_BU_TRLR_TYPE_CSO "Backup for Trailer type customer settings menu";
CM_ SG_ 950 VC_BU_TRNS_MD_CSO "Backup for Transport mode customer settings menu";
CM_ SG_ 950 VC_BU_US_METRIC_CSO "Backup for US metric customer settings menu";
CM_ SG_ 950 VC_BU_VehCfgCSO2_Stat "Backup for Configuration message CSO2 status";
CM_ SG_ 950 VC_BU_WHL_ALGN_CSO "Backup for Wheel alignment customer settings menu";
CM_ SG_ 962 VC_3RD_ROW_LOCK_CSO "3rd Row Lockout Enable/Disable customer settings menu, Present = [1]";
CM_ SG_ 962 VC_AL_FFC_OR_PLUS_CSO "Auto Launch Forward Facing Camera Off Road Plus customer settings menu";
CM_ SG_ 962 VC_AL_OR_PLUS_CSO "Auto Launch Off Road Plus customer settings menu";
CM_ SG_ 962 VC_AUTO_STOP_START_CSO "Auto Stop Start Enable/Disable customer settings menu";
CM_ SG_ 962 VC_Auto_Activ_PerfPage_CSO "RACE Automatic activation Performance Page customer settings menu; Present = [1]";
CM_ SG_ 962 VC_BACKUP_ALARM_CSO "Backup Alarm Enable/Disable customer settings menu, Present = 1";
CM_ SG_ 962 VC_BUZZER_VOLUME_LEVEL_CSO "Buzzer Volume Level Enable/Disable customer settings menu";
CM_ SG_ 962 VC_CHARGE_LOW_POPUP_CSO "Charge Low PopUp Enable/Disable customer settings menu, Present = [1]";
CM_ SG_ 962 VC_CHMSL_DYN_CNTR_CSO "CHMSL Dynamic Centerline Enable/Disable customer settings menu";
CM_ SG_ 962 VC_ESAVE_BATT_LVL_CSO "E-Save Battery Level customer settings menu";
CM_ SG_ 962 VC_ESAVE_CSO "E-Save Enable/Disable customer settings menu";
CM_ SG_ 962 VC_EXTERNAL_LIGHT_SENSOR_CSO "External Light Sensor Enable/Disable customer settings menu";
CM_ SG_ 962 VC_FFC_GRIDLINES_CSO "Forward Facing Camera Gridlines, Present = 1";
CM_ SG_ 962 VC_FOBIK_SAFE_CSO "FOBIK SAFE Enable/Disable customer settings menu;0 - Absent , 1 - Present";
CM_ SG_ 962 VC_FOB_LEFT_VEHICLE_CHIME_CSO "FOB Left Vehicle chime settings;0 - Absent , 1 - Present";
CM_ SG_ 962 VC_FT_PK_LOOSE_SHIP_CSO "Front Park Sense Loose Ship Enable/Disable customer settings menu;0 - Absent 1 - Present";
CM_ SG_ 962 VC_HWRSS_CSO "HWRSS Enable/Disable customer settings menu,Present =1";
CM_ SG_ 962 VC_LIFT_GATE_RELEASE_CSO "Liftgate release settings  ; 0 - Absent , 1 - Present";
CM_ SG_ 962 VC_LKA_SENS_CSO "Lane Keep Assist Sensitivity customer settings menu";
CM_ SG_ 962 VC_LKA_STRN_CSO "Lane Keep Assist Strength customer settings menu";
CM_ SG_ 962 VC_LKA_WARNING_CSO "Lane Keep Assist Warning Mode customer settings menu";
CM_ SG_ 962 VC_PANIC_ALARM_CSO "Panic Alarm settings ; 0 - Absent , 1 - Present";
CM_ SG_ 962 VC_PEB_CSO "Pedestrian Emergency Brake Enable/Disable customer settings menu";
CM_ SG_ 962 VC_POWER_SIDE_STEP_CSO "Power Side Step Enable/Disable customer settings menu, 1 - Present.";
CM_ SG_ 962 VC_RR_CARGO_GUIDE_LGT_CSO "Rear Cargo Guidance Lights Enable/Disable customer settings menu, Present = 1";
CM_ SG_ 962 VC_RR_PK_LOOSE_SHIP_CSO "Rear Park Sense Loose Ship Enable/Disable customer settings menu;0 - Absent 1 - Present";
CM_ SG_ 962 VC_RVC_CVPM_DGRID_CSO "Rear CVPM Camera Dynamic Gridlines, Present = 1";
CM_ SG_ 962 VC_RVC_CVPM_SGRID_CSO "Rear CVPM Camera Static Gridlines, Present = 1";
CM_ SG_ 962 VC_SECURE_PARK_CSO "Secure Park settings ; 0 - Absent , 1 - Present";
CM_ SG_ 962 VC_SEIU_INPUT_WIRE_CSO "SEIU Input Wire Enable/Disable customer settings menu,Present =1";
CM_ SG_ 962 VC_SEIU_RPM_CSO "SEIU RPM Enable/Disable customer settings menu,Present =1";
CM_ SG_ 962 VC_SPEED_THRESHOLD_CSO "Vehicle Speed Threshold Enable/Disable customer settings menu";
CM_ SG_ 962 VC_THEFT_ALARM_CSO "Theft Alarm settings;0 - Absent , 1 - Present";
CM_ SG_ 962 VC_TIRE_FILL_ALERT_CSO "Tire Fill Alert Enable/Disable customer settings menu";
CM_ SG_ 962 VC_TRAILER_LENGTH_BLIND_SPOT_CSO "Trailer Length Blind Spot Enable/Disable customer settings menu. 1 - Present";
CM_ SG_ 962 VC_TRUNK_UNLOCK_ENABLE_CSO "Trunk Unlock Enable/Disable customer settings menu";
CM_ SG_ 962 VC_TSI_CSO "Traffic Sign Information Enable/Disable customer settings menu";
CM_ SG_ 962 VC_TSR_WARNING_MODE_CSO "TSR Warning Mode customer setting menu, Present = 1";
CM_ SG_ 962 VC_TSR_WARNING_MODE_OFFSET_CSO "TSR Warning Mode Offset customer setting menu, Present = 1";
CM_ SG_ 962 VC_VISM_KEEP_AWAKE_CSO "VSIM Keep Awake settings ; 0 - Absent , 1 - Present";
CM_ SG_ 962 VC_VehCfgCSO3_Stat "Configuration message CSO3 status";
CM_ SG_ 962 VC_WIRELESS_CHARGER_CSO "Wireless Charger Enable/Disable customer settings menu, Present = [1]";
CM_ SG_ 963 VC_BU_3RD_ROW_LOCK_CSO "Backup 3rd Row Lockout Enable/Disable customer settings menu, Present = [1]";
CM_ SG_ 963 VC_BU_AL_FFC_OR_PLUS_CSO "BACKUP Auto Launch Forward Facing Camera Off Road Plus customer settings menu";
CM_ SG_ 963 VC_BU_AL_OR_PLUS_CSO "BACKUP Auto Launch Off Road Plus customer settings menu";
CM_ SG_ 963 VC_BU_AUTO_STOP_START_CSO "Auto Stop Start Enable/Disable customer settings menu";
CM_ SG_ 963 VC_BU_Auto_Activ_PerfPage_CSO "Backup RACE Automatic activation Performance Page customer settings menu; Present = [1]";
CM_ SG_ 963 VC_BU_BACKUP_ALARM_CSO "Backup for Back Up Alarm Enable/Disable customer settings menu;Present=1";
CM_ SG_ 963 VC_BU_BUZZER_VOLUME_LEVEL_CSO "Buzzer Volume Level Enable/Disable customer settings menu";
CM_ SG_ 963 VC_BU_CHARGE_LOW_POPUP_CSO "Backup Charge Low PopUp Enable/Disable customer settings menu, Present = [1]";
CM_ SG_ 963 VC_BU_CHMSL_DYN_CNTR_CSO "BACKUP CHMSL Dynamic Centerline Enable/Disable customer settings menu";
CM_ SG_ 963 VC_BU_ESAVE_BATT_LVL_CSO "Backup E-Save Battery Level customer settings menu";
CM_ SG_ 963 VC_BU_ESAVE_CSO "Backup E-Save Enable/Disable customer settings menu";
CM_ SG_ 963 VC_BU_EXTERNAL_LIGHT_SENSOR_CSO "External Light Sensor Enable/Disable customer settings menu";
CM_ SG_ 963 VC_BU_FFC_GRIDLINES_CSO "Backup for Forward Facing Camera Gridlines, Present = 1";
CM_ SG_ 963 VC_BU_FOBIK_SAFE_CSO "Back up for FOBIK SAFE Enable/Disable customer settings menu;0 - Absent , 1 - Present";
CM_ SG_ 963 VC_BU_FOB_LEFT_VEHICLE_CHIME_CSO "Back up for FOB Left Vehicle chime settings ;0 - Absent , 1 - Present";
CM_ SG_ 963 VC_BU_FT_PK_LOOSE_SHIP_CSO "Back up for Front Park Sense Loose Ship Enable/Disable customer settings menu;0 - Absent 1 - Present";
CM_ SG_ 963 VC_BU_HWRSS_CSO "Back up for HWRSS Enable/Disable customer settings menu;Present=1";
CM_ SG_ 963 VC_BU_LIFT_GATE_RELEASE_CSO "Back up for Liftgate release settings  ; 0 - Absent , 1 - Present";
CM_ SG_ 963 VC_BU_LKA_STRN_CSO "Lane Keep Assist Strength customer settings menu";
CM_ SG_ 963 VC_BU_LKA_WARNING_CSO "Lane Keep Assist Warning Mode customer settings menu";
CM_ SG_ 963 VC_BU_PANIC_ALARM_CSO "Back up for Panic Alarm settings ; 0 - Absent , 1 - Present";
CM_ SG_ 963 VC_BU_PEB_CSO "Pedestrian Emergency Brake Enable/Disable customer settings menu";
CM_ SG_ 963 VC_BU_POWER_SIDE_STEP_CSO "Power Side Step Enable/Disable customer settings menu, 1 - Present.";
CM_ SG_ 963 VC_BU_RR_CARGO_GUIDE_LGT_CSO "Back up for Rear Cargo Guidance Lights Enable/Disable customer settings menu;Present=1";
CM_ SG_ 963 VC_BU_RR_PK_LOOSE_SHIP_CSO "Back up for Rear Park Sense Loose Ship Enable/Disable customer settings menu;0 - Absent 1 - Present";
CM_ SG_ 963 VC_BU_RVC_CVPM_DGRID_CSO "Backup for Rear CVPM Camera Dynamic Gridlines, Present = 1";
CM_ SG_ 963 VC_BU_RVC_CVPM_SGRID_CSO "Backup for Rear CVPM Camera Static Gridlines, Present = 1";
CM_ SG_ 963 VC_BU_SECURE_PARK_CSO "Back up for Secure Park settings ; 0 - Absent , 1 - Present";
CM_ SG_ 963 VC_BU_SEIU_INPUT_WIRE_CSO "Back up fpr SEIU Input Wire Enable/Disable customer settings menu;Present=1";
CM_ SG_ 963 VC_BU_SEIU_RPM_CSO "Back up for SEIU RPM Enable/Disable customer settings menu;Present=1";
CM_ SG_ 963 VC_BU_SPEED_THRESHOLD_CSO "Vehicle Speed Threshold Enable/Disable customer settings menu";
CM_ SG_ 963 VC_BU_THEFT_ALARM_CSO "Back up for Theft Alarm settings ;0 - Absent , 1 - Present";
CM_ SG_ 963 VC_BU_TIRE_FILL_ALERT_CSO "Tire Fill Alert Enable/Disable customer settings menu. 1 - Present";
CM_ SG_ 963 VC_BU_TRAILER_LENGTH_BLIND_SPOT_ "Backup for Trailer Length Blind Spot Enable/Disable customer settings menu. 1 - Present";
CM_ SG_ 963 VC_BU_TRUNK_UNLOCK_ENABLE_CSO "Trunk Unlock Enable/Disable customer settings menu";
CM_ SG_ 963 VC_BU_TSI_CSO "Traffic Sign Information Enable/Disable customer settings menu";
CM_ SG_ 963 VC_BU_TSR_WARNING_MODE_CSO "Backup TSR Warning Mode customer setting menu, Present = 1";
CM_ SG_ 963 VC_BU_TSR_WARNING_MODE_OFFSET_CS "Backup TSR Warning Mode Offset customer setting menu, Present = 1";
CM_ SG_ 963 VC_BU_VISM_KEEP_AWAKE_CSO "Back up for VSIM Keep Awake settings ; 0 - Absent , 1 - Present";
CM_ SG_ 963 VC_BU_VehCfgCSO3_Stat "Backup for Configuration message CSO3 status";
CM_ SG_ 963 VC_BU_WIRELESS_CHARGER_CSO "Backup for Wireless Charger Enable/Disable customer settings menu, Present = [1]";
CM_ SG_ 2047 WAKE_SGW_Signal "This signal is used to wakeup networks";
CM_ SG_ 47 BrkPdlRawStat "Brake pedal state raw value";
CM_ SG_ 47 RAW_OBD_VEHACCEL_X "Raw vehicle acceleration in the X direction";
BA_DEF_ BO_  "App-Botschaft" ENUM  "nein","ja";
BA_DEF_ BO_  "CanMsgMinLen" INT 0 8;
BA_DEF_ BO_  "DiagRequest" ENUM  "nein","ja";
BA_DEF_ BO_  "DiagResponse" ENUM  "nein","ja";
BA_DEF_ BO_  "DiagState" ENUM  "nein","ja";
BA_DEF_ BO_  "GenMsgCycleTime" INT 0 65535;
BA_DEF_ BO_  "GenMsgCycleTimeActive" INT 0 65535;
BA_DEF_ BO_  "GenMsgDelayTime" INT 0 65535;
BA_DEF_ BO_  "GenMsgNrOfRepetitions" INT 0 65535;
BA_DEF_ BO_  "GenMsgSendType" ENUM  "cyclicX","spontanX","cyclicIfActiveX","spontanWithDelay","cyclicAndSpontanX","cyclicAndSpontanWithDelay","spontanWithRepitition","cyclicIfActiveAndSpontanWD","cyclicIfActiveFast","cyclicWithRepeatOnDemand","none";
BA_DEF_ BO_  "GenMsgStartDelayTime" INT 0 65535;
BA_DEF_ BO_  "GenMsgStartValue" STRING ;
BA_DEF_ BO_  "NWM-Botschaft" ENUM  "nein","ja";
BA_DEF_ BO_  "TpTxIndex" INT 0 99;
BA_DEF_ SG_  "FlexKomComment" STRING ;
BA_DEF_ SG_  "FlexKomIsMotorola" ENUM  "nein","ja";
BA_DEF_ SG_  "FlexKomSID" INT 0 2147483647;
BA_DEF_ SG_  "FlexKomSigLaenge" INT 0 64;
BA_DEF_ SG_  "FlexKomSigName" STRING ;
BA_DEF_ SG_  "FlexKomSigStartPos" INT 0 63;
BA_DEF_ SG_  "FlexKomSigStartValue" STRING ;
BA_DEF_ SG_  "GenSigCycleTime" INT 0 65535;
BA_DEF_ SG_  "GenSigCycleTimeActive" INT 0 65535;
BA_DEF_ SG_  "GenSigSendType" ENUM  "cyclicX","spontanX","cyclicIfActiveX","spontanWithDelay","cyclicAndSpontanX","cyclicAndSpontanWithDelay","spontanWithRepitition","cyclicIfActiveAndSpontanWD","cyclicIfActiveFast","cyclicWithRepeatOnDemand","none";
BA_DEF_ SG_  "GenSigSNA" STRING ;
BA_DEF_ SG_  "GenSigStartValue" HEX 0 2147483648;
BA_DEF_ SG_  "GenSigTimeout_AHLM" INT 0 65535;
BA_DEF_ SG_  "GenSigTimeout_ASBS" INT 0 65535;
BA_DEF_ SG_  "GenSigTimeout_CBC" INT 0 65535;
BA_DEF_ SG_  "GenSigTimeout_DPDM" INT 0 65535;
BA_DEF_ SG_  "GenSigTimeout_DTCM" INT 0 65535;
BA_DEF_ SG_  "GenSigTimeout_EHPS" INT 0 65535;
BA_DEF_ SG_  "GenSigTimeout_ESC" INT 0 65535;
BA_DEF_ SG_  "GenSigTimeout_ESL" INT 0 65535;
BA_DEF_ SG_  "GenSigTimeout_ESM" INT 0 65535;
BA_DEF_ SG_  "GenSigTimeout_ETM" INT 0 65535;
BA_DEF_ SG_  "GenSigTimeout_IC" INT 0 65535;
BA_DEF_ SG_  "GenSigTimeout_OCM" INT 0 65535;
BA_DEF_ SG_  "GenSigTimeout_ORC" INT 0 65535;
BA_DEF_ SG_  "GenSigTimeout_PTS" INT 0 65535;
BA_DEF_ SG_  "GenSigTimeout_RF_HUB" INT 0 65535;
BA_DEF_ SG_  "GenSigTimeout_SCCM" INT 0 65535;
BA_DEF_ SG_  "GenSigTimeout_TBM" INT 0 65535;
BA_DEF_ SG_  "GenSigTimeout_TCM" INT 0 65535;
BA_DEF_ SG_  "GenSigTimeout_TPM" INT 0 65535;
BA_DEF_ SG_  "RID" STRING ;
BA_DEF_ SG_  "SystemSignalLongSymbol" STRING ;
BA_DEF_DEF_  "App-Botschaft" "nein";
BA_DEF_DEF_  "CanMsgMinLen" 0;
BA_DEF_DEF_  "DiagRequest" "nein";
BA_DEF_DEF_  "DiagResponse" "nein";
BA_DEF_DEF_  "DiagState" "nein";
BA_DEF_DEF_  "GenMsgCycleTime" 0;
BA_DEF_DEF_  "GenMsgCycleTimeActive" 0;
BA_DEF_DEF_  "GenMsgDelayTime" 0;
BA_DEF_DEF_  "GenMsgNrOfRepetitions" 0;
BA_DEF_DEF_  "GenMsgSendType" "cyclicX";
BA_DEF_DEF_  "GenMsgStartDelayTime" 0;
BA_DEF_DEF_  "GenMsgStartValue" "";
BA_DEF_DEF_  "NWM-Botschaft" "nein";
BA_DEF_DEF_  "TpTxIndex" 0;
BA_DEF_DEF_  "FlexKomComment" "";
BA_DEF_DEF_  "FlexKomIsMotorola" "nein";
BA_DEF_DEF_  "FlexKomSID" 0;
BA_DEF_DEF_  "FlexKomSigLaenge" 0;
BA_DEF_DEF_  "FlexKomSigName" "";
BA_DEF_DEF_  "FlexKomSigStartPos" 0;
BA_DEF_DEF_  "FlexKomSigStartValue" "";
BA_DEF_DEF_  "GenSigCycleTime" 0;
BA_DEF_DEF_  "GenSigCycleTimeActive" 0;
BA_DEF_DEF_  "GenSigSendType" "cyclicX";
BA_DEF_DEF_  "GenSigSNA" "";
BA_DEF_DEF_  "GenSigStartValue" 0;
BA_DEF_DEF_  "GenSigTimeout_AHLM" 0;
BA_DEF_DEF_  "GenSigTimeout_ASBS" 0;
BA_DEF_DEF_  "GenSigTimeout_CBC" 0;
BA_DEF_DEF_  "GenSigTimeout_DPDM" 0;
BA_DEF_DEF_  "GenSigTimeout_DTCM" 0;
BA_DEF_DEF_  "GenSigTimeout_EHPS" 0;
BA_DEF_DEF_  "GenSigTimeout_ESC" 0;
BA_DEF_DEF_  "GenSigTimeout_ESL" 0;
BA_DEF_DEF_  "GenSigTimeout_ESM" 0;
BA_DEF_DEF_  "GenSigTimeout_ETM" 0;
BA_DEF_DEF_  "GenSigTimeout_IC" 0;
BA_DEF_DEF_  "GenSigTimeout_OCM" 0;
BA_DEF_DEF_  "GenSigTimeout_ORC" 0;
BA_DEF_DEF_  "GenSigTimeout_PTS" 0;
BA_DEF_DEF_  "GenSigTimeout_RF_HUB" 0;
BA_DEF_DEF_  "GenSigTimeout_SCCM" 0;
BA_DEF_DEF_  "GenSigTimeout_TBM" 0;
BA_DEF_DEF_  "GenSigTimeout_TCM" 0;
BA_DEF_DEF_  "GenSigTimeout_TPM" 0;
BA_DEF_DEF_  "RID" "";
BA_DEF_DEF_  "SystemSignalLongSymbol" "";
BA_ "GenMsgStartValue" BO_ 948 "0300000000000000h";
BA_ "GenMsgStartDelayTime" BO_ 948 70;
BA_ "GenMsgSendType" BO_ 948 5;
BA_ "GenMsgNrOfRepetitions" BO_ 948 2;
BA_ "GenMsgDelayTime" BO_ 948 20;
BA_ "GenMsgCycleTime" BO_ 948 2000;
BA_ "GenMsgStartValue" BO_ 950 "0300000000000000h";
BA_ "GenMsgSendType" BO_ 950 1;
BA_ "GenMsgNrOfRepetitions" BO_ 950 2;
BA_ "GenMsgDelayTime" BO_ 950 20;
BA_ "GenMsgStartValue" BO_ 962 "0300000000000000h";
BA_ "GenMsgStartDelayTime" BO_ 962 70;
BA_ "GenMsgSendType" BO_ 962 5;
BA_ "GenMsgNrOfRepetitions" BO_ 962 2;
BA_ "GenMsgDelayTime" BO_ 962 20;
BA_ "GenMsgCycleTime" BO_ 962 2000;
BA_ "GenMsgStartValue" BO_ 963 "0300000000000000h";
BA_ "GenMsgStartDelayTime" BO_ 963 70;
BA_ "GenMsgSendType" BO_ 963 1;
BA_ "GenMsgNrOfRepetitions" BO_ 963 2;
BA_ "GenMsgDelayTime" BO_ 963 20;
BA_ "GenMsgStartValue" BO_ 2047 "00h";
BA_ "GenMsgSendType" BO_ 2047 1;
BA_ "GenMsgNrOfRepetitions" BO_ 2047 2;
BA_ "GenMsgDelayTime" BO_ 2047 20;
BA_ "GenMsgStartValue" BO_ 47 "FFFFFFFF00000000h";
BA_ "GenMsgNrOfRepetitions" BO_ 47 2;
BA_ "GenMsgDelayTime" BO_ 47 20;
BA_ "GenMsgCycleTime" BO_ 47 10;
BA_ "GenSigTimeout_IC" SG_ 948 VC_AIRBAG_ON_CSO 21000;
BA_ "GenSigSNA" SG_ 948 VC_AIRBAG_ON_CSO "0h";
BA_ "GenSigSendType" SG_ 948 VC_AIRBAG_ON_CSO 5;
BA_ "GenSigCycleTime" SG_ 948 VC_AIRBAG_ON_CSO 2000;
BA_ "FlexKomSigStartValue" SG_ 948 VC_AIRBAG_ON_CSO "0300000000000000h";
BA_ "FlexKomSigStartPos" SG_ 948 VC_AIRBAG_ON_CSO 7;
BA_ "FlexKomSigName" SG_ 948 VC_AIRBAG_ON_CSO "VehCfgCSM2_Pkt";
BA_ "FlexKomSigLaenge" SG_ 948 VC_AIRBAG_ON_CSO 64;
BA_ "FlexKomSID" SG_ 948 VC_AIRBAG_ON_CSO 2007;
BA_ "FlexKomIsMotorola" SG_ 948 VC_AIRBAG_ON_CSO 1;
BA_ "FlexKomComment" SG_ 948 VC_AIRBAG_ON_CSO "Vehicle configuration - customer settings menu 2 P";
BA_ "GenSigTimeout_IC" SG_ 948 VC_AUTO_SS_CSO 21000;
BA_ "GenSigSNA" SG_ 948 VC_AUTO_SS_CSO "0h";
BA_ "GenSigSendType" SG_ 948 VC_AUTO_SS_CSO 5;
BA_ "GenSigCycleTime" SG_ 948 VC_AUTO_SS_CSO 2000;
BA_ "FlexKomSigStartValue" SG_ 948 VC_AUTO_SS_CSO "0300000000000000h";
BA_ "FlexKomSigStartPos" SG_ 948 VC_AUTO_SS_CSO 7;
BA_ "FlexKomSigName" SG_ 948 VC_AUTO_SS_CSO "VehCfgCSM2_Pkt";
BA_ "FlexKomSigLaenge" SG_ 948 VC_AUTO_SS_CSO 64;
BA_ "FlexKomSID" SG_ 948 VC_AUTO_SS_CSO 2007;
BA_ "FlexKomIsMotorola" SG_ 948 VC_AUTO_SS_CSO 1;
BA_ "FlexKomComment" SG_ 948 VC_AUTO_SS_CSO "Vehicle configuration - customer settings menu 2 P";
BA_ "GenSigTimeout_IC" SG_ 948 VC_BSM_TRLR_CSO 21000;
BA_ "GenSigSNA" SG_ 948 VC_BSM_TRLR_CSO "0h";
BA_ "GenSigSendType" SG_ 948 VC_BSM_TRLR_CSO 5;
BA_ "GenSigCycleTime" SG_ 948 VC_BSM_TRLR_CSO 2000;
BA_ "FlexKomSigStartValue" SG_ 948 VC_BSM_TRLR_CSO "0300000000000000h";
BA_ "FlexKomSigStartPos" SG_ 948 VC_BSM_TRLR_CSO 7;
BA_ "FlexKomSigName" SG_ 948 VC_BSM_TRLR_CSO "VehCfgCSM2_Pkt";
BA_ "FlexKomSigLaenge" SG_ 948 VC_BSM_TRLR_CSO 64;
BA_ "FlexKomSID" SG_ 948 VC_BSM_TRLR_CSO 2007;
BA_ "FlexKomIsMotorola" SG_ 948 VC_BSM_TRLR_CSO 1;
BA_ "FlexKomComment" SG_ 948 VC_BSM_TRLR_CSO "Vehicle configuration - customer settings menu 2 P";
BA_ "GenSigSNA" SG_ 948 VC_DOORS_OFF_ACC_DLY_CSO "0h";
BA_ "GenSigSendType" SG_ 948 VC_DOORS_OFF_ACC_DLY_CSO 5;
BA_ "GenSigCycleTime" SG_ 948 VC_DOORS_OFF_ACC_DLY_CSO 2000;
BA_ "FlexKomSigStartValue" SG_ 948 VC_DOORS_OFF_ACC_DLY_CSO "0300000000000000h";
BA_ "FlexKomSigStartPos" SG_ 948 VC_DOORS_OFF_ACC_DLY_CSO 7;
BA_ "FlexKomSigName" SG_ 948 VC_DOORS_OFF_ACC_DLY_CSO "VehCfgCSM2_Pkt";
BA_ "FlexKomSigLaenge" SG_ 948 VC_DOORS_OFF_ACC_DLY_CSO 64;
BA_ "FlexKomSID" SG_ 948 VC_DOORS_OFF_ACC_DLY_CSO 2007;
BA_ "FlexKomIsMotorola" SG_ 948 VC_DOORS_OFF_ACC_DLY_CSO 1;
BA_ "FlexKomComment" SG_ 948 VC_DOORS_OFF_ACC_DLY_CSO "Vehicle configuration - customer settings menu 2 P";
BA_ "GenSigTimeout_IC" SG_ 948 VC_EPB_ON_CSO 21000;
BA_ "GenSigSNA" SG_ 948 VC_EPB_ON_CSO "0h";
BA_ "GenSigSendType" SG_ 948 VC_EPB_ON_CSO 5;
BA_ "GenSigCycleTime" SG_ 948 VC_EPB_ON_CSO 2000;
BA_ "FlexKomSigStartValue" SG_ 948 VC_EPB_ON_CSO "0300000000000000h";
BA_ "FlexKomSigStartPos" SG_ 948 VC_EPB_ON_CSO 7;
BA_ "FlexKomSigName" SG_ 948 VC_EPB_ON_CSO "VehCfgCSM2_Pkt";
BA_ "FlexKomSigLaenge" SG_ 948 VC_EPB_ON_CSO 64;
BA_ "FlexKomSID" SG_ 948 VC_EPB_ON_CSO 2007;
BA_ "FlexKomIsMotorola" SG_ 948 VC_EPB_ON_CSO 1;
BA_ "FlexKomComment" SG_ 948 VC_EPB_ON_CSO "Vehicle configuration - customer settings menu 2 P";
BA_ "GenSigTimeout_IC" SG_ 948 VC_FCW_SW_CSO 21000;
BA_ "GenSigSNA" SG_ 948 VC_FCW_SW_CSO "0h";
BA_ "GenSigSendType" SG_ 948 VC_FCW_SW_CSO 5;
BA_ "GenSigCycleTime" SG_ 948 VC_FCW_SW_CSO 2000;
BA_ "FlexKomSigStartValue" SG_ 948 VC_FCW_SW_CSO "0300000000000000h";
BA_ "FlexKomSigStartPos" SG_ 948 VC_FCW_SW_CSO 7;
BA_ "FlexKomSigName" SG_ 948 VC_FCW_SW_CSO "VehCfgCSM2_Pkt";
BA_ "FlexKomSigLaenge" SG_ 948 VC_FCW_SW_CSO 64;
BA_ "FlexKomSID" SG_ 948 VC_FCW_SW_CSO 2007;
BA_ "FlexKomIsMotorola" SG_ 948 VC_FCW_SW_CSO 1;
BA_ "FlexKomComment" SG_ 948 VC_FCW_SW_CSO "Vehicle configuration - customer settings menu 2 P";
BA_ "GenSigTimeout_IC" SG_ 948 VC_FCW_WARN_BRK_CSO 21000;
BA_ "GenSigSNA" SG_ 948 VC_FCW_WARN_BRK_CSO "0h";
BA_ "GenSigSendType" SG_ 948 VC_FCW_WARN_BRK_CSO 5;
BA_ "GenSigCycleTime" SG_ 948 VC_FCW_WARN_BRK_CSO 2000;
BA_ "FlexKomSigStartValue" SG_ 948 VC_FCW_WARN_BRK_CSO "0300000000000000h";
BA_ "FlexKomSigStartPos" SG_ 948 VC_FCW_WARN_BRK_CSO 7;
BA_ "FlexKomSigName" SG_ 948 VC_FCW_WARN_BRK_CSO "VehCfgCSM2_Pkt";
BA_ "FlexKomSigLaenge" SG_ 948 VC_FCW_WARN_BRK_CSO 64;
BA_ "FlexKomSID" SG_ 948 VC_FCW_WARN_BRK_CSO 2007;
BA_ "FlexKomIsMotorola" SG_ 948 VC_FCW_WARN_BRK_CSO 1;
BA_ "FlexKomComment" SG_ 948 VC_FCW_WARN_BRK_CSO "Vehicle configuration - customer settings menu 2 P";
BA_ "GenSigSNA" SG_ 948 VC_FLSH_LMP_SLDR_CSO "0h";
BA_ "GenSigSendType" SG_ 948 VC_FLSH_LMP_SLDR_CSO 5;
BA_ "GenSigCycleTime" SG_ 948 VC_FLSH_LMP_SLDR_CSO 2000;
BA_ "FlexKomSigStartValue" SG_ 948 VC_FLSH_LMP_SLDR_CSO "0300000000000000h";
BA_ "FlexKomSigStartPos" SG_ 948 VC_FLSH_LMP_SLDR_CSO 7;
BA_ "FlexKomSigName" SG_ 948 VC_FLSH_LMP_SLDR_CSO "VehCfgCSM2_Pkt";
BA_ "FlexKomSigLaenge" SG_ 948 VC_FLSH_LMP_SLDR_CSO 64;
BA_ "FlexKomSID" SG_ 948 VC_FLSH_LMP_SLDR_CSO 2007;
BA_ "FlexKomIsMotorola" SG_ 948 VC_FLSH_LMP_SLDR_CSO 1;
BA_ "FlexKomComment" SG_ 948 VC_FLSH_LMP_SLDR_CSO "Vehicle configuration - customer settings menu 2 P";
BA_ "GenSigTimeout_IC" SG_ 948 VC_FUEL_SAV_CSO 21000;
BA_ "GenSigSNA" SG_ 948 VC_FUEL_SAV_CSO "0h";
BA_ "GenSigSendType" SG_ 948 VC_FUEL_SAV_CSO 5;
BA_ "GenSigCycleTime" SG_ 948 VC_FUEL_SAV_CSO 2000;
BA_ "FlexKomSigStartValue" SG_ 948 VC_FUEL_SAV_CSO "0300000000000000h";
BA_ "FlexKomSigStartPos" SG_ 948 VC_FUEL_SAV_CSO 7;
BA_ "FlexKomSigName" SG_ 948 VC_FUEL_SAV_CSO "VehCfgCSM2_Pkt";
BA_ "FlexKomSigLaenge" SG_ 948 VC_FUEL_SAV_CSO 64;
BA_ "FlexKomSID" SG_ 948 VC_FUEL_SAV_CSO 2007;
BA_ "FlexKomIsMotorola" SG_ 948 VC_FUEL_SAV_CSO 1;
BA_ "FlexKomComment" SG_ 948 VC_FUEL_SAV_CSO "Vehicle configuration - customer settings menu 2 P";
BA_ "GenSigTimeout_IC" SG_ 948 VC_HANDS_FREE_LFT_CSO 21000;
BA_ "GenSigSNA" SG_ 948 VC_HANDS_FREE_LFT_CSO "0h";
BA_ "GenSigSendType" SG_ 948 VC_HANDS_FREE_LFT_CSO 5;
BA_ "GenSigCycleTime" SG_ 948 VC_HANDS_FREE_LFT_CSO 2000;
BA_ "FlexKomSigStartValue" SG_ 948 VC_HANDS_FREE_LFT_CSO "0300000000000000h";
BA_ "FlexKomSigStartPos" SG_ 948 VC_HANDS_FREE_LFT_CSO 7;
BA_ "FlexKomSigName" SG_ 948 VC_HANDS_FREE_LFT_CSO "VehCfgCSM2_Pkt";
BA_ "FlexKomSigLaenge" SG_ 948 VC_HANDS_FREE_LFT_CSO 64;
BA_ "FlexKomSID" SG_ 948 VC_HANDS_FREE_LFT_CSO 2007;
BA_ "FlexKomIsMotorola" SG_ 948 VC_HANDS_FREE_LFT_CSO 1;
BA_ "FlexKomComment" SG_ 948 VC_HANDS_FREE_LFT_CSO "Vehicle configuration - customer settings menu 2 P";
BA_ "GenSigTimeout_IC" SG_ 948 VC_HANDS_FREE_SLDR_CSO 21000;
BA_ "GenSigSNA" SG_ 948 VC_HANDS_FREE_SLDR_CSO "0h";
BA_ "GenSigSendType" SG_ 948 VC_HANDS_FREE_SLDR_CSO 5;
BA_ "GenSigCycleTime" SG_ 948 VC_HANDS_FREE_SLDR_CSO 2000;
BA_ "FlexKomSigStartValue" SG_ 948 VC_HANDS_FREE_SLDR_CSO "0300000000000000h";
BA_ "FlexKomSigStartPos" SG_ 948 VC_HANDS_FREE_SLDR_CSO 7;
BA_ "FlexKomSigName" SG_ 948 VC_HANDS_FREE_SLDR_CSO "VehCfgCSM2_Pkt";
BA_ "FlexKomSigLaenge" SG_ 948 VC_HANDS_FREE_SLDR_CSO 64;
BA_ "FlexKomSID" SG_ 948 VC_HANDS_FREE_SLDR_CSO 2007;
BA_ "FlexKomIsMotorola" SG_ 948 VC_HANDS_FREE_SLDR_CSO 1;
BA_ "FlexKomComment" SG_ 948 VC_HANDS_FREE_SLDR_CSO "Vehicle configuration - customer settings menu 2 P";
BA_ "GenSigTimeout_IC" SG_ 948 VC_HOLD_N_GO_CSO 21000;
BA_ "GenSigSNA" SG_ 948 VC_HOLD_N_GO_CSO "0h";
BA_ "GenSigSendType" SG_ 948 VC_HOLD_N_GO_CSO 5;
BA_ "GenSigCycleTime" SG_ 948 VC_HOLD_N_GO_CSO 2000;
BA_ "FlexKomSigStartValue" SG_ 948 VC_HOLD_N_GO_CSO "0300000000000000h";
BA_ "FlexKomSigStartPos" SG_ 948 VC_HOLD_N_GO_CSO 7;
BA_ "FlexKomSigName" SG_ 948 VC_HOLD_N_GO_CSO "VehCfgCSM2_Pkt";
BA_ "FlexKomSigLaenge" SG_ 948 VC_HOLD_N_GO_CSO 64;
BA_ "FlexKomSID" SG_ 948 VC_HOLD_N_GO_CSO 2007;
BA_ "FlexKomIsMotorola" SG_ 948 VC_HOLD_N_GO_CSO 1;
BA_ "FlexKomComment" SG_ 948 VC_HOLD_N_GO_CSO "Vehicle configuration - customer settings menu 2 P";
BA_ "GenSigTimeout_IC" SG_ 948 VC_LDW_ON_CSO 21000;
BA_ "GenSigSNA" SG_ 948 VC_LDW_ON_CSO "0h";
BA_ "GenSigSendType" SG_ 948 VC_LDW_ON_CSO 5;
BA_ "GenSigCycleTime" SG_ 948 VC_LDW_ON_CSO 2000;
BA_ "FlexKomSigStartValue" SG_ 948 VC_LDW_ON_CSO "0300000000000000h";
BA_ "FlexKomSigStartPos" SG_ 948 VC_LDW_ON_CSO 7;
BA_ "FlexKomSigName" SG_ 948 VC_LDW_ON_CSO "VehCfgCSM2_Pkt";
BA_ "FlexKomSigLaenge" SG_ 948 VC_LDW_ON_CSO 64;
BA_ "FlexKomSID" SG_ 948 VC_LDW_ON_CSO 2007;
BA_ "FlexKomIsMotorola" SG_ 948 VC_LDW_ON_CSO 1;
BA_ "FlexKomComment" SG_ 948 VC_LDW_ON_CSO "Vehicle configuration - customer settings menu 2 P";
BA_ "GenSigTimeout_IC" SG_ 948 VC_PADDLE_SHIFT_CSO 21000;
BA_ "GenSigSNA" SG_ 948 VC_PADDLE_SHIFT_CSO "0h";
BA_ "GenSigSendType" SG_ 948 VC_PADDLE_SHIFT_CSO 5;
BA_ "GenSigCycleTime" SG_ 948 VC_PADDLE_SHIFT_CSO 2000;
BA_ "FlexKomSigStartValue" SG_ 948 VC_PADDLE_SHIFT_CSO "0300000000000000h";
BA_ "FlexKomSigStartPos" SG_ 948 VC_PADDLE_SHIFT_CSO 7;
BA_ "FlexKomSigName" SG_ 948 VC_PADDLE_SHIFT_CSO "VehCfgCSM2_Pkt";
BA_ "FlexKomSigLaenge" SG_ 948 VC_PADDLE_SHIFT_CSO 64;
BA_ "FlexKomSID" SG_ 948 VC_PADDLE_SHIFT_CSO 2007;
BA_ "FlexKomIsMotorola" SG_ 948 VC_PADDLE_SHIFT_CSO 1;
BA_ "FlexKomComment" SG_ 948 VC_PADDLE_SHIFT_CSO "Vehicle configuration - customer settings menu 2 P";
BA_ "GenSigTimeout_IC" SG_ 948 VC_PCS_CSO 21000;
BA_ "GenSigSNA" SG_ 948 VC_PCS_CSO "0h";
BA_ "GenSigSendType" SG_ 948 VC_PCS_CSO 5;
BA_ "GenSigCycleTime" SG_ 948 VC_PCS_CSO 2000;
BA_ "FlexKomSigStartValue" SG_ 948 VC_PCS_CSO "0300000000000000h";
BA_ "FlexKomSigStartPos" SG_ 948 VC_PCS_CSO 7;
BA_ "FlexKomSigName" SG_ 948 VC_PCS_CSO "VehCfgCSM2_Pkt";
BA_ "FlexKomSigLaenge" SG_ 948 VC_PCS_CSO 64;
BA_ "FlexKomSID" SG_ 948 VC_PCS_CSO 2007;
BA_ "FlexKomIsMotorola" SG_ 948 VC_PCS_CSO 1;
BA_ "FlexKomComment" SG_ 948 VC_PCS_CSO "Vehicle configuration - customer settings menu 2 P";
BA_ "GenSigTimeout_IC" SG_ 948 VC_PRK_ASST_TYPE_CSO 21000;
BA_ "GenSigSNA" SG_ 948 VC_PRK_ASST_TYPE_CSO "0h";
BA_ "GenSigSendType" SG_ 948 VC_PRK_ASST_TYPE_CSO 5;
BA_ "GenSigCycleTime" SG_ 948 VC_PRK_ASST_TYPE_CSO 2000;
BA_ "FlexKomSigStartValue" SG_ 948 VC_PRK_ASST_TYPE_CSO "0300000000000000h";
BA_ "FlexKomSigStartPos" SG_ 948 VC_PRK_ASST_TYPE_CSO 7;
BA_ "FlexKomSigName" SG_ 948 VC_PRK_ASST_TYPE_CSO "VehCfgCSM2_Pkt";
BA_ "FlexKomSigLaenge" SG_ 948 VC_PRK_ASST_TYPE_CSO 64;
BA_ "FlexKomSID" SG_ 948 VC_PRK_ASST_TYPE_CSO 2007;
BA_ "FlexKomIsMotorola" SG_ 948 VC_PRK_ASST_TYPE_CSO 1;
BA_ "FlexKomComment" SG_ 948 VC_PRK_ASST_TYPE_CSO "Vehicle configuration - customer settings menu 2 P";
BA_ "GenSigTimeout_IC" SG_ 948 VC_PWR_FLD_MRR_CSO 21000;
BA_ "GenSigSNA" SG_ 948 VC_PWR_FLD_MRR_CSO "0h";
BA_ "GenSigSendType" SG_ 948 VC_PWR_FLD_MRR_CSO 5;
BA_ "GenSigCycleTime" SG_ 948 VC_PWR_FLD_MRR_CSO 2000;
BA_ "FlexKomSigStartValue" SG_ 948 VC_PWR_FLD_MRR_CSO "0300000000000000h";
BA_ "FlexKomSigStartPos" SG_ 948 VC_PWR_FLD_MRR_CSO 7;
BA_ "FlexKomSigName" SG_ 948 VC_PWR_FLD_MRR_CSO "VehCfgCSM2_Pkt";
BA_ "FlexKomSigLaenge" SG_ 948 VC_PWR_FLD_MRR_CSO 64;
BA_ "FlexKomSID" SG_ 948 VC_PWR_FLD_MRR_CSO 2007;
BA_ "FlexKomIsMotorola" SG_ 948 VC_PWR_FLD_MRR_CSO 1;
BA_ "FlexKomComment" SG_ 948 VC_PWR_FLD_MRR_CSO "Vehicle configuration - customer settings menu 2 P";
BA_ "GenSigTimeout_IC" SG_ 948 VC_RDY_DRV_CSO 21000;
BA_ "GenSigSNA" SG_ 948 VC_RDY_DRV_CSO "0h";
BA_ "GenSigSendType" SG_ 948 VC_RDY_DRV_CSO 5;
BA_ "GenSigCycleTime" SG_ 948 VC_RDY_DRV_CSO 2000;
BA_ "FlexKomSigStartValue" SG_ 948 VC_RDY_DRV_CSO "0300000000000000h";
BA_ "FlexKomSigStartPos" SG_ 948 VC_RDY_DRV_CSO 7;
BA_ "FlexKomSigName" SG_ 948 VC_RDY_DRV_CSO "VehCfgCSM2_Pkt";
BA_ "FlexKomSigLaenge" SG_ 948 VC_RDY_DRV_CSO 64;
BA_ "FlexKomSID" SG_ 948 VC_RDY_DRV_CSO 2007;
BA_ "FlexKomIsMotorola" SG_ 948 VC_RDY_DRV_CSO 1;
BA_ "FlexKomComment" SG_ 948 VC_RDY_DRV_CSO "Vehicle configuration - customer settings menu 2 P";
BA_ "GenSigTimeout_IC" SG_ 948 VC_REAR_CMRA_DLY_CSO 21000;
BA_ "GenSigSNA" SG_ 948 VC_REAR_CMRA_DLY_CSO "0h";
BA_ "GenSigSendType" SG_ 948 VC_REAR_CMRA_DLY_CSO 5;
BA_ "GenSigCycleTime" SG_ 948 VC_REAR_CMRA_DLY_CSO 2000;
BA_ "FlexKomSigStartValue" SG_ 948 VC_REAR_CMRA_DLY_CSO "0300000000000000h";
BA_ "FlexKomSigStartPos" SG_ 948 VC_REAR_CMRA_DLY_CSO 7;
BA_ "FlexKomSigName" SG_ 948 VC_REAR_CMRA_DLY_CSO "VehCfgCSM2_Pkt";
BA_ "FlexKomSigLaenge" SG_ 948 VC_REAR_CMRA_DLY_CSO 64;
BA_ "FlexKomSID" SG_ 948 VC_REAR_CMRA_DLY_CSO 2007;
BA_ "FlexKomIsMotorola" SG_ 948 VC_REAR_CMRA_DLY_CSO 1;
BA_ "FlexKomComment" SG_ 948 VC_REAR_CMRA_DLY_CSO "Vehicle configuration - customer settings menu 2 P";
BA_ "GenSigTimeout_IC" SG_ 948 VC_RKE_MEM_CSO 21000;
BA_ "GenSigSNA" SG_ 948 VC_RKE_MEM_CSO "0h";
BA_ "GenSigSendType" SG_ 948 VC_RKE_MEM_CSO 5;
BA_ "GenSigCycleTime" SG_ 948 VC_RKE_MEM_CSO 2000;
BA_ "FlexKomSigStartValue" SG_ 948 VC_RKE_MEM_CSO "0300000000000000h";
BA_ "FlexKomSigStartPos" SG_ 948 VC_RKE_MEM_CSO 7;
BA_ "FlexKomSigName" SG_ 948 VC_RKE_MEM_CSO "VehCfgCSM2_Pkt";
BA_ "FlexKomSigLaenge" SG_ 948 VC_RKE_MEM_CSO 64;
BA_ "FlexKomSID" SG_ 948 VC_RKE_MEM_CSO 2007;
BA_ "FlexKomIsMotorola" SG_ 948 VC_RKE_MEM_CSO 1;
BA_ "FlexKomComment" SG_ 948 VC_RKE_MEM_CSO "Vehicle configuration - customer settings menu 2 P";
BA_ "GenSigTimeout_IC" SG_ 948 VC_RKE_UNLK_CSO 21000;
BA_ "GenSigSNA" SG_ 948 VC_RKE_UNLK_CSO "0h";
BA_ "GenSigSendType" SG_ 948 VC_RKE_UNLK_CSO 5;
BA_ "GenSigCycleTime" SG_ 948 VC_RKE_UNLK_CSO 2000;
BA_ "FlexKomSigStartValue" SG_ 948 VC_RKE_UNLK_CSO "0300000000000000h";
BA_ "FlexKomSigStartPos" SG_ 948 VC_RKE_UNLK_CSO 7;
BA_ "FlexKomSigName" SG_ 948 VC_RKE_UNLK_CSO "VehCfgCSM2_Pkt";
BA_ "FlexKomSigLaenge" SG_ 948 VC_RKE_UNLK_CSO 64;
BA_ "FlexKomSID" SG_ 948 VC_RKE_UNLK_CSO 2007;
BA_ "FlexKomIsMotorola" SG_ 948 VC_RKE_UNLK_CSO 1;
BA_ "FlexKomComment" SG_ 948 VC_RKE_UNLK_CSO "Vehicle configuration - customer settings menu 2 P";
BA_ "GenSigTimeout_IC" SG_ 948 VC_SLD_DR_ALRT_CSO 21000;
BA_ "GenSigSNA" SG_ 948 VC_SLD_DR_ALRT_CSO "0h";
BA_ "GenSigSendType" SG_ 948 VC_SLD_DR_ALRT_CSO 5;
BA_ "GenSigCycleTime" SG_ 948 VC_SLD_DR_ALRT_CSO 2000;
BA_ "FlexKomSigStartValue" SG_ 948 VC_SLD_DR_ALRT_CSO "0300000000000000h";
BA_ "FlexKomSigStartPos" SG_ 948 VC_SLD_DR_ALRT_CSO 7;
BA_ "FlexKomSigName" SG_ 948 VC_SLD_DR_ALRT_CSO "VehCfgCSM2_Pkt";
BA_ "FlexKomSigLaenge" SG_ 948 VC_SLD_DR_ALRT_CSO 64;
BA_ "FlexKomSID" SG_ 948 VC_SLD_DR_ALRT_CSO 2007;
BA_ "FlexKomIsMotorola" SG_ 948 VC_SLD_DR_ALRT_CSO 1;
BA_ "FlexKomComment" SG_ 948 VC_SLD_DR_ALRT_CSO "Vehicle configuration - customer settings menu 2 P";
BA_ "GenSigTimeout_IC" SG_ 948 VC_SLD_DR_CHM_CSO 21000;
BA_ "GenSigSNA" SG_ 948 VC_SLD_DR_CHM_CSO "0h";
BA_ "GenSigSendType" SG_ 948 VC_SLD_DR_CHM_CSO 5;
BA_ "GenSigCycleTime" SG_ 948 VC_SLD_DR_CHM_CSO 2000;
BA_ "FlexKomSigStartValue" SG_ 948 VC_SLD_DR_CHM_CSO "0300000000000000h";
BA_ "FlexKomSigStartPos" SG_ 948 VC_SLD_DR_CHM_CSO 7;
BA_ "FlexKomSigName" SG_ 948 VC_SLD_DR_CHM_CSO "VehCfgCSM2_Pkt";
BA_ "FlexKomSigLaenge" SG_ 948 VC_SLD_DR_CHM_CSO 64;
BA_ "FlexKomSID" SG_ 948 VC_SLD_DR_CHM_CSO 2007;
BA_ "FlexKomIsMotorola" SG_ 948 VC_SLD_DR_CHM_CSO 1;
BA_ "FlexKomComment" SG_ 948 VC_SLD_DR_CHM_CSO "Vehicle configuration - customer settings menu 2 P";
BA_ "GenSigTimeout_IC" SG_ 948 VC_SPEED_CSO 21000;
BA_ "GenSigSNA" SG_ 948 VC_SPEED_CSO "0h";
BA_ "GenSigSendType" SG_ 948 VC_SPEED_CSO 5;
BA_ "GenSigCycleTime" SG_ 948 VC_SPEED_CSO 2000;
BA_ "FlexKomSigStartValue" SG_ 948 VC_SPEED_CSO "0300000000000000h";
BA_ "FlexKomSigStartPos" SG_ 948 VC_SPEED_CSO 7;
BA_ "FlexKomSigName" SG_ 948 VC_SPEED_CSO "VehCfgCSM2_Pkt";
BA_ "FlexKomSigLaenge" SG_ 948 VC_SPEED_CSO 64;
BA_ "FlexKomSID" SG_ 948 VC_SPEED_CSO 2007;
BA_ "FlexKomIsMotorola" SG_ 948 VC_SPEED_CSO 1;
BA_ "FlexKomComment" SG_ 948 VC_SPEED_CSO "Vehicle configuration - customer settings menu 2 P";
BA_ "GenSigTimeout_IC" SG_ 948 VC_SPEED_WARNING_CSO 21000;
BA_ "GenSigSNA" SG_ 948 VC_SPEED_WARNING_CSO "0h";
BA_ "GenSigSendType" SG_ 948 VC_SPEED_WARNING_CSO 5;
BA_ "GenSigCycleTime" SG_ 948 VC_SPEED_WARNING_CSO 2000;
BA_ "FlexKomSigStartValue" SG_ 948 VC_SPEED_WARNING_CSO "0300000000000000h";
BA_ "FlexKomSigStartPos" SG_ 948 VC_SPEED_WARNING_CSO 7;
BA_ "FlexKomSigName" SG_ 948 VC_SPEED_WARNING_CSO "VehCfgCSM2_Pkt";
BA_ "FlexKomSigLaenge" SG_ 948 VC_SPEED_WARNING_CSO 64;
BA_ "FlexKomSID" SG_ 948 VC_SPEED_WARNING_CSO 2007;
BA_ "FlexKomIsMotorola" SG_ 948 VC_SPEED_WARNING_CSO 1;
BA_ "FlexKomComment" SG_ 948 VC_SPEED_WARNING_CSO "Vehicle configuration - customer settings menu 2 P";
BA_ "GenSigTimeout_IC" SG_ 948 VC_SVC_DELAY_CSO 21000;
BA_ "GenSigSNA" SG_ 948 VC_SVC_DELAY_CSO "0h";
BA_ "GenSigSendType" SG_ 948 VC_SVC_DELAY_CSO 5;
BA_ "GenSigCycleTime" SG_ 948 VC_SVC_DELAY_CSO 2000;
BA_ "FlexKomSigStartValue" SG_ 948 VC_SVC_DELAY_CSO "0300000000000000h";
BA_ "FlexKomSigStartPos" SG_ 948 VC_SVC_DELAY_CSO 7;
BA_ "FlexKomSigName" SG_ 948 VC_SVC_DELAY_CSO "VehCfgCSM2_Pkt";
BA_ "FlexKomSigLaenge" SG_ 948 VC_SVC_DELAY_CSO 64;
BA_ "FlexKomSID" SG_ 948 VC_SVC_DELAY_CSO 2007;
BA_ "FlexKomIsMotorola" SG_ 948 VC_SVC_DELAY_CSO 1;
BA_ "FlexKomComment" SG_ 948 VC_SVC_DELAY_CSO "Vehicle configuration - customer settings menu 2 P";
BA_ "GenSigTimeout_IC" SG_ 948 VC_SVC_GRIDLINES_CSO 21000;
BA_ "GenSigSNA" SG_ 948 VC_SVC_GRIDLINES_CSO "0h";
BA_ "GenSigSendType" SG_ 948 VC_SVC_GRIDLINES_CSO 5;
BA_ "GenSigCycleTime" SG_ 948 VC_SVC_GRIDLINES_CSO 2000;
BA_ "FlexKomSigStartValue" SG_ 948 VC_SVC_GRIDLINES_CSO "0300000000000000h";
BA_ "FlexKomSigStartPos" SG_ 948 VC_SVC_GRIDLINES_CSO 7;
BA_ "FlexKomSigName" SG_ 948 VC_SVC_GRIDLINES_CSO "VehCfgCSM2_Pkt";
BA_ "FlexKomSigLaenge" SG_ 948 VC_SVC_GRIDLINES_CSO 64;
BA_ "FlexKomSID" SG_ 948 VC_SVC_GRIDLINES_CSO 2007;
BA_ "FlexKomIsMotorola" SG_ 948 VC_SVC_GRIDLINES_CSO 1;
BA_ "FlexKomComment" SG_ 948 VC_SVC_GRIDLINES_CSO "Vehicle configuration - customer settings menu 2 P";
BA_ "GenSigTimeout_IC" SG_ 948 VC_TEEN_AUTO_HB_CSO 21000;
BA_ "GenSigSNA" SG_ 948 VC_TEEN_AUTO_HB_CSO "0h";
BA_ "GenSigSendType" SG_ 948 VC_TEEN_AUTO_HB_CSO 5;
BA_ "GenSigCycleTime" SG_ 948 VC_TEEN_AUTO_HB_CSO 2000;
BA_ "FlexKomSigStartValue" SG_ 948 VC_TEEN_AUTO_HB_CSO "0300000000000000h";
BA_ "FlexKomSigStartPos" SG_ 948 VC_TEEN_AUTO_HB_CSO 7;
BA_ "FlexKomSigName" SG_ 948 VC_TEEN_AUTO_HB_CSO "VehCfgCSM2_Pkt";
BA_ "FlexKomSigLaenge" SG_ 948 VC_TEEN_AUTO_HB_CSO 64;
BA_ "FlexKomSID" SG_ 948 VC_TEEN_AUTO_HB_CSO 2007;
BA_ "FlexKomIsMotorola" SG_ 948 VC_TEEN_AUTO_HB_CSO 1;
BA_ "FlexKomComment" SG_ 948 VC_TEEN_AUTO_HB_CSO "Vehicle configuration - customer settings menu 2 P";
BA_ "GenSigTimeout_IC" SG_ 948 VC_TEEN_BLIND_SPOT_CSO 21000;
BA_ "GenSigSNA" SG_ 948 VC_TEEN_BLIND_SPOT_CSO "0h";
BA_ "GenSigSendType" SG_ 948 VC_TEEN_BLIND_SPOT_CSO 5;
BA_ "GenSigCycleTime" SG_ 948 VC_TEEN_BLIND_SPOT_CSO 2000;
BA_ "FlexKomSigStartValue" SG_ 948 VC_TEEN_BLIND_SPOT_CSO "0300000000000000h";
BA_ "FlexKomSigStartPos" SG_ 948 VC_TEEN_BLIND_SPOT_CSO 7;
BA_ "FlexKomSigName" SG_ 948 VC_TEEN_BLIND_SPOT_CSO "VehCfgCSM2_Pkt";
BA_ "FlexKomSigLaenge" SG_ 948 VC_TEEN_BLIND_SPOT_CSO 64;
BA_ "FlexKomSID" SG_ 948 VC_TEEN_BLIND_SPOT_CSO 2007;
BA_ "FlexKomIsMotorola" SG_ 948 VC_TEEN_BLIND_SPOT_CSO 1;
BA_ "FlexKomComment" SG_ 948 VC_TEEN_BLIND_SPOT_CSO "Vehicle configuration - customer settings menu 2 P";
BA_ "GenSigTimeout_IC" SG_ 948 VC_TEEN_FCW_BRK_CSO 21000;
BA_ "GenSigSNA" SG_ 948 VC_TEEN_FCW_BRK_CSO "0h";
BA_ "GenSigSendType" SG_ 948 VC_TEEN_FCW_BRK_CSO 5;
BA_ "GenSigCycleTime" SG_ 948 VC_TEEN_FCW_BRK_CSO 2000;
BA_ "FlexKomSigStartValue" SG_ 948 VC_TEEN_FCW_BRK_CSO "0300000000000000h";
BA_ "FlexKomSigStartPos" SG_ 948 VC_TEEN_FCW_BRK_CSO 7;
BA_ "FlexKomSigName" SG_ 948 VC_TEEN_FCW_BRK_CSO "VehCfgCSM2_Pkt";
BA_ "FlexKomSigLaenge" SG_ 948 VC_TEEN_FCW_BRK_CSO 64;
BA_ "FlexKomSID" SG_ 948 VC_TEEN_FCW_BRK_CSO 2007;
BA_ "FlexKomIsMotorola" SG_ 948 VC_TEEN_FCW_BRK_CSO 1;
BA_ "FlexKomComment" SG_ 948 VC_TEEN_FCW_BRK_CSO "Vehicle configuration - customer settings menu 2 P";
BA_ "GenSigTimeout_IC" SG_ 948 VC_TEEN_FCW_SENS_CSO 21000;
BA_ "GenSigSNA" SG_ 948 VC_TEEN_FCW_SENS_CSO "0h";
BA_ "GenSigSendType" SG_ 948 VC_TEEN_FCW_SENS_CSO 5;
BA_ "GenSigCycleTime" SG_ 948 VC_TEEN_FCW_SENS_CSO 2000;
BA_ "FlexKomSigStartValue" SG_ 948 VC_TEEN_FCW_SENS_CSO "0300000000000000h";
BA_ "FlexKomSigStartPos" SG_ 948 VC_TEEN_FCW_SENS_CSO 7;
BA_ "FlexKomSigName" SG_ 948 VC_TEEN_FCW_SENS_CSO "VehCfgCSM2_Pkt";
BA_ "FlexKomSigLaenge" SG_ 948 VC_TEEN_FCW_SENS_CSO 64;
BA_ "FlexKomSID" SG_ 948 VC_TEEN_FCW_SENS_CSO 2007;
BA_ "FlexKomIsMotorola" SG_ 948 VC_TEEN_FCW_SENS_CSO 1;
BA_ "FlexKomComment" SG_ 948 VC_TEEN_FCW_SENS_CSO "Vehicle configuration - customer settings menu 2 P";
BA_ "GenSigTimeout_IC" SG_ 948 VC_TEEN_FT_PRK_VOL_CSO 21000;
BA_ "GenSigSNA" SG_ 948 VC_TEEN_FT_PRK_VOL_CSO "0h";
BA_ "GenSigSendType" SG_ 948 VC_TEEN_FT_PRK_VOL_CSO 5;
BA_ "GenSigCycleTime" SG_ 948 VC_TEEN_FT_PRK_VOL_CSO 2000;
BA_ "FlexKomSigStartValue" SG_ 948 VC_TEEN_FT_PRK_VOL_CSO "0300000000000000h";
BA_ "FlexKomSigStartPos" SG_ 948 VC_TEEN_FT_PRK_VOL_CSO 7;
BA_ "FlexKomSigName" SG_ 948 VC_TEEN_FT_PRK_VOL_CSO "VehCfgCSM2_Pkt";
BA_ "FlexKomSigLaenge" SG_ 948 VC_TEEN_FT_PRK_VOL_CSO 64;
BA_ "FlexKomSID" SG_ 948 VC_TEEN_FT_PRK_VOL_CSO 2007;
BA_ "FlexKomIsMotorola" SG_ 948 VC_TEEN_FT_PRK_VOL_CSO 1;
BA_ "FlexKomComment" SG_ 948 VC_TEEN_FT_PRK_VOL_CSO "Vehicle configuration - customer settings menu 2 P";
BA_ "GenSigTimeout_IC" SG_ 948 VC_TEEN_FUEL_POPUP_CSO 21000;
BA_ "GenSigSNA" SG_ 948 VC_TEEN_FUEL_POPUP_CSO "0h";
BA_ "GenSigSendType" SG_ 948 VC_TEEN_FUEL_POPUP_CSO 5;
BA_ "GenSigCycleTime" SG_ 948 VC_TEEN_FUEL_POPUP_CSO 2000;
BA_ "FlexKomSigStartValue" SG_ 948 VC_TEEN_FUEL_POPUP_CSO "0300000000000000h";
BA_ "FlexKomSigStartPos" SG_ 948 VC_TEEN_FUEL_POPUP_CSO 7;
BA_ "FlexKomSigName" SG_ 948 VC_TEEN_FUEL_POPUP_CSO "VehCfgCSM2_Pkt";
BA_ "FlexKomSigLaenge" SG_ 948 VC_TEEN_FUEL_POPUP_CSO 64;
BA_ "FlexKomSID" SG_ 948 VC_TEEN_FUEL_POPUP_CSO 2007;
BA_ "FlexKomIsMotorola" SG_ 948 VC_TEEN_FUEL_POPUP_CSO 1;
BA_ "FlexKomComment" SG_ 948 VC_TEEN_FUEL_POPUP_CSO "Vehicle configuration - customer settings menu 2 P";
BA_ "GenSigTimeout_IC" SG_ 948 VC_TEEN_FUEL_WRN_CSO 21000;
BA_ "GenSigSNA" SG_ 948 VC_TEEN_FUEL_WRN_CSO "0h";
BA_ "GenSigSendType" SG_ 948 VC_TEEN_FUEL_WRN_CSO 5;
BA_ "GenSigCycleTime" SG_ 948 VC_TEEN_FUEL_WRN_CSO 2000;
BA_ "FlexKomSigStartValue" SG_ 948 VC_TEEN_FUEL_WRN_CSO "0300000000000000h";
BA_ "FlexKomSigStartPos" SG_ 948 VC_TEEN_FUEL_WRN_CSO 7;
BA_ "FlexKomSigName" SG_ 948 VC_TEEN_FUEL_WRN_CSO "VehCfgCSM2_Pkt";
BA_ "FlexKomSigLaenge" SG_ 948 VC_TEEN_FUEL_WRN_CSO 64;
BA_ "FlexKomSID" SG_ 948 VC_TEEN_FUEL_WRN_CSO 2007;
BA_ "FlexKomIsMotorola" SG_ 948 VC_TEEN_FUEL_WRN_CSO 1;
BA_ "FlexKomComment" SG_ 948 VC_TEEN_FUEL_WRN_CSO "Vehicle configuration - customer settings menu 2 P";
BA_ "GenSigTimeout_IC" SG_ 948 VC_TEEN_LGHT_WPR_CSO 21000;
BA_ "GenSigSNA" SG_ 948 VC_TEEN_LGHT_WPR_CSO "0h";
BA_ "GenSigSendType" SG_ 948 VC_TEEN_LGHT_WPR_CSO 5;
BA_ "GenSigCycleTime" SG_ 948 VC_TEEN_LGHT_WPR_CSO 2000;
BA_ "FlexKomSigStartValue" SG_ 948 VC_TEEN_LGHT_WPR_CSO "0300000000000000h";
BA_ "FlexKomSigStartPos" SG_ 948 VC_TEEN_LGHT_WPR_CSO 7;
BA_ "FlexKomSigName" SG_ 948 VC_TEEN_LGHT_WPR_CSO "VehCfgCSM2_Pkt";
BA_ "FlexKomSigLaenge" SG_ 948 VC_TEEN_LGHT_WPR_CSO 64;
BA_ "FlexKomSID" SG_ 948 VC_TEEN_LGHT_WPR_CSO 2007;
BA_ "FlexKomIsMotorola" SG_ 948 VC_TEEN_LGHT_WPR_CSO 1;
BA_ "FlexKomComment" SG_ 948 VC_TEEN_LGHT_WPR_CSO "Vehicle configuration - customer settings menu 2 P";
BA_ "GenSigTimeout_IC" SG_ 948 VC_TEEN_MAX_SPEED_CSO 21000;
BA_ "GenSigSNA" SG_ 948 VC_TEEN_MAX_SPEED_CSO "0h";
BA_ "GenSigSendType" SG_ 948 VC_TEEN_MAX_SPEED_CSO 5;
BA_ "GenSigCycleTime" SG_ 948 VC_TEEN_MAX_SPEED_CSO 2000;
BA_ "FlexKomSigStartValue" SG_ 948 VC_TEEN_MAX_SPEED_CSO "0300000000000000h";
BA_ "FlexKomSigStartPos" SG_ 948 VC_TEEN_MAX_SPEED_CSO 7;
BA_ "FlexKomSigName" SG_ 948 VC_TEEN_MAX_SPEED_CSO "VehCfgCSM2_Pkt";
BA_ "FlexKomSigLaenge" SG_ 948 VC_TEEN_MAX_SPEED_CSO 64;
BA_ "FlexKomSID" SG_ 948 VC_TEEN_MAX_SPEED_CSO 2007;
BA_ "FlexKomIsMotorola" SG_ 948 VC_TEEN_MAX_SPEED_CSO 1;
BA_ "FlexKomComment" SG_ 948 VC_TEEN_MAX_SPEED_CSO "Vehicle configuration - customer settings menu 2 P";
BA_ "GenSigTimeout_IC" SG_ 948 VC_TEEN_PLG_CHIME_CSO 21000;
BA_ "GenSigSNA" SG_ 948 VC_TEEN_PLG_CHIME_CSO "0h";
BA_ "GenSigSendType" SG_ 948 VC_TEEN_PLG_CHIME_CSO 5;
BA_ "GenSigCycleTime" SG_ 948 VC_TEEN_PLG_CHIME_CSO 2000;
BA_ "FlexKomSigStartValue" SG_ 948 VC_TEEN_PLG_CHIME_CSO "0300000000000000h";
BA_ "FlexKomSigStartPos" SG_ 948 VC_TEEN_PLG_CHIME_CSO 7;
BA_ "FlexKomSigName" SG_ 948 VC_TEEN_PLG_CHIME_CSO "VehCfgCSM2_Pkt";
BA_ "FlexKomSigLaenge" SG_ 948 VC_TEEN_PLG_CHIME_CSO 64;
BA_ "FlexKomSID" SG_ 948 VC_TEEN_PLG_CHIME_CSO 2007;
BA_ "FlexKomIsMotorola" SG_ 948 VC_TEEN_PLG_CHIME_CSO 1;
BA_ "FlexKomComment" SG_ 948 VC_TEEN_PLG_CHIME_CSO "Vehicle configuration - customer settings menu 2 P";
BA_ "GenSigTimeout_IC" SG_ 948 VC_TEEN_PRK_ASST_BRK_CSO 21000;
BA_ "GenSigSNA" SG_ 948 VC_TEEN_PRK_ASST_BRK_CSO "0h";
BA_ "GenSigSendType" SG_ 948 VC_TEEN_PRK_ASST_BRK_CSO 5;
BA_ "GenSigCycleTime" SG_ 948 VC_TEEN_PRK_ASST_BRK_CSO 2000;
BA_ "FlexKomSigStartValue" SG_ 948 VC_TEEN_PRK_ASST_BRK_CSO "0300000000000000h";
BA_ "FlexKomSigStartPos" SG_ 948 VC_TEEN_PRK_ASST_BRK_CSO 7;
BA_ "FlexKomSigName" SG_ 948 VC_TEEN_PRK_ASST_BRK_CSO "VehCfgCSM2_Pkt";
BA_ "FlexKomSigLaenge" SG_ 948 VC_TEEN_PRK_ASST_BRK_CSO 64;
BA_ "FlexKomSID" SG_ 948 VC_TEEN_PRK_ASST_BRK_CSO 2007;
BA_ "FlexKomIsMotorola" SG_ 948 VC_TEEN_PRK_ASST_BRK_CSO 1;
BA_ "FlexKomComment" SG_ 948 VC_TEEN_PRK_ASST_BRK_CSO "Vehicle configuration - customer settings menu 2 P";
BA_ "GenSigTimeout_IC" SG_ 948 VC_TEEN_PRK_ASST_CSO 21000;
BA_ "GenSigSNA" SG_ 948 VC_TEEN_PRK_ASST_CSO "0h";
BA_ "GenSigSendType" SG_ 948 VC_TEEN_PRK_ASST_CSO 5;
BA_ "GenSigCycleTime" SG_ 948 VC_TEEN_PRK_ASST_CSO 2000;
BA_ "FlexKomSigStartValue" SG_ 948 VC_TEEN_PRK_ASST_CSO "0300000000000000h";
BA_ "FlexKomSigStartPos" SG_ 948 VC_TEEN_PRK_ASST_CSO 7;
BA_ "FlexKomSigName" SG_ 948 VC_TEEN_PRK_ASST_CSO "VehCfgCSM2_Pkt";
BA_ "FlexKomSigLaenge" SG_ 948 VC_TEEN_PRK_ASST_CSO 64;
BA_ "FlexKomSID" SG_ 948 VC_TEEN_PRK_ASST_CSO 2007;
BA_ "FlexKomIsMotorola" SG_ 948 VC_TEEN_PRK_ASST_CSO 1;
BA_ "FlexKomComment" SG_ 948 VC_TEEN_PRK_ASST_CSO "Vehicle configuration - customer settings menu 2 P";
BA_ "GenSigTimeout_IC" SG_ 948 VC_TEEN_RAIN_WPR_CSO 21000;
BA_ "GenSigSNA" SG_ 948 VC_TEEN_RAIN_WPR_CSO "0h";
BA_ "GenSigSendType" SG_ 948 VC_TEEN_RAIN_WPR_CSO 5;
BA_ "GenSigCycleTime" SG_ 948 VC_TEEN_RAIN_WPR_CSO 2000;
BA_ "FlexKomSigStartValue" SG_ 948 VC_TEEN_RAIN_WPR_CSO "0300000000000000h";
BA_ "FlexKomSigStartPos" SG_ 948 VC_TEEN_RAIN_WPR_CSO 7;
BA_ "FlexKomSigName" SG_ 948 VC_TEEN_RAIN_WPR_CSO "VehCfgCSM2_Pkt";
BA_ "FlexKomSigLaenge" SG_ 948 VC_TEEN_RAIN_WPR_CSO 64;
BA_ "FlexKomSID" SG_ 948 VC_TEEN_RAIN_WPR_CSO 2007;
BA_ "FlexKomIsMotorola" SG_ 948 VC_TEEN_RAIN_WPR_CSO 1;
BA_ "FlexKomComment" SG_ 948 VC_TEEN_RAIN_WPR_CSO "Vehicle configuration - customer settings menu 2 P";
BA_ "GenSigTimeout_IC" SG_ 948 VC_TEEN_RR_PRK_VOL_CSO 21000;
BA_ "GenSigSNA" SG_ 948 VC_TEEN_RR_PRK_VOL_CSO "0h";
BA_ "GenSigSendType" SG_ 948 VC_TEEN_RR_PRK_VOL_CSO 5;
BA_ "GenSigCycleTime" SG_ 948 VC_TEEN_RR_PRK_VOL_CSO 2000;
BA_ "FlexKomSigStartValue" SG_ 948 VC_TEEN_RR_PRK_VOL_CSO "0300000000000000h";
BA_ "FlexKomSigStartPos" SG_ 948 VC_TEEN_RR_PRK_VOL_CSO 7;
BA_ "FlexKomSigName" SG_ 948 VC_TEEN_RR_PRK_VOL_CSO "VehCfgCSM2_Pkt";
BA_ "FlexKomSigLaenge" SG_ 948 VC_TEEN_RR_PRK_VOL_CSO 64;
BA_ "FlexKomSID" SG_ 948 VC_TEEN_RR_PRK_VOL_CSO 2007;
BA_ "FlexKomIsMotorola" SG_ 948 VC_TEEN_RR_PRK_VOL_CSO 1;
BA_ "FlexKomComment" SG_ 948 VC_TEEN_RR_PRK_VOL_CSO "Vehicle configuration - customer settings menu 2 P";
BA_ "GenSigTimeout_IC" SG_ 948 VC_TEEN_SLD_DR_ALRT_CSO 21000;
BA_ "GenSigSNA" SG_ 948 VC_TEEN_SLD_DR_ALRT_CSO "0h";
BA_ "GenSigSendType" SG_ 948 VC_TEEN_SLD_DR_ALRT_CSO 5;
BA_ "GenSigCycleTime" SG_ 948 VC_TEEN_SLD_DR_ALRT_CSO 2000;
BA_ "FlexKomSigStartValue" SG_ 948 VC_TEEN_SLD_DR_ALRT_CSO "0300000000000000h";
BA_ "FlexKomSigStartPos" SG_ 948 VC_TEEN_SLD_DR_ALRT_CSO 7;
BA_ "FlexKomSigName" SG_ 948 VC_TEEN_SLD_DR_ALRT_CSO "VehCfgCSM2_Pkt";
BA_ "FlexKomSigLaenge" SG_ 948 VC_TEEN_SLD_DR_ALRT_CSO 64;
BA_ "FlexKomSID" SG_ 948 VC_TEEN_SLD_DR_ALRT_CSO 2007;
BA_ "FlexKomIsMotorola" SG_ 948 VC_TEEN_SLD_DR_ALRT_CSO 1;
BA_ "FlexKomComment" SG_ 948 VC_TEEN_SLD_DR_ALRT_CSO "Vehicle configuration - customer settings menu 2 P";
BA_ "GenSigTimeout_IC" SG_ 948 VC_TEEN_SLD_DR_CHM_CSO 21000;
BA_ "GenSigSNA" SG_ 948 VC_TEEN_SLD_DR_CHM_CSO "0h";
BA_ "GenSigSendType" SG_ 948 VC_TEEN_SLD_DR_CHM_CSO 5;
BA_ "GenSigCycleTime" SG_ 948 VC_TEEN_SLD_DR_CHM_CSO 2000;
BA_ "FlexKomSigStartValue" SG_ 948 VC_TEEN_SLD_DR_CHM_CSO "0300000000000000h";
BA_ "FlexKomSigStartPos" SG_ 948 VC_TEEN_SLD_DR_CHM_CSO 7;
BA_ "FlexKomSigName" SG_ 948 VC_TEEN_SLD_DR_CHM_CSO "VehCfgCSM2_Pkt";
BA_ "FlexKomSigLaenge" SG_ 948 VC_TEEN_SLD_DR_CHM_CSO 64;
BA_ "FlexKomSID" SG_ 948 VC_TEEN_SLD_DR_CHM_CSO 2007;
BA_ "FlexKomIsMotorola" SG_ 948 VC_TEEN_SLD_DR_CHM_CSO 1;
BA_ "FlexKomComment" SG_ 948 VC_TEEN_SLD_DR_CHM_CSO "Vehicle configuration - customer settings menu 2 P";
BA_ "GenSigSNA" SG_ 948 VC_TEMP_CSO "0h";
BA_ "GenSigSendType" SG_ 948 VC_TEMP_CSO 5;
BA_ "GenSigCycleTime" SG_ 948 VC_TEMP_CSO 2000;
BA_ "FlexKomSigStartValue" SG_ 948 VC_TEMP_CSO "0300000000000000h";
BA_ "FlexKomSigStartPos" SG_ 948 VC_TEMP_CSO 7;
BA_ "FlexKomSigName" SG_ 948 VC_TEMP_CSO "VehCfgCSM2_Pkt";
BA_ "FlexKomSigLaenge" SG_ 948 VC_TEMP_CSO 64;
BA_ "FlexKomSID" SG_ 948 VC_TEMP_CSO 2007;
BA_ "FlexKomIsMotorola" SG_ 948 VC_TEMP_CSO 1;
BA_ "FlexKomComment" SG_ 948 VC_TEMP_CSO "Vehicle configuration - customer settings menu 2 P";
BA_ "GenSigTimeout_IC" SG_ 948 VC_TLT_MRR_CSO 21000;
BA_ "GenSigSNA" SG_ 948 VC_TLT_MRR_CSO "0h";
BA_ "GenSigSendType" SG_ 948 VC_TLT_MRR_CSO 5;
BA_ "GenSigCycleTime" SG_ 948 VC_TLT_MRR_CSO 2000;
BA_ "FlexKomSigStartValue" SG_ 948 VC_TLT_MRR_CSO "0300000000000000h";
BA_ "FlexKomSigStartPos" SG_ 948 VC_TLT_MRR_CSO 7;
BA_ "FlexKomSigName" SG_ 948 VC_TLT_MRR_CSO "VehCfgCSM2_Pkt";
BA_ "FlexKomSigLaenge" SG_ 948 VC_TLT_MRR_CSO 64;
BA_ "FlexKomSID" SG_ 948 VC_TLT_MRR_CSO 2007;
BA_ "FlexKomIsMotorola" SG_ 948 VC_TLT_MRR_CSO 1;
BA_ "FlexKomComment" SG_ 948 VC_TLT_MRR_CSO "Vehicle configuration - customer settings menu 2 P";
BA_ "GenSigTimeout_IC" SG_ 948 VC_TORQUE_CSO 21000;
BA_ "GenSigSNA" SG_ 948 VC_TORQUE_CSO "0h";
BA_ "GenSigSendType" SG_ 948 VC_TORQUE_CSO 5;
BA_ "GenSigCycleTime" SG_ 948 VC_TORQUE_CSO 2000;
BA_ "FlexKomSigStartValue" SG_ 948 VC_TORQUE_CSO "0300000000000000h";
BA_ "FlexKomSigStartPos" SG_ 948 VC_TORQUE_CSO 7;
BA_ "FlexKomSigName" SG_ 948 VC_TORQUE_CSO "VehCfgCSM2_Pkt";
BA_ "FlexKomSigLaenge" SG_ 948 VC_TORQUE_CSO 64;
BA_ "FlexKomSID" SG_ 948 VC_TORQUE_CSO 2007;
BA_ "FlexKomIsMotorola" SG_ 948 VC_TORQUE_CSO 1;
BA_ "FlexKomComment" SG_ 948 VC_TORQUE_CSO "Vehicle configuration - customer settings menu 2 P";
BA_ "GenSigTimeout_IC" SG_ 948 VC_TRLR_CSO 21000;
BA_ "GenSigSNA" SG_ 948 VC_TRLR_CSO "0h";
BA_ "GenSigSendType" SG_ 948 VC_TRLR_CSO 5;
BA_ "GenSigCycleTime" SG_ 948 VC_TRLR_CSO 2000;
BA_ "FlexKomSigStartValue" SG_ 948 VC_TRLR_CSO "0300000000000000h";
BA_ "FlexKomSigStartPos" SG_ 948 VC_TRLR_CSO 7;
BA_ "FlexKomSigName" SG_ 948 VC_TRLR_CSO "VehCfgCSM2_Pkt";
BA_ "FlexKomSigLaenge" SG_ 948 VC_TRLR_CSO 64;
BA_ "FlexKomSID" SG_ 948 VC_TRLR_CSO 2007;
BA_ "FlexKomIsMotorola" SG_ 948 VC_TRLR_CSO 1;
BA_ "FlexKomComment" SG_ 948 VC_TRLR_CSO "Vehicle configuration - customer settings menu 2 P";
BA_ "GenSigTimeout_IC" SG_ 948 VC_TRLR_NAME_CSO 21000;
BA_ "GenSigSNA" SG_ 948 VC_TRLR_NAME_CSO "0h";
BA_ "GenSigSendType" SG_ 948 VC_TRLR_NAME_CSO 5;
BA_ "GenSigCycleTime" SG_ 948 VC_TRLR_NAME_CSO 2000;
BA_ "FlexKomSigStartValue" SG_ 948 VC_TRLR_NAME_CSO "0300000000000000h";
BA_ "FlexKomSigStartPos" SG_ 948 VC_TRLR_NAME_CSO 7;
BA_ "FlexKomSigName" SG_ 948 VC_TRLR_NAME_CSO "VehCfgCSM2_Pkt";
BA_ "FlexKomSigLaenge" SG_ 948 VC_TRLR_NAME_CSO 64;
BA_ "FlexKomSID" SG_ 948 VC_TRLR_NAME_CSO 2007;
BA_ "FlexKomIsMotorola" SG_ 948 VC_TRLR_NAME_CSO 1;
BA_ "FlexKomComment" SG_ 948 VC_TRLR_NAME_CSO "Vehicle configuration - customer settings menu 2 P";
BA_ "GenSigTimeout_IC" SG_ 948 VC_TRLR_TYPE_CSO 21000;
BA_ "GenSigSNA" SG_ 948 VC_TRLR_TYPE_CSO "0h";
BA_ "GenSigSendType" SG_ 948 VC_TRLR_TYPE_CSO 5;
BA_ "GenSigCycleTime" SG_ 948 VC_TRLR_TYPE_CSO 2000;
BA_ "FlexKomSigStartValue" SG_ 948 VC_TRLR_TYPE_CSO "0300000000000000h";
BA_ "FlexKomSigStartPos" SG_ 948 VC_TRLR_TYPE_CSO 7;
BA_ "FlexKomSigName" SG_ 948 VC_TRLR_TYPE_CSO "VehCfgCSM2_Pkt";
BA_ "FlexKomSigLaenge" SG_ 948 VC_TRLR_TYPE_CSO 64;
BA_ "FlexKomSID" SG_ 948 VC_TRLR_TYPE_CSO 2007;
BA_ "FlexKomIsMotorola" SG_ 948 VC_TRLR_TYPE_CSO 1;
BA_ "FlexKomComment" SG_ 948 VC_TRLR_TYPE_CSO "Vehicle configuration - customer settings menu 2 P";
BA_ "GenSigTimeout_IC" SG_ 948 VC_TRNS_MD_CSO 21000;
BA_ "GenSigSNA" SG_ 948 VC_TRNS_MD_CSO "0h";
BA_ "GenSigSendType" SG_ 948 VC_TRNS_MD_CSO 5;
BA_ "GenSigCycleTime" SG_ 948 VC_TRNS_MD_CSO 2000;
BA_ "FlexKomSigStartValue" SG_ 948 VC_TRNS_MD_CSO "0300000000000000h";
BA_ "FlexKomSigStartPos" SG_ 948 VC_TRNS_MD_CSO 7;
BA_ "FlexKomSigName" SG_ 948 VC_TRNS_MD_CSO "VehCfgCSM2_Pkt";
BA_ "FlexKomSigLaenge" SG_ 948 VC_TRNS_MD_CSO 64;
BA_ "FlexKomSID" SG_ 948 VC_TRNS_MD_CSO 2007;
BA_ "FlexKomIsMotorola" SG_ 948 VC_TRNS_MD_CSO 1;
BA_ "FlexKomComment" SG_ 948 VC_TRNS_MD_CSO "Vehicle configuration - customer settings menu 2 P";
BA_ "GenSigTimeout_IC" SG_ 948 VC_US_METRIC_CSO 21000;
BA_ "GenSigSNA" SG_ 948 VC_US_METRIC_CSO "0h";
BA_ "GenSigSendType" SG_ 948 VC_US_METRIC_CSO 5;
BA_ "GenSigCycleTime" SG_ 948 VC_US_METRIC_CSO 2000;
BA_ "FlexKomSigStartValue" SG_ 948 VC_US_METRIC_CSO "0300000000000000h";
BA_ "FlexKomSigStartPos" SG_ 948 VC_US_METRIC_CSO 7;
BA_ "FlexKomSigName" SG_ 948 VC_US_METRIC_CSO "VehCfgCSM2_Pkt";
BA_ "FlexKomSigLaenge" SG_ 948 VC_US_METRIC_CSO 64;
BA_ "FlexKomSID" SG_ 948 VC_US_METRIC_CSO 2007;
BA_ "FlexKomIsMotorola" SG_ 948 VC_US_METRIC_CSO 1;
BA_ "FlexKomComment" SG_ 948 VC_US_METRIC_CSO "Vehicle configuration - customer settings menu 2 P";
BA_ "GenSigTimeout_IC" SG_ 948 VC_VehCfgCSO2_Stat 21000;
BA_ "GenSigStartValue" SG_ 948 VC_VehCfgCSO2_Stat 3;
BA_ "GenSigSNA" SG_ 948 VC_VehCfgCSO2_Stat "3h";
BA_ "GenSigSendType" SG_ 948 VC_VehCfgCSO2_Stat 5;
BA_ "GenSigCycleTime" SG_ 948 VC_VehCfgCSO2_Stat 2000;
BA_ "FlexKomSigStartValue" SG_ 948 VC_VehCfgCSO2_Stat "0300000000000000h";
BA_ "FlexKomSigStartPos" SG_ 948 VC_VehCfgCSO2_Stat 7;
BA_ "FlexKomSigName" SG_ 948 VC_VehCfgCSO2_Stat "VehCfgCSM2_Pkt";
BA_ "FlexKomSigLaenge" SG_ 948 VC_VehCfgCSO2_Stat 64;
BA_ "FlexKomSID" SG_ 948 VC_VehCfgCSO2_Stat 2007;
BA_ "FlexKomIsMotorola" SG_ 948 VC_VehCfgCSO2_Stat 1;
BA_ "FlexKomComment" SG_ 948 VC_VehCfgCSO2_Stat "Vehicle configuration - customer settings menu 2 P";
BA_ "GenSigTimeout_IC" SG_ 948 VC_WHL_ALGN_CSO 21000;
BA_ "GenSigSNA" SG_ 948 VC_WHL_ALGN_CSO "0h";
BA_ "GenSigSendType" SG_ 948 VC_WHL_ALGN_CSO 5;
BA_ "GenSigCycleTime" SG_ 948 VC_WHL_ALGN_CSO 2000;
BA_ "FlexKomSigStartValue" SG_ 948 VC_WHL_ALGN_CSO "0300000000000000h";
BA_ "FlexKomSigStartPos" SG_ 948 VC_WHL_ALGN_CSO 7;
BA_ "FlexKomSigName" SG_ 948 VC_WHL_ALGN_CSO "VehCfgCSM2_Pkt";
BA_ "FlexKomSigLaenge" SG_ 948 VC_WHL_ALGN_CSO 64;
BA_ "FlexKomSID" SG_ 948 VC_WHL_ALGN_CSO 2007;
BA_ "FlexKomIsMotorola" SG_ 948 VC_WHL_ALGN_CSO 1;
BA_ "FlexKomComment" SG_ 948 VC_WHL_ALGN_CSO "Vehicle configuration - customer settings menu 2 P";
BA_ "GenSigSNA" SG_ 950 VC_BU_AIRBAG_ON_CSO "0h";
BA_ "GenSigSendType" SG_ 950 VC_BU_AIRBAG_ON_CSO 1;
BA_ "FlexKomSigStartValue" SG_ 950 VC_BU_AIRBAG_ON_CSO "0300000000000000h";
BA_ "FlexKomSigStartPos" SG_ 950 VC_BU_AIRBAG_ON_CSO 7;
BA_ "FlexKomSigName" SG_ 950 VC_BU_AIRBAG_ON_CSO "VehCfgCSM2_BuPkt";
BA_ "FlexKomSigLaenge" SG_ 950 VC_BU_AIRBAG_ON_CSO 64;
BA_ "FlexKomSID" SG_ 950 VC_BU_AIRBAG_ON_CSO 2009;
BA_ "FlexKomIsMotorola" SG_ 950 VC_BU_AIRBAG_ON_CSO 1;
BA_ "FlexKomComment" SG_ 950 VC_BU_AIRBAG_ON_CSO "Backup for veh config - customer settings menu 2 p";
BA_ "GenSigSNA" SG_ 950 VC_BU_AUTO_SS_CSO "0h";
BA_ "GenSigSendType" SG_ 950 VC_BU_AUTO_SS_CSO 1;
BA_ "FlexKomSigStartValue" SG_ 950 VC_BU_AUTO_SS_CSO "0300000000000000h";
BA_ "FlexKomSigStartPos" SG_ 950 VC_BU_AUTO_SS_CSO 7;
BA_ "FlexKomSigName" SG_ 950 VC_BU_AUTO_SS_CSO "VehCfgCSM2_BuPkt";
BA_ "FlexKomSigLaenge" SG_ 950 VC_BU_AUTO_SS_CSO 64;
BA_ "FlexKomSID" SG_ 950 VC_BU_AUTO_SS_CSO 2009;
BA_ "FlexKomIsMotorola" SG_ 950 VC_BU_AUTO_SS_CSO 1;
BA_ "FlexKomComment" SG_ 950 VC_BU_AUTO_SS_CSO "Backup for veh config - customer settings menu 2 p";
BA_ "GenSigSNA" SG_ 950 VC_BU_BSM_TRLR_CSO "0h";
BA_ "GenSigSendType" SG_ 950 VC_BU_BSM_TRLR_CSO 1;
BA_ "FlexKomSigStartValue" SG_ 950 VC_BU_BSM_TRLR_CSO "0300000000000000h";
BA_ "FlexKomSigStartPos" SG_ 950 VC_BU_BSM_TRLR_CSO 7;
BA_ "FlexKomSigName" SG_ 950 VC_BU_BSM_TRLR_CSO "VehCfgCSM2_BuPkt";
BA_ "FlexKomSigLaenge" SG_ 950 VC_BU_BSM_TRLR_CSO 64;
BA_ "FlexKomSID" SG_ 950 VC_BU_BSM_TRLR_CSO 2009;
BA_ "FlexKomIsMotorola" SG_ 950 VC_BU_BSM_TRLR_CSO 1;
BA_ "FlexKomComment" SG_ 950 VC_BU_BSM_TRLR_CSO "Backup for veh config - customer settings menu 2 p";
BA_ "GenSigSNA" SG_ 950 VC_BU_DOORS_OFF_ACC_DLY_CSO "0h";
BA_ "GenSigSendType" SG_ 950 VC_BU_DOORS_OFF_ACC_DLY_CSO 1;
BA_ "FlexKomSigStartValue" SG_ 950 VC_BU_DOORS_OFF_ACC_DLY_CSO "0300000000000000h";
BA_ "FlexKomSigStartPos" SG_ 950 VC_BU_DOORS_OFF_ACC_DLY_CSO 7;
BA_ "FlexKomSigName" SG_ 950 VC_BU_DOORS_OFF_ACC_DLY_CSO "VehCfgCSM2_BuPkt";
BA_ "FlexKomSigLaenge" SG_ 950 VC_BU_DOORS_OFF_ACC_DLY_CSO 64;
BA_ "FlexKomSID" SG_ 950 VC_BU_DOORS_OFF_ACC_DLY_CSO 2009;
BA_ "FlexKomIsMotorola" SG_ 950 VC_BU_DOORS_OFF_ACC_DLY_CSO 1;
BA_ "FlexKomComment" SG_ 950 VC_BU_DOORS_OFF_ACC_DLY_CSO "Backup for veh config - customer settings menu 2 p";
BA_ "GenSigSNA" SG_ 950 VC_BU_EPB_ON_CSO "0h";
BA_ "GenSigSendType" SG_ 950 VC_BU_EPB_ON_CSO 1;
BA_ "FlexKomSigStartValue" SG_ 950 VC_BU_EPB_ON_CSO "0300000000000000h";
BA_ "FlexKomSigStartPos" SG_ 950 VC_BU_EPB_ON_CSO 7;
BA_ "FlexKomSigName" SG_ 950 VC_BU_EPB_ON_CSO "VehCfgCSM2_BuPkt";
BA_ "FlexKomSigLaenge" SG_ 950 VC_BU_EPB_ON_CSO 64;
BA_ "FlexKomSID" SG_ 950 VC_BU_EPB_ON_CSO 2009;
BA_ "FlexKomIsMotorola" SG_ 950 VC_BU_EPB_ON_CSO 1;
BA_ "FlexKomComment" SG_ 950 VC_BU_EPB_ON_CSO "Backup for veh config - customer settings menu 2 p";
BA_ "GenSigSNA" SG_ 950 VC_BU_FCW_SW_CSO "0h";
BA_ "GenSigSendType" SG_ 950 VC_BU_FCW_SW_CSO 1;
BA_ "FlexKomSigStartValue" SG_ 950 VC_BU_FCW_SW_CSO "0300000000000000h";
BA_ "FlexKomSigStartPos" SG_ 950 VC_BU_FCW_SW_CSO 7;
BA_ "FlexKomSigName" SG_ 950 VC_BU_FCW_SW_CSO "VehCfgCSM2_BuPkt";
BA_ "FlexKomSigLaenge" SG_ 950 VC_BU_FCW_SW_CSO 64;
BA_ "FlexKomSID" SG_ 950 VC_BU_FCW_SW_CSO 2009;
BA_ "FlexKomIsMotorola" SG_ 950 VC_BU_FCW_SW_CSO 1;
BA_ "FlexKomComment" SG_ 950 VC_BU_FCW_SW_CSO "Backup for veh config - customer settings menu 2 p";
BA_ "GenSigSNA" SG_ 950 VC_BU_FCW_WARN_BRK_CSO "0h";
BA_ "GenSigSendType" SG_ 950 VC_BU_FCW_WARN_BRK_CSO 1;
BA_ "FlexKomSigStartValue" SG_ 950 VC_BU_FCW_WARN_BRK_CSO "0300000000000000h";
BA_ "FlexKomSigStartPos" SG_ 950 VC_BU_FCW_WARN_BRK_CSO 7;
BA_ "FlexKomSigName" SG_ 950 VC_BU_FCW_WARN_BRK_CSO "VehCfgCSM2_BuPkt";
BA_ "FlexKomSigLaenge" SG_ 950 VC_BU_FCW_WARN_BRK_CSO 64;
BA_ "FlexKomSID" SG_ 950 VC_BU_FCW_WARN_BRK_CSO 2009;
BA_ "FlexKomIsMotorola" SG_ 950 VC_BU_FCW_WARN_BRK_CSO 1;
BA_ "FlexKomComment" SG_ 950 VC_BU_FCW_WARN_BRK_CSO "Backup for veh config - customer settings menu 2 p";
BA_ "GenSigSNA" SG_ 950 VC_BU_FLSH_LMP_SLDR_CSO "0h";
BA_ "GenSigSendType" SG_ 950 VC_BU_FLSH_LMP_SLDR_CSO 1;
BA_ "FlexKomSigStartValue" SG_ 950 VC_BU_FLSH_LMP_SLDR_CSO "0300000000000000h";
BA_ "FlexKomSigStartPos" SG_ 950 VC_BU_FLSH_LMP_SLDR_CSO 7;
BA_ "FlexKomSigName" SG_ 950 VC_BU_FLSH_LMP_SLDR_CSO "VehCfgCSM2_BuPkt";
BA_ "FlexKomSigLaenge" SG_ 950 VC_BU_FLSH_LMP_SLDR_CSO 64;
BA_ "FlexKomSID" SG_ 950 VC_BU_FLSH_LMP_SLDR_CSO 2009;
BA_ "FlexKomIsMotorola" SG_ 950 VC_BU_FLSH_LMP_SLDR_CSO 1;
BA_ "FlexKomComment" SG_ 950 VC_BU_FLSH_LMP_SLDR_CSO "Backup for veh config - customer settings menu 2 p";
BA_ "GenSigSNA" SG_ 950 VC_BU_FUEL_SAV_CSO "0h";
BA_ "GenSigSendType" SG_ 950 VC_BU_FUEL_SAV_CSO 1;
BA_ "FlexKomSigStartValue" SG_ 950 VC_BU_FUEL_SAV_CSO "0300000000000000h";
BA_ "FlexKomSigStartPos" SG_ 950 VC_BU_FUEL_SAV_CSO 7;
BA_ "FlexKomSigName" SG_ 950 VC_BU_FUEL_SAV_CSO "VehCfgCSM2_BuPkt";
BA_ "FlexKomSigLaenge" SG_ 950 VC_BU_FUEL_SAV_CSO 64;
BA_ "FlexKomSID" SG_ 950 VC_BU_FUEL_SAV_CSO 2009;
BA_ "FlexKomIsMotorola" SG_ 950 VC_BU_FUEL_SAV_CSO 1;
BA_ "FlexKomComment" SG_ 950 VC_BU_FUEL_SAV_CSO "Backup for veh config - customer settings menu 2 p";
BA_ "GenSigSNA" SG_ 950 VC_BU_HANDS_FREE_LFT_CSO "0h";
BA_ "GenSigSendType" SG_ 950 VC_BU_HANDS_FREE_LFT_CSO 1;
BA_ "FlexKomSigStartValue" SG_ 950 VC_BU_HANDS_FREE_LFT_CSO "0300000000000000h";
BA_ "FlexKomSigStartPos" SG_ 950 VC_BU_HANDS_FREE_LFT_CSO 7;
BA_ "FlexKomSigName" SG_ 950 VC_BU_HANDS_FREE_LFT_CSO "VehCfgCSM2_BuPkt";
BA_ "FlexKomSigLaenge" SG_ 950 VC_BU_HANDS_FREE_LFT_CSO 64;
BA_ "FlexKomSID" SG_ 950 VC_BU_HANDS_FREE_LFT_CSO 2009;
BA_ "FlexKomIsMotorola" SG_ 950 VC_BU_HANDS_FREE_LFT_CSO 1;
BA_ "FlexKomComment" SG_ 950 VC_BU_HANDS_FREE_LFT_CSO "Backup for veh config - customer settings menu 2 p";
BA_ "GenSigSNA" SG_ 950 VC_BU_HANDS_FREE_SLDR_CSO "0h";
BA_ "GenSigSendType" SG_ 950 VC_BU_HANDS_FREE_SLDR_CSO 1;
BA_ "FlexKomSigStartValue" SG_ 950 VC_BU_HANDS_FREE_SLDR_CSO "0300000000000000h";
BA_ "FlexKomSigStartPos" SG_ 950 VC_BU_HANDS_FREE_SLDR_CSO 7;
BA_ "FlexKomSigName" SG_ 950 VC_BU_HANDS_FREE_SLDR_CSO "VehCfgCSM2_BuPkt";
BA_ "FlexKomSigLaenge" SG_ 950 VC_BU_HANDS_FREE_SLDR_CSO 64;
BA_ "FlexKomSID" SG_ 950 VC_BU_HANDS_FREE_SLDR_CSO 2009;
BA_ "FlexKomIsMotorola" SG_ 950 VC_BU_HANDS_FREE_SLDR_CSO 1;
BA_ "FlexKomComment" SG_ 950 VC_BU_HANDS_FREE_SLDR_CSO "Backup for veh config - customer settings menu 2 p";
BA_ "GenSigSNA" SG_ 950 VC_BU_HOLD_N_GO_CSO "0h";
BA_ "GenSigSendType" SG_ 950 VC_BU_HOLD_N_GO_CSO 1;
BA_ "FlexKomSigStartValue" SG_ 950 VC_BU_HOLD_N_GO_CSO "0300000000000000h";
BA_ "FlexKomSigStartPos" SG_ 950 VC_BU_HOLD_N_GO_CSO 7;
BA_ "FlexKomSigName" SG_ 950 VC_BU_HOLD_N_GO_CSO "VehCfgCSM2_BuPkt";
BA_ "FlexKomSigLaenge" SG_ 950 VC_BU_HOLD_N_GO_CSO 64;
BA_ "FlexKomSID" SG_ 950 VC_BU_HOLD_N_GO_CSO 2009;
BA_ "FlexKomIsMotorola" SG_ 950 VC_BU_HOLD_N_GO_CSO 1;
BA_ "FlexKomComment" SG_ 950 VC_BU_HOLD_N_GO_CSO "Backup for veh config - customer settings menu 2 p";
BA_ "GenSigSNA" SG_ 950 VC_BU_LDW_ON_CSO "0h";
BA_ "GenSigSendType" SG_ 950 VC_BU_LDW_ON_CSO 1;
BA_ "FlexKomSigStartValue" SG_ 950 VC_BU_LDW_ON_CSO "0300000000000000h";
BA_ "FlexKomSigStartPos" SG_ 950 VC_BU_LDW_ON_CSO 7;
BA_ "FlexKomSigName" SG_ 950 VC_BU_LDW_ON_CSO "VehCfgCSM2_BuPkt";
BA_ "FlexKomSigLaenge" SG_ 950 VC_BU_LDW_ON_CSO 64;
BA_ "FlexKomSID" SG_ 950 VC_BU_LDW_ON_CSO 2009;
BA_ "FlexKomIsMotorola" SG_ 950 VC_BU_LDW_ON_CSO 1;
BA_ "FlexKomComment" SG_ 950 VC_BU_LDW_ON_CSO "Backup for veh config - customer settings menu 2 p";
BA_ "GenSigSNA" SG_ 950 VC_BU_PADDLE_SHIFT_CSO "0h";
BA_ "GenSigSendType" SG_ 950 VC_BU_PADDLE_SHIFT_CSO 1;
BA_ "FlexKomSigStartValue" SG_ 950 VC_BU_PADDLE_SHIFT_CSO "0300000000000000h";
BA_ "FlexKomSigStartPos" SG_ 950 VC_BU_PADDLE_SHIFT_CSO 7;
BA_ "FlexKomSigName" SG_ 950 VC_BU_PADDLE_SHIFT_CSO "VehCfgCSM2_BuPkt";
BA_ "FlexKomSigLaenge" SG_ 950 VC_BU_PADDLE_SHIFT_CSO 64;
BA_ "FlexKomSID" SG_ 950 VC_BU_PADDLE_SHIFT_CSO 2009;
BA_ "FlexKomIsMotorola" SG_ 950 VC_BU_PADDLE_SHIFT_CSO 1;
BA_ "FlexKomComment" SG_ 950 VC_BU_PADDLE_SHIFT_CSO "Backup for veh config - customer settings menu 2 p";
BA_ "GenSigSNA" SG_ 950 VC_BU_PCS_CSO "0h";
BA_ "GenSigSendType" SG_ 950 VC_BU_PCS_CSO 1;
BA_ "FlexKomSigStartValue" SG_ 950 VC_BU_PCS_CSO "0300000000000000h";
BA_ "FlexKomSigStartPos" SG_ 950 VC_BU_PCS_CSO 7;
BA_ "FlexKomSigName" SG_ 950 VC_BU_PCS_CSO "VehCfgCSM2_BuPkt";
BA_ "FlexKomSigLaenge" SG_ 950 VC_BU_PCS_CSO 64;
BA_ "FlexKomSID" SG_ 950 VC_BU_PCS_CSO 2009;
BA_ "FlexKomIsMotorola" SG_ 950 VC_BU_PCS_CSO 1;
BA_ "FlexKomComment" SG_ 950 VC_BU_PCS_CSO "Backup for veh config - customer settings menu 2 p";
BA_ "GenSigSNA" SG_ 950 VC_BU_PRK_ASST_TYPE_CSO "0h";
BA_ "GenSigSendType" SG_ 950 VC_BU_PRK_ASST_TYPE_CSO 1;
BA_ "FlexKomSigStartValue" SG_ 950 VC_BU_PRK_ASST_TYPE_CSO "0300000000000000h";
BA_ "FlexKomSigStartPos" SG_ 950 VC_BU_PRK_ASST_TYPE_CSO 7;
BA_ "FlexKomSigName" SG_ 950 VC_BU_PRK_ASST_TYPE_CSO "VehCfgCSM2_BuPkt";
BA_ "FlexKomSigLaenge" SG_ 950 VC_BU_PRK_ASST_TYPE_CSO 64;
BA_ "FlexKomSID" SG_ 950 VC_BU_PRK_ASST_TYPE_CSO 2009;
BA_ "FlexKomIsMotorola" SG_ 950 VC_BU_PRK_ASST_TYPE_CSO 1;
BA_ "FlexKomComment" SG_ 950 VC_BU_PRK_ASST_TYPE_CSO "Backup for veh config - customer settings menu 2 p";
BA_ "GenSigSNA" SG_ 950 VC_BU_PWR_FLD_MRR_CSO "0h";
BA_ "GenSigSendType" SG_ 950 VC_BU_PWR_FLD_MRR_CSO 1;
BA_ "FlexKomSigStartValue" SG_ 950 VC_BU_PWR_FLD_MRR_CSO "0300000000000000h";
BA_ "FlexKomSigStartPos" SG_ 950 VC_BU_PWR_FLD_MRR_CSO 7;
BA_ "FlexKomSigName" SG_ 950 VC_BU_PWR_FLD_MRR_CSO "VehCfgCSM2_BuPkt";
BA_ "FlexKomSigLaenge" SG_ 950 VC_BU_PWR_FLD_MRR_CSO 64;
BA_ "FlexKomSID" SG_ 950 VC_BU_PWR_FLD_MRR_CSO 2009;
BA_ "FlexKomIsMotorola" SG_ 950 VC_BU_PWR_FLD_MRR_CSO 1;
BA_ "FlexKomComment" SG_ 950 VC_BU_PWR_FLD_MRR_CSO "Backup for veh config - customer settings menu 2 p";
BA_ "GenSigSNA" SG_ 950 VC_BU_RDY_DRV_CSO "0h";
BA_ "GenSigSendType" SG_ 950 VC_BU_RDY_DRV_CSO 1;
BA_ "FlexKomSigStartValue" SG_ 950 VC_BU_RDY_DRV_CSO "0300000000000000h";
BA_ "FlexKomSigStartPos" SG_ 950 VC_BU_RDY_DRV_CSO 7;
BA_ "FlexKomSigName" SG_ 950 VC_BU_RDY_DRV_CSO "VehCfgCSM2_BuPkt";
BA_ "FlexKomSigLaenge" SG_ 950 VC_BU_RDY_DRV_CSO 64;
BA_ "FlexKomSID" SG_ 950 VC_BU_RDY_DRV_CSO 2009;
BA_ "FlexKomIsMotorola" SG_ 950 VC_BU_RDY_DRV_CSO 1;
BA_ "FlexKomComment" SG_ 950 VC_BU_RDY_DRV_CSO "Backup for veh config - customer settings menu 2 p";
BA_ "GenSigSNA" SG_ 950 VC_BU_REAR_CMRA_DLY_CSO "0h";
BA_ "GenSigSendType" SG_ 950 VC_BU_REAR_CMRA_DLY_CSO 1;
BA_ "FlexKomSigStartValue" SG_ 950 VC_BU_REAR_CMRA_DLY_CSO "0300000000000000h";
BA_ "FlexKomSigStartPos" SG_ 950 VC_BU_REAR_CMRA_DLY_CSO 7;
BA_ "FlexKomSigName" SG_ 950 VC_BU_REAR_CMRA_DLY_CSO "VehCfgCSM2_BuPkt";
BA_ "FlexKomSigLaenge" SG_ 950 VC_BU_REAR_CMRA_DLY_CSO 64;
BA_ "FlexKomSID" SG_ 950 VC_BU_REAR_CMRA_DLY_CSO 2009;
BA_ "FlexKomIsMotorola" SG_ 950 VC_BU_REAR_CMRA_DLY_CSO 1;
BA_ "FlexKomComment" SG_ 950 VC_BU_REAR_CMRA_DLY_CSO "Backup for veh config - customer settings menu 2 p";
BA_ "GenSigSNA" SG_ 950 VC_BU_RKE_MEM_CSO "0h";
BA_ "GenSigSendType" SG_ 950 VC_BU_RKE_MEM_CSO 1;
BA_ "FlexKomSigStartValue" SG_ 950 VC_BU_RKE_MEM_CSO "0300000000000000h";
BA_ "FlexKomSigStartPos" SG_ 950 VC_BU_RKE_MEM_CSO 7;
BA_ "FlexKomSigName" SG_ 950 VC_BU_RKE_MEM_CSO "VehCfgCSM2_BuPkt";
BA_ "FlexKomSigLaenge" SG_ 950 VC_BU_RKE_MEM_CSO 64;
BA_ "FlexKomSID" SG_ 950 VC_BU_RKE_MEM_CSO 2009;
BA_ "FlexKomIsMotorola" SG_ 950 VC_BU_RKE_MEM_CSO 1;
BA_ "FlexKomComment" SG_ 950 VC_BU_RKE_MEM_CSO "Backup for veh config - customer settings menu 2 p";
BA_ "GenSigSNA" SG_ 950 VC_BU_RKE_UNLK_CSO "0h";
BA_ "GenSigSendType" SG_ 950 VC_BU_RKE_UNLK_CSO 1;
BA_ "FlexKomSigStartValue" SG_ 950 VC_BU_RKE_UNLK_CSO "0300000000000000h";
BA_ "FlexKomSigStartPos" SG_ 950 VC_BU_RKE_UNLK_CSO 7;
BA_ "FlexKomSigName" SG_ 950 VC_BU_RKE_UNLK_CSO "VehCfgCSM2_BuPkt";
BA_ "FlexKomSigLaenge" SG_ 950 VC_BU_RKE_UNLK_CSO 64;
BA_ "FlexKomSID" SG_ 950 VC_BU_RKE_UNLK_CSO 2009;
BA_ "FlexKomIsMotorola" SG_ 950 VC_BU_RKE_UNLK_CSO 1;
BA_ "FlexKomComment" SG_ 950 VC_BU_RKE_UNLK_CSO "Backup for veh config - customer settings menu 2 p";
BA_ "GenSigSNA" SG_ 950 VC_BU_SLD_DR_ALRT_CSO "0h";
BA_ "GenSigSendType" SG_ 950 VC_BU_SLD_DR_ALRT_CSO 1;
BA_ "FlexKomSigStartValue" SG_ 950 VC_BU_SLD_DR_ALRT_CSO "0300000000000000h";
BA_ "FlexKomSigStartPos" SG_ 950 VC_BU_SLD_DR_ALRT_CSO 7;
BA_ "FlexKomSigName" SG_ 950 VC_BU_SLD_DR_ALRT_CSO "VehCfgCSM2_BuPkt";
BA_ "FlexKomSigLaenge" SG_ 950 VC_BU_SLD_DR_ALRT_CSO 64;
BA_ "FlexKomSID" SG_ 950 VC_BU_SLD_DR_ALRT_CSO 2009;
BA_ "FlexKomIsMotorola" SG_ 950 VC_BU_SLD_DR_ALRT_CSO 1;
BA_ "FlexKomComment" SG_ 950 VC_BU_SLD_DR_ALRT_CSO "Backup for veh config - customer settings menu 2 p";
BA_ "GenSigSNA" SG_ 950 VC_BU_SLD_DR_CHM_CSO "0h";
BA_ "GenSigSendType" SG_ 950 VC_BU_SLD_DR_CHM_CSO 1;
BA_ "FlexKomSigStartValue" SG_ 950 VC_BU_SLD_DR_CHM_CSO "0300000000000000h";
BA_ "FlexKomSigStartPos" SG_ 950 VC_BU_SLD_DR_CHM_CSO 7;
BA_ "FlexKomSigName" SG_ 950 VC_BU_SLD_DR_CHM_CSO "VehCfgCSM2_BuPkt";
BA_ "FlexKomSigLaenge" SG_ 950 VC_BU_SLD_DR_CHM_CSO 64;
BA_ "FlexKomSID" SG_ 950 VC_BU_SLD_DR_CHM_CSO 2009;
BA_ "FlexKomIsMotorola" SG_ 950 VC_BU_SLD_DR_CHM_CSO 1;
BA_ "FlexKomComment" SG_ 950 VC_BU_SLD_DR_CHM_CSO "Backup for veh config - customer settings menu 2 p";
BA_ "GenSigSNA" SG_ 950 VC_BU_SPEED_CSO "0h";
BA_ "GenSigSendType" SG_ 950 VC_BU_SPEED_CSO 1;
BA_ "FlexKomSigStartValue" SG_ 950 VC_BU_SPEED_CSO "0300000000000000h";
BA_ "FlexKomSigStartPos" SG_ 950 VC_BU_SPEED_CSO 7;
BA_ "FlexKomSigName" SG_ 950 VC_BU_SPEED_CSO "VehCfgCSM2_BuPkt";
BA_ "FlexKomSigLaenge" SG_ 950 VC_BU_SPEED_CSO 64;
BA_ "FlexKomSID" SG_ 950 VC_BU_SPEED_CSO 2009;
BA_ "FlexKomIsMotorola" SG_ 950 VC_BU_SPEED_CSO 1;
BA_ "FlexKomComment" SG_ 950 VC_BU_SPEED_CSO "Backup for veh config - customer settings menu 2 p";
BA_ "GenSigSNA" SG_ 950 VC_BU_SPEED_WARNING_CSO "0h";
BA_ "GenSigSendType" SG_ 950 VC_BU_SPEED_WARNING_CSO 1;
BA_ "FlexKomSigStartValue" SG_ 950 VC_BU_SPEED_WARNING_CSO "0300000000000000h";
BA_ "FlexKomSigStartPos" SG_ 950 VC_BU_SPEED_WARNING_CSO 7;
BA_ "FlexKomSigName" SG_ 950 VC_BU_SPEED_WARNING_CSO "VehCfgCSM2_BuPkt";
BA_ "FlexKomSigLaenge" SG_ 950 VC_BU_SPEED_WARNING_CSO 64;
BA_ "FlexKomSID" SG_ 950 VC_BU_SPEED_WARNING_CSO 2009;
BA_ "FlexKomIsMotorola" SG_ 950 VC_BU_SPEED_WARNING_CSO 1;
BA_ "FlexKomComment" SG_ 950 VC_BU_SPEED_WARNING_CSO "Backup for veh config - customer settings menu 2 p";
BA_ "GenSigSNA" SG_ 950 VC_BU_SVC_DELAY_CSO "0h";
BA_ "GenSigSendType" SG_ 950 VC_BU_SVC_DELAY_CSO 1;
BA_ "FlexKomSigStartValue" SG_ 950 VC_BU_SVC_DELAY_CSO "0300000000000000h";
BA_ "FlexKomSigStartPos" SG_ 950 VC_BU_SVC_DELAY_CSO 7;
BA_ "FlexKomSigName" SG_ 950 VC_BU_SVC_DELAY_CSO "VehCfgCSM2_BuPkt";
BA_ "FlexKomSigLaenge" SG_ 950 VC_BU_SVC_DELAY_CSO 64;
BA_ "FlexKomSID" SG_ 950 VC_BU_SVC_DELAY_CSO 2009;
BA_ "FlexKomIsMotorola" SG_ 950 VC_BU_SVC_DELAY_CSO 1;
BA_ "FlexKomComment" SG_ 950 VC_BU_SVC_DELAY_CSO "Backup for veh config - customer settings menu 2 p";
BA_ "GenSigSNA" SG_ 950 VC_BU_SVC_GRIDLINES_CSO "0h";
BA_ "GenSigSendType" SG_ 950 VC_BU_SVC_GRIDLINES_CSO 1;
BA_ "FlexKomSigStartValue" SG_ 950 VC_BU_SVC_GRIDLINES_CSO "0300000000000000h";
BA_ "FlexKomSigStartPos" SG_ 950 VC_BU_SVC_GRIDLINES_CSO 7;
BA_ "FlexKomSigName" SG_ 950 VC_BU_SVC_GRIDLINES_CSO "VehCfgCSM2_BuPkt";
BA_ "FlexKomSigLaenge" SG_ 950 VC_BU_SVC_GRIDLINES_CSO 64;
BA_ "FlexKomSID" SG_ 950 VC_BU_SVC_GRIDLINES_CSO 2009;
BA_ "FlexKomIsMotorola" SG_ 950 VC_BU_SVC_GRIDLINES_CSO 1;
BA_ "FlexKomComment" SG_ 950 VC_BU_SVC_GRIDLINES_CSO "Backup for veh config - customer settings menu 2 p";
BA_ "GenSigSNA" SG_ 950 VC_BU_TEEN_AUTO_HB_CSO "0h";
BA_ "GenSigSendType" SG_ 950 VC_BU_TEEN_AUTO_HB_CSO 1;
BA_ "FlexKomSigStartValue" SG_ 950 VC_BU_TEEN_AUTO_HB_CSO "0300000000000000h";
BA_ "FlexKomSigStartPos" SG_ 950 VC_BU_TEEN_AUTO_HB_CSO 7;
BA_ "FlexKomSigName" SG_ 950 VC_BU_TEEN_AUTO_HB_CSO "VehCfgCSM2_BuPkt";
BA_ "FlexKomSigLaenge" SG_ 950 VC_BU_TEEN_AUTO_HB_CSO 64;
BA_ "FlexKomSID" SG_ 950 VC_BU_TEEN_AUTO_HB_CSO 2009;
BA_ "FlexKomIsMotorola" SG_ 950 VC_BU_TEEN_AUTO_HB_CSO 1;
BA_ "FlexKomComment" SG_ 950 VC_BU_TEEN_AUTO_HB_CSO "Backup for veh config - customer settings menu 2 p";
BA_ "GenSigSNA" SG_ 950 VC_BU_TEEN_BLIND_SPOT_CSO "0h";
BA_ "GenSigSendType" SG_ 950 VC_BU_TEEN_BLIND_SPOT_CSO 1;
BA_ "FlexKomSigStartValue" SG_ 950 VC_BU_TEEN_BLIND_SPOT_CSO "0300000000000000h";
BA_ "FlexKomSigStartPos" SG_ 950 VC_BU_TEEN_BLIND_SPOT_CSO 7;
BA_ "FlexKomSigName" SG_ 950 VC_BU_TEEN_BLIND_SPOT_CSO "VehCfgCSM2_BuPkt";
BA_ "FlexKomSigLaenge" SG_ 950 VC_BU_TEEN_BLIND_SPOT_CSO 64;
BA_ "FlexKomSID" SG_ 950 VC_BU_TEEN_BLIND_SPOT_CSO 2009;
BA_ "FlexKomIsMotorola" SG_ 950 VC_BU_TEEN_BLIND_SPOT_CSO 1;
BA_ "FlexKomComment" SG_ 950 VC_BU_TEEN_BLIND_SPOT_CSO "Backup for veh config - customer settings menu 2 p";
BA_ "GenSigSNA" SG_ 950 VC_BU_TEEN_FCW_BRK_CSO "0h";
BA_ "GenSigSendType" SG_ 950 VC_BU_TEEN_FCW_BRK_CSO 1;
BA_ "FlexKomSigStartValue" SG_ 950 VC_BU_TEEN_FCW_BRK_CSO "0300000000000000h";
BA_ "FlexKomSigStartPos" SG_ 950 VC_BU_TEEN_FCW_BRK_CSO 7;
BA_ "FlexKomSigName" SG_ 950 VC_BU_TEEN_FCW_BRK_CSO "VehCfgCSM2_BuPkt";
BA_ "FlexKomSigLaenge" SG_ 950 VC_BU_TEEN_FCW_BRK_CSO 64;
BA_ "FlexKomSID" SG_ 950 VC_BU_TEEN_FCW_BRK_CSO 2009;
BA_ "FlexKomIsMotorola" SG_ 950 VC_BU_TEEN_FCW_BRK_CSO 1;
BA_ "FlexKomComment" SG_ 950 VC_BU_TEEN_FCW_BRK_CSO "Backup for veh config - customer settings menu 2 p";
BA_ "GenSigSNA" SG_ 950 VC_BU_TEEN_FCW_SENS_CSO "0h";
BA_ "GenSigSendType" SG_ 950 VC_BU_TEEN_FCW_SENS_CSO 1;
BA_ "FlexKomSigStartValue" SG_ 950 VC_BU_TEEN_FCW_SENS_CSO "0300000000000000h";
BA_ "FlexKomSigStartPos" SG_ 950 VC_BU_TEEN_FCW_SENS_CSO 7;
BA_ "FlexKomSigName" SG_ 950 VC_BU_TEEN_FCW_SENS_CSO "VehCfgCSM2_BuPkt";
BA_ "FlexKomSigLaenge" SG_ 950 VC_BU_TEEN_FCW_SENS_CSO 64;
BA_ "FlexKomSID" SG_ 950 VC_BU_TEEN_FCW_SENS_CSO 2009;
BA_ "FlexKomIsMotorola" SG_ 950 VC_BU_TEEN_FCW_SENS_CSO 1;
BA_ "FlexKomComment" SG_ 950 VC_BU_TEEN_FCW_SENS_CSO "Backup for veh config - customer settings menu 2 p";
BA_ "GenSigSNA" SG_ 950 VC_BU_TEEN_FT_PRK_VOL_CSO "0h";
BA_ "GenSigSendType" SG_ 950 VC_BU_TEEN_FT_PRK_VOL_CSO 1;
BA_ "FlexKomSigStartValue" SG_ 950 VC_BU_TEEN_FT_PRK_VOL_CSO "0300000000000000h";
BA_ "FlexKomSigStartPos" SG_ 950 VC_BU_TEEN_FT_PRK_VOL_CSO 7;
BA_ "FlexKomSigName" SG_ 950 VC_BU_TEEN_FT_PRK_VOL_CSO "VehCfgCSM2_BuPkt";
BA_ "FlexKomSigLaenge" SG_ 950 VC_BU_TEEN_FT_PRK_VOL_CSO 64;
BA_ "FlexKomSID" SG_ 950 VC_BU_TEEN_FT_PRK_VOL_CSO 2009;
BA_ "FlexKomIsMotorola" SG_ 950 VC_BU_TEEN_FT_PRK_VOL_CSO 1;
BA_ "FlexKomComment" SG_ 950 VC_BU_TEEN_FT_PRK_VOL_CSO "Backup for veh config - customer settings menu 2 p";
BA_ "GenSigSNA" SG_ 950 VC_BU_TEEN_FUEL_POPUP_CSO "0h";
BA_ "GenSigSendType" SG_ 950 VC_BU_TEEN_FUEL_POPUP_CSO 1;
BA_ "FlexKomSigStartValue" SG_ 950 VC_BU_TEEN_FUEL_POPUP_CSO "0300000000000000h";
BA_ "FlexKomSigStartPos" SG_ 950 VC_BU_TEEN_FUEL_POPUP_CSO 7;
BA_ "FlexKomSigName" SG_ 950 VC_BU_TEEN_FUEL_POPUP_CSO "VehCfgCSM2_BuPkt";
BA_ "FlexKomSigLaenge" SG_ 950 VC_BU_TEEN_FUEL_POPUP_CSO 64;
BA_ "FlexKomSID" SG_ 950 VC_BU_TEEN_FUEL_POPUP_CSO 2009;
BA_ "FlexKomIsMotorola" SG_ 950 VC_BU_TEEN_FUEL_POPUP_CSO 1;
BA_ "FlexKomComment" SG_ 950 VC_BU_TEEN_FUEL_POPUP_CSO "Backup for veh config - customer settings menu 2 p";
BA_ "GenSigSNA" SG_ 950 VC_BU_TEEN_FUEL_WRN_CSO "0h";
BA_ "GenSigSendType" SG_ 950 VC_BU_TEEN_FUEL_WRN_CSO 1;
BA_ "FlexKomSigStartValue" SG_ 950 VC_BU_TEEN_FUEL_WRN_CSO "0300000000000000h";
BA_ "FlexKomSigStartPos" SG_ 950 VC_BU_TEEN_FUEL_WRN_CSO 7;
BA_ "FlexKomSigName" SG_ 950 VC_BU_TEEN_FUEL_WRN_CSO "VehCfgCSM2_BuPkt";
BA_ "FlexKomSigLaenge" SG_ 950 VC_BU_TEEN_FUEL_WRN_CSO 64;
BA_ "FlexKomSID" SG_ 950 VC_BU_TEEN_FUEL_WRN_CSO 2009;
BA_ "FlexKomIsMotorola" SG_ 950 VC_BU_TEEN_FUEL_WRN_CSO 1;
BA_ "FlexKomComment" SG_ 950 VC_BU_TEEN_FUEL_WRN_CSO "Backup for veh config - customer settings menu 2 p";
BA_ "GenSigSNA" SG_ 950 VC_BU_TEEN_LGHT_WPR_CSO "0h";
BA_ "GenSigSendType" SG_ 950 VC_BU_TEEN_LGHT_WPR_CSO 1;
BA_ "FlexKomSigStartValue" SG_ 950 VC_BU_TEEN_LGHT_WPR_CSO "0300000000000000h";
BA_ "FlexKomSigStartPos" SG_ 950 VC_BU_TEEN_LGHT_WPR_CSO 7;
BA_ "FlexKomSigName" SG_ 950 VC_BU_TEEN_LGHT_WPR_CSO "VehCfgCSM2_BuPkt";
BA_ "FlexKomSigLaenge" SG_ 950 VC_BU_TEEN_LGHT_WPR_CSO 64;
BA_ "FlexKomSID" SG_ 950 VC_BU_TEEN_LGHT_WPR_CSO 2009;
BA_ "FlexKomIsMotorola" SG_ 950 VC_BU_TEEN_LGHT_WPR_CSO 1;
BA_ "FlexKomComment" SG_ 950 VC_BU_TEEN_LGHT_WPR_CSO "Backup for veh config - customer settings menu 2 p";
BA_ "GenSigSNA" SG_ 950 VC_BU_TEEN_MAX_SPEED_CSO "0h";
BA_ "GenSigSendType" SG_ 950 VC_BU_TEEN_MAX_SPEED_CSO 1;
BA_ "FlexKomSigStartValue" SG_ 950 VC_BU_TEEN_MAX_SPEED_CSO "0300000000000000h";
BA_ "FlexKomSigStartPos" SG_ 950 VC_BU_TEEN_MAX_SPEED_CSO 7;
BA_ "FlexKomSigName" SG_ 950 VC_BU_TEEN_MAX_SPEED_CSO "VehCfgCSM2_BuPkt";
BA_ "FlexKomSigLaenge" SG_ 950 VC_BU_TEEN_MAX_SPEED_CSO 64;
BA_ "FlexKomSID" SG_ 950 VC_BU_TEEN_MAX_SPEED_CSO 2009;
BA_ "FlexKomIsMotorola" SG_ 950 VC_BU_TEEN_MAX_SPEED_CSO 1;
BA_ "FlexKomComment" SG_ 950 VC_BU_TEEN_MAX_SPEED_CSO "Backup for veh config - customer settings menu 2 p";
BA_ "GenSigSNA" SG_ 950 VC_BU_TEEN_PLG_CHIME_CSO "0h";
BA_ "GenSigSendType" SG_ 950 VC_BU_TEEN_PLG_CHIME_CSO 1;
BA_ "FlexKomSigStartValue" SG_ 950 VC_BU_TEEN_PLG_CHIME_CSO "0300000000000000h";
BA_ "FlexKomSigStartPos" SG_ 950 VC_BU_TEEN_PLG_CHIME_CSO 7;
BA_ "FlexKomSigName" SG_ 950 VC_BU_TEEN_PLG_CHIME_CSO "VehCfgCSM2_BuPkt";
BA_ "FlexKomSigLaenge" SG_ 950 VC_BU_TEEN_PLG_CHIME_CSO 64;
BA_ "FlexKomSID" SG_ 950 VC_BU_TEEN_PLG_CHIME_CSO 2009;
BA_ "FlexKomIsMotorola" SG_ 950 VC_BU_TEEN_PLG_CHIME_CSO 1;
BA_ "FlexKomComment" SG_ 950 VC_BU_TEEN_PLG_CHIME_CSO "Backup for veh config - customer settings menu 2 p";
BA_ "GenSigSNA" SG_ 950 VC_BU_TEEN_PRK_ASST_BRK_CSO "0h";
BA_ "GenSigSendType" SG_ 950 VC_BU_TEEN_PRK_ASST_BRK_CSO 1;
BA_ "FlexKomSigStartValue" SG_ 950 VC_BU_TEEN_PRK_ASST_BRK_CSO "0300000000000000h";
BA_ "FlexKomSigStartPos" SG_ 950 VC_BU_TEEN_PRK_ASST_BRK_CSO 7;
BA_ "FlexKomSigName" SG_ 950 VC_BU_TEEN_PRK_ASST_BRK_CSO "VehCfgCSM2_BuPkt";
BA_ "FlexKomSigLaenge" SG_ 950 VC_BU_TEEN_PRK_ASST_BRK_CSO 64;
BA_ "FlexKomSID" SG_ 950 VC_BU_TEEN_PRK_ASST_BRK_CSO 2009;
BA_ "FlexKomIsMotorola" SG_ 950 VC_BU_TEEN_PRK_ASST_BRK_CSO 1;
BA_ "FlexKomComment" SG_ 950 VC_BU_TEEN_PRK_ASST_BRK_CSO "Backup for veh config - customer settings menu 2 p";
BA_ "GenSigSNA" SG_ 950 VC_BU_TEEN_PRK_ASST_CSO "0h";
BA_ "GenSigSendType" SG_ 950 VC_BU_TEEN_PRK_ASST_CSO 1;
BA_ "FlexKomSigStartValue" SG_ 950 VC_BU_TEEN_PRK_ASST_CSO "0300000000000000h";
BA_ "FlexKomSigStartPos" SG_ 950 VC_BU_TEEN_PRK_ASST_CSO 7;
BA_ "FlexKomSigName" SG_ 950 VC_BU_TEEN_PRK_ASST_CSO "VehCfgCSM2_BuPkt";
BA_ "FlexKomSigLaenge" SG_ 950 VC_BU_TEEN_PRK_ASST_CSO 64;
BA_ "FlexKomSID" SG_ 950 VC_BU_TEEN_PRK_ASST_CSO 2009;
BA_ "FlexKomIsMotorola" SG_ 950 VC_BU_TEEN_PRK_ASST_CSO 1;
BA_ "FlexKomComment" SG_ 950 VC_BU_TEEN_PRK_ASST_CSO "Backup for veh config - customer settings menu 2 p";
BA_ "GenSigSNA" SG_ 950 VC_BU_TEEN_RAIN_WPR_CSO "0h";
BA_ "GenSigSendType" SG_ 950 VC_BU_TEEN_RAIN_WPR_CSO 1;
BA_ "FlexKomSigStartValue" SG_ 950 VC_BU_TEEN_RAIN_WPR_CSO "0300000000000000h";
BA_ "FlexKomSigStartPos" SG_ 950 VC_BU_TEEN_RAIN_WPR_CSO 7;
BA_ "FlexKomSigName" SG_ 950 VC_BU_TEEN_RAIN_WPR_CSO "VehCfgCSM2_BuPkt";
BA_ "FlexKomSigLaenge" SG_ 950 VC_BU_TEEN_RAIN_WPR_CSO 64;
BA_ "FlexKomSID" SG_ 950 VC_BU_TEEN_RAIN_WPR_CSO 2009;
BA_ "FlexKomIsMotorola" SG_ 950 VC_BU_TEEN_RAIN_WPR_CSO 1;
BA_ "FlexKomComment" SG_ 950 VC_BU_TEEN_RAIN_WPR_CSO "Backup for veh config - customer settings menu 2 p";
BA_ "GenSigSNA" SG_ 950 VC_BU_TEEN_RR_PRK_VOL_CSO "0h";
BA_ "GenSigSendType" SG_ 950 VC_BU_TEEN_RR_PRK_VOL_CSO 1;
BA_ "FlexKomSigStartValue" SG_ 950 VC_BU_TEEN_RR_PRK_VOL_CSO "0300000000000000h";
BA_ "FlexKomSigStartPos" SG_ 950 VC_BU_TEEN_RR_PRK_VOL_CSO 7;
BA_ "FlexKomSigName" SG_ 950 VC_BU_TEEN_RR_PRK_VOL_CSO "VehCfgCSM2_BuPkt";
BA_ "FlexKomSigLaenge" SG_ 950 VC_BU_TEEN_RR_PRK_VOL_CSO 64;
BA_ "FlexKomSID" SG_ 950 VC_BU_TEEN_RR_PRK_VOL_CSO 2009;
BA_ "FlexKomIsMotorola" SG_ 950 VC_BU_TEEN_RR_PRK_VOL_CSO 1;
BA_ "FlexKomComment" SG_ 950 VC_BU_TEEN_RR_PRK_VOL_CSO "Backup for veh config - customer settings menu 2 p";
BA_ "GenSigSNA" SG_ 950 VC_BU_TEEN_SLD_DR_ALRT_CSO "0h";
BA_ "GenSigSendType" SG_ 950 VC_BU_TEEN_SLD_DR_ALRT_CSO 1;
BA_ "FlexKomSigStartValue" SG_ 950 VC_BU_TEEN_SLD_DR_ALRT_CSO "0300000000000000h";
BA_ "FlexKomSigStartPos" SG_ 950 VC_BU_TEEN_SLD_DR_ALRT_CSO 7;
BA_ "FlexKomSigName" SG_ 950 VC_BU_TEEN_SLD_DR_ALRT_CSO "VehCfgCSM2_BuPkt";
BA_ "FlexKomSigLaenge" SG_ 950 VC_BU_TEEN_SLD_DR_ALRT_CSO 64;
BA_ "FlexKomSID" SG_ 950 VC_BU_TEEN_SLD_DR_ALRT_CSO 2009;
BA_ "FlexKomIsMotorola" SG_ 950 VC_BU_TEEN_SLD_DR_ALRT_CSO 1;
BA_ "FlexKomComment" SG_ 950 VC_BU_TEEN_SLD_DR_ALRT_CSO "Backup for veh config - customer settings menu 2 p";
BA_ "GenSigSNA" SG_ 950 VC_BU_TEEN_SLD_DR_CHM_CSO "0h";
BA_ "GenSigSendType" SG_ 950 VC_BU_TEEN_SLD_DR_CHM_CSO 1;
BA_ "FlexKomSigStartValue" SG_ 950 VC_BU_TEEN_SLD_DR_CHM_CSO "0300000000000000h";
BA_ "FlexKomSigStartPos" SG_ 950 VC_BU_TEEN_SLD_DR_CHM_CSO 7;
BA_ "FlexKomSigName" SG_ 950 VC_BU_TEEN_SLD_DR_CHM_CSO "VehCfgCSM2_BuPkt";
BA_ "FlexKomSigLaenge" SG_ 950 VC_BU_TEEN_SLD_DR_CHM_CSO 64;
BA_ "FlexKomSID" SG_ 950 VC_BU_TEEN_SLD_DR_CHM_CSO 2009;
BA_ "FlexKomIsMotorola" SG_ 950 VC_BU_TEEN_SLD_DR_CHM_CSO 1;
BA_ "FlexKomComment" SG_ 950 VC_BU_TEEN_SLD_DR_CHM_CSO "Backup for veh config - customer settings menu 2 p";
BA_ "GenSigSNA" SG_ 950 VC_BU_TEMP_CSO "0h";
BA_ "GenSigSendType" SG_ 950 VC_BU_TEMP_CSO 1;
BA_ "FlexKomSigStartValue" SG_ 950 VC_BU_TEMP_CSO "0300000000000000h";
BA_ "FlexKomSigStartPos" SG_ 950 VC_BU_TEMP_CSO 7;
BA_ "FlexKomSigName" SG_ 950 VC_BU_TEMP_CSO "VehCfgCSM2_BuPkt";
BA_ "FlexKomSigLaenge" SG_ 950 VC_BU_TEMP_CSO 64;
BA_ "FlexKomSID" SG_ 950 VC_BU_TEMP_CSO 2009;
BA_ "FlexKomIsMotorola" SG_ 950 VC_BU_TEMP_CSO 1;
BA_ "FlexKomComment" SG_ 950 VC_BU_TEMP_CSO "Backup for veh config - customer settings menu 2 p";
BA_ "GenSigSNA" SG_ 950 VC_BU_TLT_MRR_CSO "0h";
BA_ "GenSigSendType" SG_ 950 VC_BU_TLT_MRR_CSO 1;
BA_ "FlexKomSigStartValue" SG_ 950 VC_BU_TLT_MRR_CSO "0300000000000000h";
BA_ "FlexKomSigStartPos" SG_ 950 VC_BU_TLT_MRR_CSO 7;
BA_ "FlexKomSigName" SG_ 950 VC_BU_TLT_MRR_CSO "VehCfgCSM2_BuPkt";
BA_ "FlexKomSigLaenge" SG_ 950 VC_BU_TLT_MRR_CSO 64;
BA_ "FlexKomSID" SG_ 950 VC_BU_TLT_MRR_CSO 2009;
BA_ "FlexKomIsMotorola" SG_ 950 VC_BU_TLT_MRR_CSO 1;
BA_ "FlexKomComment" SG_ 950 VC_BU_TLT_MRR_CSO "Backup for veh config - customer settings menu 2 p";
BA_ "GenSigSNA" SG_ 950 VC_BU_TORQUE_CSO "0h";
BA_ "GenSigSendType" SG_ 950 VC_BU_TORQUE_CSO 1;
BA_ "FlexKomSigStartValue" SG_ 950 VC_BU_TORQUE_CSO "0300000000000000h";
BA_ "FlexKomSigStartPos" SG_ 950 VC_BU_TORQUE_CSO 7;
BA_ "FlexKomSigName" SG_ 950 VC_BU_TORQUE_CSO "VehCfgCSM2_BuPkt";
BA_ "FlexKomSigLaenge" SG_ 950 VC_BU_TORQUE_CSO 64;
BA_ "FlexKomSID" SG_ 950 VC_BU_TORQUE_CSO 2009;
BA_ "FlexKomIsMotorola" SG_ 950 VC_BU_TORQUE_CSO 1;
BA_ "FlexKomComment" SG_ 950 VC_BU_TORQUE_CSO "Backup for veh config - customer settings menu 2 p";
BA_ "GenSigSNA" SG_ 950 VC_BU_TRLR_CSO "0h";
BA_ "GenSigSendType" SG_ 950 VC_BU_TRLR_CSO 1;
BA_ "FlexKomSigStartValue" SG_ 950 VC_BU_TRLR_CSO "0300000000000000h";
BA_ "FlexKomSigStartPos" SG_ 950 VC_BU_TRLR_CSO 7;
BA_ "FlexKomSigName" SG_ 950 VC_BU_TRLR_CSO "VehCfgCSM2_BuPkt";
BA_ "FlexKomSigLaenge" SG_ 950 VC_BU_TRLR_CSO 64;
BA_ "FlexKomSID" SG_ 950 VC_BU_TRLR_CSO 2009;
BA_ "FlexKomIsMotorola" SG_ 950 VC_BU_TRLR_CSO 1;
BA_ "FlexKomComment" SG_ 950 VC_BU_TRLR_CSO "Backup for veh config - customer settings menu 2 p";
BA_ "GenSigSNA" SG_ 950 VC_BU_TRLR_NAME_CSO "0h";
BA_ "GenSigSendType" SG_ 950 VC_BU_TRLR_NAME_CSO 1;
BA_ "FlexKomSigStartValue" SG_ 950 VC_BU_TRLR_NAME_CSO "0300000000000000h";
BA_ "FlexKomSigStartPos" SG_ 950 VC_BU_TRLR_NAME_CSO 7;
BA_ "FlexKomSigName" SG_ 950 VC_BU_TRLR_NAME_CSO "VehCfgCSM2_BuPkt";
BA_ "FlexKomSigLaenge" SG_ 950 VC_BU_TRLR_NAME_CSO 64;
BA_ "FlexKomSID" SG_ 950 VC_BU_TRLR_NAME_CSO 2009;
BA_ "FlexKomIsMotorola" SG_ 950 VC_BU_TRLR_NAME_CSO 1;
BA_ "FlexKomComment" SG_ 950 VC_BU_TRLR_NAME_CSO "Backup for veh config - customer settings menu 2 p";
BA_ "GenSigSNA" SG_ 950 VC_BU_TRLR_TYPE_CSO "0h";
BA_ "GenSigSendType" SG_ 950 VC_BU_TRLR_TYPE_CSO 1;
BA_ "FlexKomSigStartValue" SG_ 950 VC_BU_TRLR_TYPE_CSO "0300000000000000h";
BA_ "FlexKomSigStartPos" SG_ 950 VC_BU_TRLR_TYPE_CSO 7;
BA_ "FlexKomSigName" SG_ 950 VC_BU_TRLR_TYPE_CSO "VehCfgCSM2_BuPkt";
BA_ "FlexKomSigLaenge" SG_ 950 VC_BU_TRLR_TYPE_CSO 64;
BA_ "FlexKomSID" SG_ 950 VC_BU_TRLR_TYPE_CSO 2009;
BA_ "FlexKomIsMotorola" SG_ 950 VC_BU_TRLR_TYPE_CSO 1;
BA_ "FlexKomComment" SG_ 950 VC_BU_TRLR_TYPE_CSO "Backup for veh config - customer settings menu 2 p";
BA_ "GenSigSNA" SG_ 950 VC_BU_TRNS_MD_CSO "0h";
BA_ "GenSigSendType" SG_ 950 VC_BU_TRNS_MD_CSO 1;
BA_ "FlexKomSigStartValue" SG_ 950 VC_BU_TRNS_MD_CSO "0300000000000000h";
BA_ "FlexKomSigStartPos" SG_ 950 VC_BU_TRNS_MD_CSO 7;
BA_ "FlexKomSigName" SG_ 950 VC_BU_TRNS_MD_CSO "VehCfgCSM2_BuPkt";
BA_ "FlexKomSigLaenge" SG_ 950 VC_BU_TRNS_MD_CSO 64;
BA_ "FlexKomSID" SG_ 950 VC_BU_TRNS_MD_CSO 2009;
BA_ "FlexKomIsMotorola" SG_ 950 VC_BU_TRNS_MD_CSO 1;
BA_ "FlexKomComment" SG_ 950 VC_BU_TRNS_MD_CSO "Backup for veh config - customer settings menu 2 p";
BA_ "GenSigSNA" SG_ 950 VC_BU_US_METRIC_CSO "0h";
BA_ "GenSigSendType" SG_ 950 VC_BU_US_METRIC_CSO 1;
BA_ "FlexKomSigStartValue" SG_ 950 VC_BU_US_METRIC_CSO "0300000000000000h";
BA_ "FlexKomSigStartPos" SG_ 950 VC_BU_US_METRIC_CSO 7;
BA_ "FlexKomSigName" SG_ 950 VC_BU_US_METRIC_CSO "VehCfgCSM2_BuPkt";
BA_ "FlexKomSigLaenge" SG_ 950 VC_BU_US_METRIC_CSO 64;
BA_ "FlexKomSID" SG_ 950 VC_BU_US_METRIC_CSO 2009;
BA_ "FlexKomIsMotorola" SG_ 950 VC_BU_US_METRIC_CSO 1;
BA_ "FlexKomComment" SG_ 950 VC_BU_US_METRIC_CSO "Backup for veh config - customer settings menu 2 p";
BA_ "GenSigStartValue" SG_ 950 VC_BU_VehCfgCSO2_Stat 3;
BA_ "GenSigSNA" SG_ 950 VC_BU_VehCfgCSO2_Stat "3h";
BA_ "GenSigSendType" SG_ 950 VC_BU_VehCfgCSO2_Stat 1;
BA_ "FlexKomSigStartValue" SG_ 950 VC_BU_VehCfgCSO2_Stat "0300000000000000h";
BA_ "FlexKomSigStartPos" SG_ 950 VC_BU_VehCfgCSO2_Stat 7;
BA_ "FlexKomSigName" SG_ 950 VC_BU_VehCfgCSO2_Stat "VehCfgCSM2_BuPkt";
BA_ "FlexKomSigLaenge" SG_ 950 VC_BU_VehCfgCSO2_Stat 64;
BA_ "FlexKomSID" SG_ 950 VC_BU_VehCfgCSO2_Stat 2009;
BA_ "FlexKomIsMotorola" SG_ 950 VC_BU_VehCfgCSO2_Stat 1;
BA_ "FlexKomComment" SG_ 950 VC_BU_VehCfgCSO2_Stat "Backup for veh config - customer settings menu 2 p";
BA_ "GenSigSNA" SG_ 950 VC_BU_WHL_ALGN_CSO "0h";
BA_ "GenSigSendType" SG_ 950 VC_BU_WHL_ALGN_CSO 1;
BA_ "FlexKomSigStartValue" SG_ 950 VC_BU_WHL_ALGN_CSO "0300000000000000h";
BA_ "FlexKomSigStartPos" SG_ 950 VC_BU_WHL_ALGN_CSO 7;
BA_ "FlexKomSigName" SG_ 950 VC_BU_WHL_ALGN_CSO "VehCfgCSM2_BuPkt";
BA_ "FlexKomSigLaenge" SG_ 950 VC_BU_WHL_ALGN_CSO 64;
BA_ "FlexKomSID" SG_ 950 VC_BU_WHL_ALGN_CSO 2009;
BA_ "FlexKomIsMotorola" SG_ 950 VC_BU_WHL_ALGN_CSO 1;
BA_ "FlexKomComment" SG_ 950 VC_BU_WHL_ALGN_CSO "Backup for veh config - customer settings menu 2 p";
BA_ "GenSigSNA" SG_ 962 VC_3RD_ROW_LOCK_CSO "0h";
BA_ "GenSigSendType" SG_ 962 VC_3RD_ROW_LOCK_CSO 5;
BA_ "GenSigCycleTime" SG_ 962 VC_3RD_ROW_LOCK_CSO 2000;
BA_ "FlexKomSigStartValue" SG_ 962 VC_3RD_ROW_LOCK_CSO "0300000000000000h";
BA_ "FlexKomSigStartPos" SG_ 962 VC_3RD_ROW_LOCK_CSO 7;
BA_ "FlexKomSigName" SG_ 962 VC_3RD_ROW_LOCK_CSO "VehCfgCSM3_Pkt";
BA_ "FlexKomSigLaenge" SG_ 962 VC_3RD_ROW_LOCK_CSO 64;
BA_ "FlexKomSID" SG_ 962 VC_3RD_ROW_LOCK_CSO 2720;
BA_ "FlexKomIsMotorola" SG_ 962 VC_3RD_ROW_LOCK_CSO 1;
BA_ "FlexKomComment" SG_ 962 VC_3RD_ROW_LOCK_CSO "Vehicle configuration - customer settings menu 3 P";
BA_ "GenSigSNA" SG_ 962 VC_AL_FFC_OR_PLUS_CSO "0h";
BA_ "GenSigSendType" SG_ 962 VC_AL_FFC_OR_PLUS_CSO 5;
BA_ "GenSigCycleTime" SG_ 962 VC_AL_FFC_OR_PLUS_CSO 2000;
BA_ "FlexKomSigStartValue" SG_ 962 VC_AL_FFC_OR_PLUS_CSO "0300000000000000h";
BA_ "FlexKomSigStartPos" SG_ 962 VC_AL_FFC_OR_PLUS_CSO 7;
BA_ "FlexKomSigName" SG_ 962 VC_AL_FFC_OR_PLUS_CSO "VehCfgCSM3_Pkt";
BA_ "FlexKomSigLaenge" SG_ 962 VC_AL_FFC_OR_PLUS_CSO 64;
BA_ "FlexKomSID" SG_ 962 VC_AL_FFC_OR_PLUS_CSO 2720;
BA_ "FlexKomIsMotorola" SG_ 962 VC_AL_FFC_OR_PLUS_CSO 1;
BA_ "FlexKomComment" SG_ 962 VC_AL_FFC_OR_PLUS_CSO "Vehicle configuration - customer settings menu 3 P";
BA_ "GenSigSNA" SG_ 962 VC_AL_OR_PLUS_CSO "0h";
BA_ "GenSigSendType" SG_ 962 VC_AL_OR_PLUS_CSO 5;
BA_ "GenSigCycleTime" SG_ 962 VC_AL_OR_PLUS_CSO 2000;
BA_ "FlexKomSigStartValue" SG_ 962 VC_AL_OR_PLUS_CSO "0300000000000000h";
BA_ "FlexKomSigStartPos" SG_ 962 VC_AL_OR_PLUS_CSO 7;
BA_ "FlexKomSigName" SG_ 962 VC_AL_OR_PLUS_CSO "VehCfgCSM3_Pkt";
BA_ "FlexKomSigLaenge" SG_ 962 VC_AL_OR_PLUS_CSO 64;
BA_ "FlexKomSID" SG_ 962 VC_AL_OR_PLUS_CSO 2720;
BA_ "FlexKomIsMotorola" SG_ 962 VC_AL_OR_PLUS_CSO 1;
BA_ "FlexKomComment" SG_ 962 VC_AL_OR_PLUS_CSO "Vehicle configuration - customer settings menu 3 P";
BA_ "GenSigSNA" SG_ 962 VC_AUTO_STOP_START_CSO "0h";
BA_ "GenSigSendType" SG_ 962 VC_AUTO_STOP_START_CSO 5;
BA_ "GenSigCycleTime" SG_ 962 VC_AUTO_STOP_START_CSO 2000;
BA_ "FlexKomSigStartValue" SG_ 962 VC_AUTO_STOP_START_CSO "0300000000000000h";
BA_ "FlexKomSigStartPos" SG_ 962 VC_AUTO_STOP_START_CSO 7;
BA_ "FlexKomSigName" SG_ 962 VC_AUTO_STOP_START_CSO "VehCfgCSM3_Pkt";
BA_ "FlexKomSigLaenge" SG_ 962 VC_AUTO_STOP_START_CSO 64;
BA_ "FlexKomSID" SG_ 962 VC_AUTO_STOP_START_CSO 2720;
BA_ "FlexKomIsMotorola" SG_ 962 VC_AUTO_STOP_START_CSO 1;
BA_ "FlexKomComment" SG_ 962 VC_AUTO_STOP_START_CSO "Vehicle configuration - customer settings menu 3 P";
BA_ "GenSigSNA" SG_ 962 VC_Auto_Activ_PerfPage_CSO "0h";
BA_ "GenSigSendType" SG_ 962 VC_Auto_Activ_PerfPage_CSO 5;
BA_ "GenSigCycleTime" SG_ 962 VC_Auto_Activ_PerfPage_CSO 2000;
BA_ "FlexKomSigStartValue" SG_ 962 VC_Auto_Activ_PerfPage_CSO "0300000000000000h";
BA_ "FlexKomSigStartPos" SG_ 962 VC_Auto_Activ_PerfPage_CSO 7;
BA_ "FlexKomSigName" SG_ 962 VC_Auto_Activ_PerfPage_CSO "VehCfgCSM3_Pkt";
BA_ "FlexKomSigLaenge" SG_ 962 VC_Auto_Activ_PerfPage_CSO 64;
BA_ "FlexKomSID" SG_ 962 VC_Auto_Activ_PerfPage_CSO 2720;
BA_ "FlexKomIsMotorola" SG_ 962 VC_Auto_Activ_PerfPage_CSO 1;
BA_ "FlexKomComment" SG_ 962 VC_Auto_Activ_PerfPage_CSO "Vehicle configuration - customer settings menu 3 P";
BA_ "GenSigSNA" SG_ 962 VC_BACKUP_ALARM_CSO "0h";
BA_ "GenSigSendType" SG_ 962 VC_BACKUP_ALARM_CSO 5;
BA_ "GenSigCycleTime" SG_ 962 VC_BACKUP_ALARM_CSO 2000;
BA_ "FlexKomSigStartValue" SG_ 962 VC_BACKUP_ALARM_CSO "0300000000000000h";
BA_ "FlexKomSigStartPos" SG_ 962 VC_BACKUP_ALARM_CSO 7;
BA_ "FlexKomSigName" SG_ 962 VC_BACKUP_ALARM_CSO "VehCfgCSM3_Pkt";
BA_ "FlexKomSigLaenge" SG_ 962 VC_BACKUP_ALARM_CSO 64;
BA_ "FlexKomSID" SG_ 962 VC_BACKUP_ALARM_CSO 2720;
BA_ "FlexKomIsMotorola" SG_ 962 VC_BACKUP_ALARM_CSO 1;
BA_ "FlexKomComment" SG_ 962 VC_BACKUP_ALARM_CSO "Vehicle configuration - customer settings menu 3 P";
BA_ "GenSigSNA" SG_ 962 VC_BUZZER_VOLUME_LEVEL_CSO "0h";
BA_ "GenSigSendType" SG_ 962 VC_BUZZER_VOLUME_LEVEL_CSO 5;
BA_ "GenSigCycleTime" SG_ 962 VC_BUZZER_VOLUME_LEVEL_CSO 2000;
BA_ "FlexKomSigStartValue" SG_ 962 VC_BUZZER_VOLUME_LEVEL_CSO "0300000000000000h";
BA_ "FlexKomSigStartPos" SG_ 962 VC_BUZZER_VOLUME_LEVEL_CSO 7;
BA_ "FlexKomSigName" SG_ 962 VC_BUZZER_VOLUME_LEVEL_CSO "VehCfgCSM3_Pkt";
BA_ "FlexKomSigLaenge" SG_ 962 VC_BUZZER_VOLUME_LEVEL_CSO 64;
BA_ "FlexKomSID" SG_ 962 VC_BUZZER_VOLUME_LEVEL_CSO 2720;
BA_ "FlexKomIsMotorola" SG_ 962 VC_BUZZER_VOLUME_LEVEL_CSO 1;
BA_ "FlexKomComment" SG_ 962 VC_BUZZER_VOLUME_LEVEL_CSO "Vehicle configuration - customer settings menu 3 P";
BA_ "GenSigSNA" SG_ 962 VC_CHARGE_LOW_POPUP_CSO "0h";
BA_ "GenSigSendType" SG_ 962 VC_CHARGE_LOW_POPUP_CSO 5;
BA_ "GenSigCycleTime" SG_ 962 VC_CHARGE_LOW_POPUP_CSO 2000;
BA_ "FlexKomSigStartValue" SG_ 962 VC_CHARGE_LOW_POPUP_CSO "0300000000000000h";
BA_ "FlexKomSigStartPos" SG_ 962 VC_CHARGE_LOW_POPUP_CSO 7;
BA_ "FlexKomSigName" SG_ 962 VC_CHARGE_LOW_POPUP_CSO "VehCfgCSM3_Pkt";
BA_ "FlexKomSigLaenge" SG_ 962 VC_CHARGE_LOW_POPUP_CSO 64;
BA_ "FlexKomSID" SG_ 962 VC_CHARGE_LOW_POPUP_CSO 2720;
BA_ "FlexKomIsMotorola" SG_ 962 VC_CHARGE_LOW_POPUP_CSO 1;
BA_ "FlexKomComment" SG_ 962 VC_CHARGE_LOW_POPUP_CSO "Vehicle configuration - customer settings menu 3 P";
BA_ "GenSigSNA" SG_ 962 VC_CHMSL_DYN_CNTR_CSO "0h";
BA_ "GenSigSendType" SG_ 962 VC_CHMSL_DYN_CNTR_CSO 5;
BA_ "GenSigCycleTime" SG_ 962 VC_CHMSL_DYN_CNTR_CSO 2000;
BA_ "FlexKomSigStartValue" SG_ 962 VC_CHMSL_DYN_CNTR_CSO "0300000000000000h";
BA_ "FlexKomSigStartPos" SG_ 962 VC_CHMSL_DYN_CNTR_CSO 7;
BA_ "FlexKomSigName" SG_ 962 VC_CHMSL_DYN_CNTR_CSO "VehCfgCSM3_Pkt";
BA_ "FlexKomSigLaenge" SG_ 962 VC_CHMSL_DYN_CNTR_CSO 64;
BA_ "FlexKomSID" SG_ 962 VC_CHMSL_DYN_CNTR_CSO 2720;
BA_ "FlexKomIsMotorola" SG_ 962 VC_CHMSL_DYN_CNTR_CSO 1;
BA_ "FlexKomComment" SG_ 962 VC_CHMSL_DYN_CNTR_CSO "Vehicle configuration - customer settings menu 3 P";
BA_ "GenSigSNA" SG_ 962 VC_ESAVE_BATT_LVL_CSO "0h";
BA_ "GenSigSendType" SG_ 962 VC_ESAVE_BATT_LVL_CSO 5;
BA_ "GenSigCycleTime" SG_ 962 VC_ESAVE_BATT_LVL_CSO 2000;
BA_ "FlexKomSigStartValue" SG_ 962 VC_ESAVE_BATT_LVL_CSO "0300000000000000h";
BA_ "FlexKomSigStartPos" SG_ 962 VC_ESAVE_BATT_LVL_CSO 7;
BA_ "FlexKomSigName" SG_ 962 VC_ESAVE_BATT_LVL_CSO "VehCfgCSM3_Pkt";
BA_ "FlexKomSigLaenge" SG_ 962 VC_ESAVE_BATT_LVL_CSO 64;
BA_ "FlexKomSID" SG_ 962 VC_ESAVE_BATT_LVL_CSO 2720;
BA_ "FlexKomIsMotorola" SG_ 962 VC_ESAVE_BATT_LVL_CSO 1;
BA_ "FlexKomComment" SG_ 962 VC_ESAVE_BATT_LVL_CSO "E-Save Battery Level customer settings menu";
BA_ "GenSigSNA" SG_ 962 VC_ESAVE_CSO "0h";
BA_ "GenSigSendType" SG_ 962 VC_ESAVE_CSO 5;
BA_ "GenSigCycleTime" SG_ 962 VC_ESAVE_CSO 2000;
BA_ "FlexKomSigStartValue" SG_ 962 VC_ESAVE_CSO "0300000000000000h";
BA_ "FlexKomSigStartPos" SG_ 962 VC_ESAVE_CSO 7;
BA_ "FlexKomSigName" SG_ 962 VC_ESAVE_CSO "VehCfgCSM3_Pkt";
BA_ "FlexKomSigLaenge" SG_ 962 VC_ESAVE_CSO 64;
BA_ "FlexKomSID" SG_ 962 VC_ESAVE_CSO 2720;
BA_ "FlexKomIsMotorola" SG_ 962 VC_ESAVE_CSO 1;
BA_ "FlexKomComment" SG_ 962 VC_ESAVE_CSO "E-Save Enable/Disable customer settings menu";
BA_ "GenSigSNA" SG_ 962 VC_EXTERNAL_LIGHT_SENSOR_CSO "0h";
BA_ "GenSigSendType" SG_ 962 VC_EXTERNAL_LIGHT_SENSOR_CSO 5;
BA_ "GenSigCycleTime" SG_ 962 VC_EXTERNAL_LIGHT_SENSOR_CSO 2000;
BA_ "FlexKomSigStartValue" SG_ 962 VC_EXTERNAL_LIGHT_SENSOR_CSO "0300000000000000h";
BA_ "FlexKomSigStartPos" SG_ 962 VC_EXTERNAL_LIGHT_SENSOR_CSO 7;
BA_ "FlexKomSigName" SG_ 962 VC_EXTERNAL_LIGHT_SENSOR_CSO "VehCfgCSM3_Pkt";
BA_ "FlexKomSigLaenge" SG_ 962 VC_EXTERNAL_LIGHT_SENSOR_CSO 64;
BA_ "FlexKomSID" SG_ 962 VC_EXTERNAL_LIGHT_SENSOR_CSO 2720;
BA_ "FlexKomIsMotorola" SG_ 962 VC_EXTERNAL_LIGHT_SENSOR_CSO 1;
BA_ "FlexKomComment" SG_ 962 VC_EXTERNAL_LIGHT_SENSOR_CSO "Vehicle configuration - customer settings menu 3 P";
BA_ "GenSigSNA" SG_ 962 VC_FFC_GRIDLINES_CSO "0h";
BA_ "GenSigSendType" SG_ 962 VC_FFC_GRIDLINES_CSO 5;
BA_ "GenSigCycleTime" SG_ 962 VC_FFC_GRIDLINES_CSO 2000;
BA_ "FlexKomSigStartValue" SG_ 962 VC_FFC_GRIDLINES_CSO "0300000000000000h";
BA_ "FlexKomSigStartPos" SG_ 962 VC_FFC_GRIDLINES_CSO 7;
BA_ "FlexKomSigName" SG_ 962 VC_FFC_GRIDLINES_CSO "VehCfgCSM3_Pkt";
BA_ "FlexKomSigLaenge" SG_ 962 VC_FFC_GRIDLINES_CSO 64;
BA_ "FlexKomSID" SG_ 962 VC_FFC_GRIDLINES_CSO 2720;
BA_ "FlexKomIsMotorola" SG_ 962 VC_FFC_GRIDLINES_CSO 1;
BA_ "FlexKomComment" SG_ 962 VC_FFC_GRIDLINES_CSO "Vehicle configuration - customer settings menu 3 P";
BA_ "GenSigSNA" SG_ 962 VC_FOBIK_SAFE_CSO "0h";
BA_ "GenSigSendType" SG_ 962 VC_FOBIK_SAFE_CSO 5;
BA_ "GenSigCycleTime" SG_ 962 VC_FOBIK_SAFE_CSO 2000;
BA_ "FlexKomSigStartValue" SG_ 962 VC_FOBIK_SAFE_CSO "0300000000000000h";
BA_ "FlexKomSigStartPos" SG_ 962 VC_FOBIK_SAFE_CSO 7;
BA_ "FlexKomSigName" SG_ 962 VC_FOBIK_SAFE_CSO "VehCfgCSM3_Pkt";
BA_ "FlexKomSigLaenge" SG_ 962 VC_FOBIK_SAFE_CSO 64;
BA_ "FlexKomSID" SG_ 962 VC_FOBIK_SAFE_CSO 2720;
BA_ "FlexKomIsMotorola" SG_ 962 VC_FOBIK_SAFE_CSO 1;
BA_ "FlexKomComment" SG_ 962 VC_FOBIK_SAFE_CSO "Vehicle configuration - customer settings menu 3 P";
BA_ "GenSigSNA" SG_ 962 VC_FOB_LEFT_VEHICLE_CHIME_CSO "0h";
BA_ "GenSigSendType" SG_ 962 VC_FOB_LEFT_VEHICLE_CHIME_CSO 5;
BA_ "GenSigCycleTime" SG_ 962 VC_FOB_LEFT_VEHICLE_CHIME_CSO 2000;
BA_ "FlexKomSigStartValue" SG_ 962 VC_FOB_LEFT_VEHICLE_CHIME_CSO "0300000000000000h";
BA_ "FlexKomSigStartPos" SG_ 962 VC_FOB_LEFT_VEHICLE_CHIME_CSO 7;
BA_ "FlexKomSigName" SG_ 962 VC_FOB_LEFT_VEHICLE_CHIME_CSO "VehCfgCSM3_Pkt";
BA_ "FlexKomSigLaenge" SG_ 962 VC_FOB_LEFT_VEHICLE_CHIME_CSO 64;
BA_ "FlexKomSID" SG_ 962 VC_FOB_LEFT_VEHICLE_CHIME_CSO 2720;
BA_ "FlexKomIsMotorola" SG_ 962 VC_FOB_LEFT_VEHICLE_CHIME_CSO 1;
BA_ "FlexKomComment" SG_ 962 VC_FOB_LEFT_VEHICLE_CHIME_CSO "Vehicle configuration - customer settings menu 3 P";
BA_ "GenSigSNA" SG_ 962 VC_FT_PK_LOOSE_SHIP_CSO "0h";
BA_ "GenSigSendType" SG_ 962 VC_FT_PK_LOOSE_SHIP_CSO 5;
BA_ "GenSigCycleTime" SG_ 962 VC_FT_PK_LOOSE_SHIP_CSO 2000;
BA_ "FlexKomSigStartValue" SG_ 962 VC_FT_PK_LOOSE_SHIP_CSO "0300000000000000h";
BA_ "FlexKomSigStartPos" SG_ 962 VC_FT_PK_LOOSE_SHIP_CSO 7;
BA_ "FlexKomSigName" SG_ 962 VC_FT_PK_LOOSE_SHIP_CSO "VehCfgCSM3_Pkt";
BA_ "FlexKomSigLaenge" SG_ 962 VC_FT_PK_LOOSE_SHIP_CSO 64;
BA_ "FlexKomSID" SG_ 962 VC_FT_PK_LOOSE_SHIP_CSO 2720;
BA_ "FlexKomIsMotorola" SG_ 962 VC_FT_PK_LOOSE_SHIP_CSO 1;
BA_ "FlexKomComment" SG_ 962 VC_FT_PK_LOOSE_SHIP_CSO "Vehicle configuration - customer settings menu 3 P";
BA_ "GenSigSNA" SG_ 962 VC_HWRSS_CSO "0h";
BA_ "GenSigSendType" SG_ 962 VC_HWRSS_CSO 5;
BA_ "GenSigCycleTime" SG_ 962 VC_HWRSS_CSO 2000;
BA_ "FlexKomSigStartValue" SG_ 962 VC_HWRSS_CSO "0300000000000000h";
BA_ "FlexKomSigStartPos" SG_ 962 VC_HWRSS_CSO 7;
BA_ "FlexKomSigName" SG_ 962 VC_HWRSS_CSO "VehCfgCSM3_Pkt";
BA_ "FlexKomSigLaenge" SG_ 962 VC_HWRSS_CSO 64;
BA_ "FlexKomSID" SG_ 962 VC_HWRSS_CSO 2720;
BA_ "FlexKomIsMotorola" SG_ 962 VC_HWRSS_CSO 1;
BA_ "FlexKomComment" SG_ 962 VC_HWRSS_CSO "Vehicle configuration - customer settings menu 3 P";
BA_ "GenSigSNA" SG_ 962 VC_LIFT_GATE_RELEASE_CSO "0h";
BA_ "GenSigSendType" SG_ 962 VC_LIFT_GATE_RELEASE_CSO 5;
BA_ "GenSigCycleTime" SG_ 962 VC_LIFT_GATE_RELEASE_CSO 2000;
BA_ "FlexKomSigStartValue" SG_ 962 VC_LIFT_GATE_RELEASE_CSO "0300000000000000h";
BA_ "FlexKomSigStartPos" SG_ 962 VC_LIFT_GATE_RELEASE_CSO 7;
BA_ "FlexKomSigName" SG_ 962 VC_LIFT_GATE_RELEASE_CSO "VehCfgCSM3_Pkt";
BA_ "FlexKomSigLaenge" SG_ 962 VC_LIFT_GATE_RELEASE_CSO 64;
BA_ "FlexKomSID" SG_ 962 VC_LIFT_GATE_RELEASE_CSO 2720;
BA_ "FlexKomIsMotorola" SG_ 962 VC_LIFT_GATE_RELEASE_CSO 1;
BA_ "FlexKomComment" SG_ 962 VC_LIFT_GATE_RELEASE_CSO "Vehicle configuration - customer settings menu 3 P";
BA_ "GenSigSNA" SG_ 962 VC_LKA_SENS_CSO "0h";
BA_ "GenSigSendType" SG_ 962 VC_LKA_SENS_CSO 5;
BA_ "GenSigCycleTime" SG_ 962 VC_LKA_SENS_CSO 2000;
BA_ "FlexKomSigStartValue" SG_ 962 VC_LKA_SENS_CSO "0300000000000000h";
BA_ "FlexKomSigStartPos" SG_ 962 VC_LKA_SENS_CSO 7;
BA_ "FlexKomSigName" SG_ 962 VC_LKA_SENS_CSO "VehCfgCSM3_Pkt";
BA_ "FlexKomSigLaenge" SG_ 962 VC_LKA_SENS_CSO 64;
BA_ "FlexKomSID" SG_ 962 VC_LKA_SENS_CSO 2720;
BA_ "FlexKomIsMotorola" SG_ 962 VC_LKA_SENS_CSO 1;
BA_ "FlexKomComment" SG_ 962 VC_LKA_SENS_CSO "Vehicle configuration - customer settings menu 3 P";
BA_ "GenSigSNA" SG_ 962 VC_LKA_STRN_CSO "0h";
BA_ "GenSigSendType" SG_ 962 VC_LKA_STRN_CSO 5;
BA_ "GenSigCycleTime" SG_ 962 VC_LKA_STRN_CSO 2000;
BA_ "FlexKomSigStartValue" SG_ 962 VC_LKA_STRN_CSO "0300000000000000h";
BA_ "FlexKomSigStartPos" SG_ 962 VC_LKA_STRN_CSO 7;
BA_ "FlexKomSigName" SG_ 962 VC_LKA_STRN_CSO "VehCfgCSM3_Pkt";
BA_ "FlexKomSigLaenge" SG_ 962 VC_LKA_STRN_CSO 64;
BA_ "FlexKomSID" SG_ 962 VC_LKA_STRN_CSO 2720;
BA_ "FlexKomIsMotorola" SG_ 962 VC_LKA_STRN_CSO 1;
BA_ "FlexKomComment" SG_ 962 VC_LKA_STRN_CSO "Vehicle configuration - customer settings menu 3 P";
BA_ "GenSigSNA" SG_ 962 VC_LKA_WARNING_CSO "0h";
BA_ "GenSigSendType" SG_ 962 VC_LKA_WARNING_CSO 5;
BA_ "GenSigCycleTime" SG_ 962 VC_LKA_WARNING_CSO 2000;
BA_ "FlexKomSigStartValue" SG_ 962 VC_LKA_WARNING_CSO "0300000000000000h";
BA_ "FlexKomSigStartPos" SG_ 962 VC_LKA_WARNING_CSO 7;
BA_ "FlexKomSigName" SG_ 962 VC_LKA_WARNING_CSO "VehCfgCSM3_Pkt";
BA_ "FlexKomSigLaenge" SG_ 962 VC_LKA_WARNING_CSO 64;
BA_ "FlexKomSID" SG_ 962 VC_LKA_WARNING_CSO 2720;
BA_ "FlexKomIsMotorola" SG_ 962 VC_LKA_WARNING_CSO 1;
BA_ "FlexKomComment" SG_ 962 VC_LKA_WARNING_CSO "Vehicle configuration - customer settings menu 3 P";
BA_ "GenSigSNA" SG_ 962 VC_PANIC_ALARM_CSO "0h";
BA_ "GenSigSendType" SG_ 962 VC_PANIC_ALARM_CSO 5;
BA_ "GenSigCycleTime" SG_ 962 VC_PANIC_ALARM_CSO 2000;
BA_ "FlexKomSigStartValue" SG_ 962 VC_PANIC_ALARM_CSO "0300000000000000h";
BA_ "FlexKomSigStartPos" SG_ 962 VC_PANIC_ALARM_CSO 7;
BA_ "FlexKomSigName" SG_ 962 VC_PANIC_ALARM_CSO "VehCfgCSM3_Pkt";
BA_ "FlexKomSigLaenge" SG_ 962 VC_PANIC_ALARM_CSO 64;
BA_ "FlexKomSID" SG_ 962 VC_PANIC_ALARM_CSO 2720;
BA_ "FlexKomIsMotorola" SG_ 962 VC_PANIC_ALARM_CSO 1;
BA_ "FlexKomComment" SG_ 962 VC_PANIC_ALARM_CSO "Vehicle configuration - customer settings menu 3 P";
BA_ "GenSigSNA" SG_ 962 VC_PEB_CSO "0h";
BA_ "GenSigSendType" SG_ 962 VC_PEB_CSO 5;
BA_ "GenSigCycleTime" SG_ 962 VC_PEB_CSO 2000;
BA_ "FlexKomSigStartValue" SG_ 962 VC_PEB_CSO "0300000000000000h";
BA_ "FlexKomSigStartPos" SG_ 962 VC_PEB_CSO 7;
BA_ "FlexKomSigName" SG_ 962 VC_PEB_CSO "VehCfgCSM3_Pkt";
BA_ "FlexKomSigLaenge" SG_ 962 VC_PEB_CSO 64;
BA_ "FlexKomSID" SG_ 962 VC_PEB_CSO 2720;
BA_ "FlexKomIsMotorola" SG_ 962 VC_PEB_CSO 1;
BA_ "FlexKomComment" SG_ 962 VC_PEB_CSO "Vehicle configuration - customer settings menu 3 P";
BA_ "GenSigSNA" SG_ 962 VC_POWER_SIDE_STEP_CSO "0h";
BA_ "GenSigSendType" SG_ 962 VC_POWER_SIDE_STEP_CSO 5;
BA_ "GenSigCycleTime" SG_ 962 VC_POWER_SIDE_STEP_CSO 2000;
BA_ "FlexKomSigStartValue" SG_ 962 VC_POWER_SIDE_STEP_CSO "0300000000000000h";
BA_ "FlexKomSigStartPos" SG_ 962 VC_POWER_SIDE_STEP_CSO 7;
BA_ "FlexKomSigName" SG_ 962 VC_POWER_SIDE_STEP_CSO "VehCfgCSM3_Pkt";
BA_ "FlexKomSigLaenge" SG_ 962 VC_POWER_SIDE_STEP_CSO 64;
BA_ "FlexKomSID" SG_ 962 VC_POWER_SIDE_STEP_CSO 2720;
BA_ "FlexKomIsMotorola" SG_ 962 VC_POWER_SIDE_STEP_CSO 1;
BA_ "FlexKomComment" SG_ 962 VC_POWER_SIDE_STEP_CSO "Vehicle configuration - customer settings menu 3 P";
BA_ "GenSigSNA" SG_ 962 VC_RR_CARGO_GUIDE_LGT_CSO "0h";
BA_ "GenSigSendType" SG_ 962 VC_RR_CARGO_GUIDE_LGT_CSO 5;
BA_ "GenSigCycleTime" SG_ 962 VC_RR_CARGO_GUIDE_LGT_CSO 2000;
BA_ "FlexKomSigStartValue" SG_ 962 VC_RR_CARGO_GUIDE_LGT_CSO "0300000000000000h";
BA_ "FlexKomSigStartPos" SG_ 962 VC_RR_CARGO_GUIDE_LGT_CSO 7;
BA_ "FlexKomSigName" SG_ 962 VC_RR_CARGO_GUIDE_LGT_CSO "VehCfgCSM3_Pkt";
BA_ "FlexKomSigLaenge" SG_ 962 VC_RR_CARGO_GUIDE_LGT_CSO 64;
BA_ "FlexKomSID" SG_ 962 VC_RR_CARGO_GUIDE_LGT_CSO 2720;
BA_ "FlexKomIsMotorola" SG_ 962 VC_RR_CARGO_GUIDE_LGT_CSO 1;
BA_ "FlexKomComment" SG_ 962 VC_RR_CARGO_GUIDE_LGT_CSO "Vehicle configuration - customer settings menu 3 P";
BA_ "GenSigSNA" SG_ 962 VC_RR_PK_LOOSE_SHIP_CSO "0h";
BA_ "GenSigSendType" SG_ 962 VC_RR_PK_LOOSE_SHIP_CSO 5;
BA_ "GenSigCycleTime" SG_ 962 VC_RR_PK_LOOSE_SHIP_CSO 2000;
BA_ "FlexKomSigStartValue" SG_ 962 VC_RR_PK_LOOSE_SHIP_CSO "0300000000000000h";
BA_ "FlexKomSigStartPos" SG_ 962 VC_RR_PK_LOOSE_SHIP_CSO 7;
BA_ "FlexKomSigName" SG_ 962 VC_RR_PK_LOOSE_SHIP_CSO "VehCfgCSM3_Pkt";
BA_ "FlexKomSigLaenge" SG_ 962 VC_RR_PK_LOOSE_SHIP_CSO 64;
BA_ "FlexKomSID" SG_ 962 VC_RR_PK_LOOSE_SHIP_CSO 2720;
BA_ "FlexKomIsMotorola" SG_ 962 VC_RR_PK_LOOSE_SHIP_CSO 1;
BA_ "FlexKomComment" SG_ 962 VC_RR_PK_LOOSE_SHIP_CSO "Vehicle configuration - customer settings menu 3 P";
BA_ "GenSigSNA" SG_ 962 VC_RVC_CVPM_DGRID_CSO "0h";
BA_ "GenSigSendType" SG_ 962 VC_RVC_CVPM_DGRID_CSO 5;
BA_ "GenSigCycleTime" SG_ 962 VC_RVC_CVPM_DGRID_CSO 2000;
BA_ "FlexKomSigStartValue" SG_ 962 VC_RVC_CVPM_DGRID_CSO "0300000000000000h";
BA_ "FlexKomSigStartPos" SG_ 962 VC_RVC_CVPM_DGRID_CSO 7;
BA_ "FlexKomSigName" SG_ 962 VC_RVC_CVPM_DGRID_CSO "VehCfgCSM3_Pkt";
BA_ "FlexKomSigLaenge" SG_ 962 VC_RVC_CVPM_DGRID_CSO 64;
BA_ "FlexKomSID" SG_ 962 VC_RVC_CVPM_DGRID_CSO 2720;
BA_ "FlexKomIsMotorola" SG_ 962 VC_RVC_CVPM_DGRID_CSO 1;
BA_ "FlexKomComment" SG_ 962 VC_RVC_CVPM_DGRID_CSO "Vehicle configuration - customer settings menu 3 P";
BA_ "GenSigSNA" SG_ 962 VC_RVC_CVPM_SGRID_CSO "0h";
BA_ "GenSigSendType" SG_ 962 VC_RVC_CVPM_SGRID_CSO 5;
BA_ "GenSigCycleTime" SG_ 962 VC_RVC_CVPM_SGRID_CSO 2000;
BA_ "FlexKomSigStartValue" SG_ 962 VC_RVC_CVPM_SGRID_CSO "0300000000000000h";
BA_ "FlexKomSigStartPos" SG_ 962 VC_RVC_CVPM_SGRID_CSO 7;
BA_ "FlexKomSigName" SG_ 962 VC_RVC_CVPM_SGRID_CSO "VehCfgCSM3_Pkt";
BA_ "FlexKomSigLaenge" SG_ 962 VC_RVC_CVPM_SGRID_CSO 64;
BA_ "FlexKomSID" SG_ 962 VC_RVC_CVPM_SGRID_CSO 2720;
BA_ "FlexKomIsMotorola" SG_ 962 VC_RVC_CVPM_SGRID_CSO 1;
BA_ "FlexKomComment" SG_ 962 VC_RVC_CVPM_SGRID_CSO "Vehicle configuration - customer settings menu 3 P";
BA_ "GenSigSNA" SG_ 962 VC_SECURE_PARK_CSO "0h";
BA_ "GenSigSendType" SG_ 962 VC_SECURE_PARK_CSO 5;
BA_ "GenSigCycleTime" SG_ 962 VC_SECURE_PARK_CSO 2000;
BA_ "FlexKomSigStartValue" SG_ 962 VC_SECURE_PARK_CSO "0300000000000000h";
BA_ "FlexKomSigStartPos" SG_ 962 VC_SECURE_PARK_CSO 7;
BA_ "FlexKomSigName" SG_ 962 VC_SECURE_PARK_CSO "VehCfgCSM3_Pkt";
BA_ "FlexKomSigLaenge" SG_ 962 VC_SECURE_PARK_CSO 64;
BA_ "FlexKomSID" SG_ 962 VC_SECURE_PARK_CSO 2720;
BA_ "FlexKomIsMotorola" SG_ 962 VC_SECURE_PARK_CSO 1;
BA_ "FlexKomComment" SG_ 962 VC_SECURE_PARK_CSO "Vehicle configuration - customer settings menu 3 P";
BA_ "GenSigSNA" SG_ 962 VC_SEIU_INPUT_WIRE_CSO "0h";
BA_ "GenSigSendType" SG_ 962 VC_SEIU_INPUT_WIRE_CSO 5;
BA_ "GenSigCycleTime" SG_ 962 VC_SEIU_INPUT_WIRE_CSO 2000;
BA_ "FlexKomSigStartValue" SG_ 962 VC_SEIU_INPUT_WIRE_CSO "0300000000000000h";
BA_ "FlexKomSigStartPos" SG_ 962 VC_SEIU_INPUT_WIRE_CSO 7;
BA_ "FlexKomSigName" SG_ 962 VC_SEIU_INPUT_WIRE_CSO "VehCfgCSM3_Pkt";
BA_ "FlexKomSigLaenge" SG_ 962 VC_SEIU_INPUT_WIRE_CSO 64;
BA_ "FlexKomSID" SG_ 962 VC_SEIU_INPUT_WIRE_CSO 2720;
BA_ "FlexKomIsMotorola" SG_ 962 VC_SEIU_INPUT_WIRE_CSO 1;
BA_ "FlexKomComment" SG_ 962 VC_SEIU_INPUT_WIRE_CSO "Vehicle configuration - customer settings menu 3 P";
BA_ "GenSigSNA" SG_ 962 VC_SEIU_RPM_CSO "0h";
BA_ "GenSigSendType" SG_ 962 VC_SEIU_RPM_CSO 5;
BA_ "GenSigCycleTime" SG_ 962 VC_SEIU_RPM_CSO 2000;
BA_ "FlexKomSigStartValue" SG_ 962 VC_SEIU_RPM_CSO "0300000000000000h";
BA_ "FlexKomSigStartPos" SG_ 962 VC_SEIU_RPM_CSO 7;
BA_ "FlexKomSigName" SG_ 962 VC_SEIU_RPM_CSO "VehCfgCSM3_Pkt";
BA_ "FlexKomSigLaenge" SG_ 962 VC_SEIU_RPM_CSO 64;
BA_ "FlexKomSID" SG_ 962 VC_SEIU_RPM_CSO 2720;
BA_ "FlexKomIsMotorola" SG_ 962 VC_SEIU_RPM_CSO 1;
BA_ "FlexKomComment" SG_ 962 VC_SEIU_RPM_CSO "Vehicle configuration - customer settings menu 3 P";
BA_ "GenSigSNA" SG_ 962 VC_SPEED_THRESHOLD_CSO "0h";
BA_ "GenSigSendType" SG_ 962 VC_SPEED_THRESHOLD_CSO 5;
BA_ "GenSigCycleTime" SG_ 962 VC_SPEED_THRESHOLD_CSO 2000;
BA_ "FlexKomSigStartValue" SG_ 962 VC_SPEED_THRESHOLD_CSO "0300000000000000h";
BA_ "FlexKomSigStartPos" SG_ 962 VC_SPEED_THRESHOLD_CSO 7;
BA_ "FlexKomSigName" SG_ 962 VC_SPEED_THRESHOLD_CSO "VehCfgCSM3_Pkt";
BA_ "FlexKomSigLaenge" SG_ 962 VC_SPEED_THRESHOLD_CSO 64;
BA_ "FlexKomSID" SG_ 962 VC_SPEED_THRESHOLD_CSO 2720;
BA_ "FlexKomIsMotorola" SG_ 962 VC_SPEED_THRESHOLD_CSO 1;
BA_ "FlexKomComment" SG_ 962 VC_SPEED_THRESHOLD_CSO "Vehicle configuration - customer settings menu 3 P";
BA_ "GenSigSNA" SG_ 962 VC_THEFT_ALARM_CSO "0h";
BA_ "GenSigSendType" SG_ 962 VC_THEFT_ALARM_CSO 5;
BA_ "GenSigCycleTime" SG_ 962 VC_THEFT_ALARM_CSO 2000;
BA_ "FlexKomSigStartValue" SG_ 962 VC_THEFT_ALARM_CSO "0300000000000000h";
BA_ "FlexKomSigStartPos" SG_ 962 VC_THEFT_ALARM_CSO 7;
BA_ "FlexKomSigName" SG_ 962 VC_THEFT_ALARM_CSO "VehCfgCSM3_Pkt";
BA_ "FlexKomSigLaenge" SG_ 962 VC_THEFT_ALARM_CSO 64;
BA_ "FlexKomSID" SG_ 962 VC_THEFT_ALARM_CSO 2720;
BA_ "FlexKomIsMotorola" SG_ 962 VC_THEFT_ALARM_CSO 1;
BA_ "FlexKomComment" SG_ 962 VC_THEFT_ALARM_CSO "Vehicle configuration - customer settings menu 3 P";
BA_ "GenSigSNA" SG_ 962 VC_TIRE_FILL_ALERT_CSO "0h";
BA_ "GenSigSendType" SG_ 962 VC_TIRE_FILL_ALERT_CSO 5;
BA_ "GenSigCycleTime" SG_ 962 VC_TIRE_FILL_ALERT_CSO 2000;
BA_ "FlexKomSigStartValue" SG_ 962 VC_TIRE_FILL_ALERT_CSO "0300000000000000h";
BA_ "FlexKomSigStartPos" SG_ 962 VC_TIRE_FILL_ALERT_CSO 7;
BA_ "FlexKomSigName" SG_ 962 VC_TIRE_FILL_ALERT_CSO "VehCfgCSM3_Pkt";
BA_ "FlexKomSigLaenge" SG_ 962 VC_TIRE_FILL_ALERT_CSO 64;
BA_ "FlexKomSID" SG_ 962 VC_TIRE_FILL_ALERT_CSO 2720;
BA_ "FlexKomIsMotorola" SG_ 962 VC_TIRE_FILL_ALERT_CSO 1;
BA_ "FlexKomComment" SG_ 962 VC_TIRE_FILL_ALERT_CSO "veh config - customer settings menu 3 packet";
BA_ "GenSigSNA" SG_ 962 VC_TRAILER_LENGTH_BLIND_SPOT_CSO "0h";
BA_ "GenSigSendType" SG_ 962 VC_TRAILER_LENGTH_BLIND_SPOT_CSO 5;
BA_ "GenSigCycleTime" SG_ 962 VC_TRAILER_LENGTH_BLIND_SPOT_CSO 2000;
BA_ "FlexKomSigStartValue" SG_ 962 VC_TRAILER_LENGTH_BLIND_SPOT_CSO "0300000000000000h";
BA_ "FlexKomSigStartPos" SG_ 962 VC_TRAILER_LENGTH_BLIND_SPOT_CSO 7;
BA_ "FlexKomSigName" SG_ 962 VC_TRAILER_LENGTH_BLIND_SPOT_CSO "VehCfgCSM3_Pkt";
BA_ "FlexKomSigLaenge" SG_ 962 VC_TRAILER_LENGTH_BLIND_SPOT_CSO 64;
BA_ "FlexKomSID" SG_ 962 VC_TRAILER_LENGTH_BLIND_SPOT_CSO 2720;
BA_ "FlexKomIsMotorola" SG_ 962 VC_TRAILER_LENGTH_BLIND_SPOT_CSO 1;
BA_ "FlexKomComment" SG_ 962 VC_TRAILER_LENGTH_BLIND_SPOT_CSO "Vehicle configuration - customer settings menu 3 P";
BA_ "GenSigSNA" SG_ 962 VC_TRUNK_UNLOCK_ENABLE_CSO "0h";
BA_ "GenSigSendType" SG_ 962 VC_TRUNK_UNLOCK_ENABLE_CSO 5;
BA_ "GenSigCycleTime" SG_ 962 VC_TRUNK_UNLOCK_ENABLE_CSO 2000;
BA_ "FlexKomSigStartValue" SG_ 962 VC_TRUNK_UNLOCK_ENABLE_CSO "0300000000000000h";
BA_ "FlexKomSigStartPos" SG_ 962 VC_TRUNK_UNLOCK_ENABLE_CSO 7;
BA_ "FlexKomSigName" SG_ 962 VC_TRUNK_UNLOCK_ENABLE_CSO "VehCfgCSM3_Pkt";
BA_ "FlexKomSigLaenge" SG_ 962 VC_TRUNK_UNLOCK_ENABLE_CSO 64;
BA_ "FlexKomSID" SG_ 962 VC_TRUNK_UNLOCK_ENABLE_CSO 2720;
BA_ "FlexKomIsMotorola" SG_ 962 VC_TRUNK_UNLOCK_ENABLE_CSO 1;
BA_ "FlexKomComment" SG_ 962 VC_TRUNK_UNLOCK_ENABLE_CSO "Vehicle configuration - customer settings menu 3 P";
BA_ "GenSigSNA" SG_ 962 VC_TSI_CSO "0h";
BA_ "GenSigSendType" SG_ 962 VC_TSI_CSO 5;
BA_ "GenSigCycleTime" SG_ 962 VC_TSI_CSO 2000;
BA_ "FlexKomSigStartValue" SG_ 962 VC_TSI_CSO "0300000000000000h";
BA_ "FlexKomSigStartPos" SG_ 962 VC_TSI_CSO 7;
BA_ "FlexKomSigName" SG_ 962 VC_TSI_CSO "VehCfgCSM3_Pkt";
BA_ "FlexKomSigLaenge" SG_ 962 VC_TSI_CSO 64;
BA_ "FlexKomSID" SG_ 962 VC_TSI_CSO 2720;
BA_ "FlexKomIsMotorola" SG_ 962 VC_TSI_CSO 1;
BA_ "FlexKomComment" SG_ 962 VC_TSI_CSO "Vehicle configuration - customer settings menu 3 P";
BA_ "GenSigSNA" SG_ 962 VC_TSR_WARNING_MODE_CSO "0h";
BA_ "GenSigSendType" SG_ 962 VC_TSR_WARNING_MODE_CSO 5;
BA_ "GenSigCycleTime" SG_ 962 VC_TSR_WARNING_MODE_CSO 2000;
BA_ "FlexKomSigStartValue" SG_ 962 VC_TSR_WARNING_MODE_CSO "0300000000000000h";
BA_ "FlexKomSigStartPos" SG_ 962 VC_TSR_WARNING_MODE_CSO 7;
BA_ "FlexKomSigName" SG_ 962 VC_TSR_WARNING_MODE_CSO "VehCfgCSM3_Pkt";
BA_ "FlexKomSigLaenge" SG_ 962 VC_TSR_WARNING_MODE_CSO 64;
BA_ "FlexKomSID" SG_ 962 VC_TSR_WARNING_MODE_CSO 2720;
BA_ "FlexKomIsMotorola" SG_ 962 VC_TSR_WARNING_MODE_CSO 1;
BA_ "FlexKomComment" SG_ 962 VC_TSR_WARNING_MODE_CSO "Vehicle configuration - customer settings menu 3 P";
BA_ "GenSigSNA" SG_ 962 VC_TSR_WARNING_MODE_OFFSET_CSO "0h";
BA_ "GenSigSendType" SG_ 962 VC_TSR_WARNING_MODE_OFFSET_CSO 5;
BA_ "GenSigCycleTime" SG_ 962 VC_TSR_WARNING_MODE_OFFSET_CSO 2000;
BA_ "FlexKomSigStartValue" SG_ 962 VC_TSR_WARNING_MODE_OFFSET_CSO "0300000000000000h";
BA_ "FlexKomSigStartPos" SG_ 962 VC_TSR_WARNING_MODE_OFFSET_CSO 7;
BA_ "FlexKomSigName" SG_ 962 VC_TSR_WARNING_MODE_OFFSET_CSO "VehCfgCSM3_Pkt";
BA_ "FlexKomSigLaenge" SG_ 962 VC_TSR_WARNING_MODE_OFFSET_CSO 64;
BA_ "FlexKomSID" SG_ 962 VC_TSR_WARNING_MODE_OFFSET_CSO 2720;
BA_ "FlexKomIsMotorola" SG_ 962 VC_TSR_WARNING_MODE_OFFSET_CSO 1;
BA_ "FlexKomComment" SG_ 962 VC_TSR_WARNING_MODE_OFFSET_CSO "Vehicle configuration - customer settings menu 3 P";
BA_ "GenSigSNA" SG_ 962 VC_VISM_KEEP_AWAKE_CSO "0h";
BA_ "GenSigSendType" SG_ 962 VC_VISM_KEEP_AWAKE_CSO 5;
BA_ "GenSigCycleTime" SG_ 962 VC_VISM_KEEP_AWAKE_CSO 2000;
BA_ "FlexKomSigStartValue" SG_ 962 VC_VISM_KEEP_AWAKE_CSO "0300000000000000h";
BA_ "FlexKomSigStartPos" SG_ 962 VC_VISM_KEEP_AWAKE_CSO 7;
BA_ "FlexKomSigName" SG_ 962 VC_VISM_KEEP_AWAKE_CSO "VehCfgCSM3_Pkt";
BA_ "FlexKomSigLaenge" SG_ 962 VC_VISM_KEEP_AWAKE_CSO 64;
BA_ "FlexKomSID" SG_ 962 VC_VISM_KEEP_AWAKE_CSO 2720;
BA_ "FlexKomIsMotorola" SG_ 962 VC_VISM_KEEP_AWAKE_CSO 1;
BA_ "FlexKomComment" SG_ 962 VC_VISM_KEEP_AWAKE_CSO "Vehicle configuration - customer settings menu 3 P";
BA_ "GenSigStartValue" SG_ 962 VC_VehCfgCSO3_Stat 3;
BA_ "GenSigSNA" SG_ 962 VC_VehCfgCSO3_Stat "3h";
BA_ "GenSigSendType" SG_ 962 VC_VehCfgCSO3_Stat 5;
BA_ "GenSigCycleTime" SG_ 962 VC_VehCfgCSO3_Stat 2000;
BA_ "FlexKomSigStartValue" SG_ 962 VC_VehCfgCSO3_Stat "0300000000000000h";
BA_ "FlexKomSigStartPos" SG_ 962 VC_VehCfgCSO3_Stat 7;
BA_ "FlexKomSigName" SG_ 962 VC_VehCfgCSO3_Stat "VehCfgCSM3_Pkt";
BA_ "FlexKomSigLaenge" SG_ 962 VC_VehCfgCSO3_Stat 64;
BA_ "FlexKomSID" SG_ 962 VC_VehCfgCSO3_Stat 2720;
BA_ "FlexKomIsMotorola" SG_ 962 VC_VehCfgCSO3_Stat 1;
BA_ "FlexKomComment" SG_ 962 VC_VehCfgCSO3_Stat "Vehicle configuration - customer settings menu 3 P";
BA_ "GenSigSNA" SG_ 962 VC_WIRELESS_CHARGER_CSO "0h";
BA_ "GenSigSendType" SG_ 962 VC_WIRELESS_CHARGER_CSO 5;
BA_ "GenSigCycleTime" SG_ 962 VC_WIRELESS_CHARGER_CSO 2000;
BA_ "FlexKomSigStartValue" SG_ 962 VC_WIRELESS_CHARGER_CSO "0300000000000000h";
BA_ "FlexKomSigStartPos" SG_ 962 VC_WIRELESS_CHARGER_CSO 7;
BA_ "FlexKomSigName" SG_ 962 VC_WIRELESS_CHARGER_CSO "VehCfgCSM3_Pkt";
BA_ "FlexKomSigLaenge" SG_ 962 VC_WIRELESS_CHARGER_CSO 64;
BA_ "FlexKomSID" SG_ 962 VC_WIRELESS_CHARGER_CSO 2720;
BA_ "FlexKomIsMotorola" SG_ 962 VC_WIRELESS_CHARGER_CSO 1;
BA_ "FlexKomComment" SG_ 962 VC_WIRELESS_CHARGER_CSO "Vehicle configuration - customer settings menu 3 P";
BA_ "GenSigSNA" SG_ 963 VC_BU_3RD_ROW_LOCK_CSO "0h";
BA_ "GenSigSendType" SG_ 963 VC_BU_3RD_ROW_LOCK_CSO 1;
BA_ "FlexKomSigStartValue" SG_ 963 VC_BU_3RD_ROW_LOCK_CSO "0300000000000000h";
BA_ "FlexKomSigStartPos" SG_ 963 VC_BU_3RD_ROW_LOCK_CSO 7;
BA_ "FlexKomSigName" SG_ 963 VC_BU_3RD_ROW_LOCK_CSO "VehCfgCSM3_BuPkt";
BA_ "FlexKomSigLaenge" SG_ 963 VC_BU_3RD_ROW_LOCK_CSO 64;
BA_ "FlexKomSID" SG_ 963 VC_BU_3RD_ROW_LOCK_CSO 2721;
BA_ "FlexKomIsMotorola" SG_ 963 VC_BU_3RD_ROW_LOCK_CSO 1;
BA_ "FlexKomComment" SG_ 963 VC_BU_3RD_ROW_LOCK_CSO "Backup for veh config - customer settings menu 3 p";
BA_ "GenSigSNA" SG_ 963 VC_BU_AL_FFC_OR_PLUS_CSO "0h";
BA_ "GenSigSendType" SG_ 963 VC_BU_AL_FFC_OR_PLUS_CSO 1;
BA_ "FlexKomSigStartValue" SG_ 963 VC_BU_AL_FFC_OR_PLUS_CSO "0300000000000000h";
BA_ "FlexKomSigStartPos" SG_ 963 VC_BU_AL_FFC_OR_PLUS_CSO 7;
BA_ "FlexKomSigName" SG_ 963 VC_BU_AL_FFC_OR_PLUS_CSO "VehCfgCSM3_BuPkt";
BA_ "FlexKomSigLaenge" SG_ 963 VC_BU_AL_FFC_OR_PLUS_CSO 64;
BA_ "FlexKomSID" SG_ 963 VC_BU_AL_FFC_OR_PLUS_CSO 2721;
BA_ "FlexKomIsMotorola" SG_ 963 VC_BU_AL_FFC_OR_PLUS_CSO 1;
BA_ "FlexKomComment" SG_ 963 VC_BU_AL_FFC_OR_PLUS_CSO "Backup for veh config - customer settings menu 3 p";
BA_ "GenSigSNA" SG_ 963 VC_BU_AL_OR_PLUS_CSO "0h";
BA_ "GenSigSendType" SG_ 963 VC_BU_AL_OR_PLUS_CSO 1;
BA_ "FlexKomSigStartValue" SG_ 963 VC_BU_AL_OR_PLUS_CSO "0300000000000000h";
BA_ "FlexKomSigStartPos" SG_ 963 VC_BU_AL_OR_PLUS_CSO 7;
BA_ "FlexKomSigName" SG_ 963 VC_BU_AL_OR_PLUS_CSO "VehCfgCSM3_BuPkt";
BA_ "FlexKomSigLaenge" SG_ 963 VC_BU_AL_OR_PLUS_CSO 64;
BA_ "FlexKomSID" SG_ 963 VC_BU_AL_OR_PLUS_CSO 2721;
BA_ "FlexKomIsMotorola" SG_ 963 VC_BU_AL_OR_PLUS_CSO 1;
BA_ "FlexKomComment" SG_ 963 VC_BU_AL_OR_PLUS_CSO "Backup for veh config - customer settings menu 3 p";
BA_ "GenSigSNA" SG_ 963 VC_BU_AUTO_STOP_START_CSO "0h";
BA_ "GenSigSendType" SG_ 963 VC_BU_AUTO_STOP_START_CSO 1;
BA_ "FlexKomSigStartValue" SG_ 963 VC_BU_AUTO_STOP_START_CSO "0300000000000000h";
BA_ "FlexKomSigStartPos" SG_ 963 VC_BU_AUTO_STOP_START_CSO 7;
BA_ "FlexKomSigName" SG_ 963 VC_BU_AUTO_STOP_START_CSO "VehCfgCSM3_BuPkt";
BA_ "FlexKomSigLaenge" SG_ 963 VC_BU_AUTO_STOP_START_CSO 64;
BA_ "FlexKomSID" SG_ 963 VC_BU_AUTO_STOP_START_CSO 2721;
BA_ "FlexKomIsMotorola" SG_ 963 VC_BU_AUTO_STOP_START_CSO 1;
BA_ "FlexKomComment" SG_ 963 VC_BU_AUTO_STOP_START_CSO "Backup for veh config - customer settings menu 3 p";
BA_ "GenSigSNA" SG_ 963 VC_BU_Auto_Activ_PerfPage_CSO "0h";
BA_ "GenSigSendType" SG_ 963 VC_BU_Auto_Activ_PerfPage_CSO 1;
BA_ "FlexKomSigStartValue" SG_ 963 VC_BU_Auto_Activ_PerfPage_CSO "0300000000000000h";
BA_ "FlexKomSigStartPos" SG_ 963 VC_BU_Auto_Activ_PerfPage_CSO 7;
BA_ "FlexKomSigName" SG_ 963 VC_BU_Auto_Activ_PerfPage_CSO "VehCfgCSM3_BuPkt";
BA_ "FlexKomSigLaenge" SG_ 963 VC_BU_Auto_Activ_PerfPage_CSO 64;
BA_ "FlexKomSID" SG_ 963 VC_BU_Auto_Activ_PerfPage_CSO 2721;
BA_ "FlexKomIsMotorola" SG_ 963 VC_BU_Auto_Activ_PerfPage_CSO 1;
BA_ "FlexKomComment" SG_ 963 VC_BU_Auto_Activ_PerfPage_CSO "Backup for veh config - customer settings menu 3 p";
BA_ "GenSigSNA" SG_ 963 VC_BU_BACKUP_ALARM_CSO "0h";
BA_ "GenSigSendType" SG_ 963 VC_BU_BACKUP_ALARM_CSO 1;
BA_ "FlexKomSigStartValue" SG_ 963 VC_BU_BACKUP_ALARM_CSO "0300000000000000h";
BA_ "FlexKomSigStartPos" SG_ 963 VC_BU_BACKUP_ALARM_CSO 7;
BA_ "FlexKomSigName" SG_ 963 VC_BU_BACKUP_ALARM_CSO "VehCfgCSM3_BuPkt";
BA_ "FlexKomSigLaenge" SG_ 963 VC_BU_BACKUP_ALARM_CSO 64;
BA_ "FlexKomSID" SG_ 963 VC_BU_BACKUP_ALARM_CSO 2721;
BA_ "FlexKomIsMotorola" SG_ 963 VC_BU_BACKUP_ALARM_CSO 1;
BA_ "FlexKomComment" SG_ 963 VC_BU_BACKUP_ALARM_CSO "Backup for veh config - customer settings menu 3 p";
BA_ "GenSigSNA" SG_ 963 VC_BU_BUZZER_VOLUME_LEVEL_CSO "0h";
BA_ "GenSigSendType" SG_ 963 VC_BU_BUZZER_VOLUME_LEVEL_CSO 1;
BA_ "FlexKomSigStartValue" SG_ 963 VC_BU_BUZZER_VOLUME_LEVEL_CSO "0300000000000000h";
BA_ "FlexKomSigStartPos" SG_ 963 VC_BU_BUZZER_VOLUME_LEVEL_CSO 7;
BA_ "FlexKomSigName" SG_ 963 VC_BU_BUZZER_VOLUME_LEVEL_CSO "VehCfgCSM3_BuPkt";
BA_ "FlexKomSigLaenge" SG_ 963 VC_BU_BUZZER_VOLUME_LEVEL_CSO 64;
BA_ "FlexKomSID" SG_ 963 VC_BU_BUZZER_VOLUME_LEVEL_CSO 2721;
BA_ "FlexKomIsMotorola" SG_ 963 VC_BU_BUZZER_VOLUME_LEVEL_CSO 1;
BA_ "FlexKomComment" SG_ 963 VC_BU_BUZZER_VOLUME_LEVEL_CSO "Backup for veh config - customer settings menu 3 p";
BA_ "GenSigSNA" SG_ 963 VC_BU_CHARGE_LOW_POPUP_CSO "0h";
BA_ "GenSigSendType" SG_ 963 VC_BU_CHARGE_LOW_POPUP_CSO 1;
BA_ "FlexKomSigStartValue" SG_ 963 VC_BU_CHARGE_LOW_POPUP_CSO "0300000000000000h";
BA_ "FlexKomSigStartPos" SG_ 963 VC_BU_CHARGE_LOW_POPUP_CSO 7;
BA_ "FlexKomSigName" SG_ 963 VC_BU_CHARGE_LOW_POPUP_CSO "VehCfgCSM3_BuPkt";
BA_ "FlexKomSigLaenge" SG_ 963 VC_BU_CHARGE_LOW_POPUP_CSO 64;
BA_ "FlexKomSID" SG_ 963 VC_BU_CHARGE_LOW_POPUP_CSO 2721;
BA_ "FlexKomIsMotorola" SG_ 963 VC_BU_CHARGE_LOW_POPUP_CSO 1;
BA_ "FlexKomComment" SG_ 963 VC_BU_CHARGE_LOW_POPUP_CSO "Backup for veh config - customer settings menu 3 p";
BA_ "GenSigSNA" SG_ 963 VC_BU_CHMSL_DYN_CNTR_CSO "0h";
BA_ "GenSigSendType" SG_ 963 VC_BU_CHMSL_DYN_CNTR_CSO 1;
BA_ "FlexKomSigStartValue" SG_ 963 VC_BU_CHMSL_DYN_CNTR_CSO "0300000000000000h";
BA_ "FlexKomSigStartPos" SG_ 963 VC_BU_CHMSL_DYN_CNTR_CSO 7;
BA_ "FlexKomSigName" SG_ 963 VC_BU_CHMSL_DYN_CNTR_CSO "VehCfgCSM3_BuPkt";
BA_ "FlexKomSigLaenge" SG_ 963 VC_BU_CHMSL_DYN_CNTR_CSO 64;
BA_ "FlexKomSID" SG_ 963 VC_BU_CHMSL_DYN_CNTR_CSO 2721;
BA_ "FlexKomIsMotorola" SG_ 963 VC_BU_CHMSL_DYN_CNTR_CSO 1;
BA_ "FlexKomComment" SG_ 963 VC_BU_CHMSL_DYN_CNTR_CSO "Backup for veh config - customer settings menu 3 p";
BA_ "GenSigSNA" SG_ 963 VC_BU_ESAVE_BATT_LVL_CSO "0h";
BA_ "GenSigSendType" SG_ 963 VC_BU_ESAVE_BATT_LVL_CSO 1;
BA_ "FlexKomSigStartValue" SG_ 963 VC_BU_ESAVE_BATT_LVL_CSO "0300000000000000h";
BA_ "FlexKomSigStartPos" SG_ 963 VC_BU_ESAVE_BATT_LVL_CSO 7;
BA_ "FlexKomSigName" SG_ 963 VC_BU_ESAVE_BATT_LVL_CSO "VehCfgCSM3_BuPkt";
BA_ "FlexKomSigLaenge" SG_ 963 VC_BU_ESAVE_BATT_LVL_CSO 64;
BA_ "FlexKomSID" SG_ 963 VC_BU_ESAVE_BATT_LVL_CSO 2721;
BA_ "FlexKomIsMotorola" SG_ 963 VC_BU_ESAVE_BATT_LVL_CSO 1;
BA_ "FlexKomComment" SG_ 963 VC_BU_ESAVE_BATT_LVL_CSO "Backup E-Save Battery Level customer settings menu";
BA_ "GenSigSNA" SG_ 963 VC_BU_ESAVE_CSO "0h";
BA_ "GenSigSendType" SG_ 963 VC_BU_ESAVE_CSO 1;
BA_ "FlexKomSigStartValue" SG_ 963 VC_BU_ESAVE_CSO "0300000000000000h";
BA_ "FlexKomSigStartPos" SG_ 963 VC_BU_ESAVE_CSO 7;
BA_ "FlexKomSigName" SG_ 963 VC_BU_ESAVE_CSO "VehCfgCSM3_BuPkt";
BA_ "FlexKomSigLaenge" SG_ 963 VC_BU_ESAVE_CSO 64;
BA_ "FlexKomSID" SG_ 963 VC_BU_ESAVE_CSO 2721;
BA_ "FlexKomIsMotorola" SG_ 963 VC_BU_ESAVE_CSO 1;
BA_ "FlexKomComment" SG_ 963 VC_BU_ESAVE_CSO "Backup E-Save Enable/Disable customer settings menu";
BA_ "GenSigSNA" SG_ 963 VC_BU_EXTERNAL_LIGHT_SENSOR_CSO "0h";
BA_ "GenSigSendType" SG_ 963 VC_BU_EXTERNAL_LIGHT_SENSOR_CSO 1;
BA_ "FlexKomSigStartValue" SG_ 963 VC_BU_EXTERNAL_LIGHT_SENSOR_CSO "0300000000000000h";
BA_ "FlexKomSigStartPos" SG_ 963 VC_BU_EXTERNAL_LIGHT_SENSOR_CSO 7;
BA_ "FlexKomSigName" SG_ 963 VC_BU_EXTERNAL_LIGHT_SENSOR_CSO "VehCfgCSM3_BuPkt";
BA_ "FlexKomSigLaenge" SG_ 963 VC_BU_EXTERNAL_LIGHT_SENSOR_CSO 64;
BA_ "FlexKomSID" SG_ 963 VC_BU_EXTERNAL_LIGHT_SENSOR_CSO 2721;
BA_ "FlexKomIsMotorola" SG_ 963 VC_BU_EXTERNAL_LIGHT_SENSOR_CSO 1;
BA_ "FlexKomComment" SG_ 963 VC_BU_EXTERNAL_LIGHT_SENSOR_CSO "Backup for veh config - customer settings menu 3 p";
BA_ "GenSigSNA" SG_ 963 VC_BU_FFC_GRIDLINES_CSO "0h";
BA_ "GenSigSendType" SG_ 963 VC_BU_FFC_GRIDLINES_CSO 1;
BA_ "FlexKomSigStartValue" SG_ 963 VC_BU_FFC_GRIDLINES_CSO "0300000000000000h";
BA_ "FlexKomSigStartPos" SG_ 963 VC_BU_FFC_GRIDLINES_CSO 7;
BA_ "FlexKomSigName" SG_ 963 VC_BU_FFC_GRIDLINES_CSO "VehCfgCSM3_BuPkt";
BA_ "FlexKomSigLaenge" SG_ 963 VC_BU_FFC_GRIDLINES_CSO 64;
BA_ "FlexKomSID" SG_ 963 VC_BU_FFC_GRIDLINES_CSO 2721;
BA_ "FlexKomIsMotorola" SG_ 963 VC_BU_FFC_GRIDLINES_CSO 1;
BA_ "FlexKomComment" SG_ 963 VC_BU_FFC_GRIDLINES_CSO "Backup for veh config - customer settings menu 3 p";
BA_ "GenSigSNA" SG_ 963 VC_BU_FOBIK_SAFE_CSO "0h";
BA_ "GenSigSendType" SG_ 963 VC_BU_FOBIK_SAFE_CSO 1;
BA_ "FlexKomSigStartValue" SG_ 963 VC_BU_FOBIK_SAFE_CSO "0300000000000000h";
BA_ "FlexKomSigStartPos" SG_ 963 VC_BU_FOBIK_SAFE_CSO 7;
BA_ "FlexKomSigName" SG_ 963 VC_BU_FOBIK_SAFE_CSO "VehCfgCSM3_BuPkt";
BA_ "FlexKomSigLaenge" SG_ 963 VC_BU_FOBIK_SAFE_CSO 64;
BA_ "FlexKomSID" SG_ 963 VC_BU_FOBIK_SAFE_CSO 2721;
BA_ "FlexKomIsMotorola" SG_ 963 VC_BU_FOBIK_SAFE_CSO 1;
BA_ "FlexKomComment" SG_ 963 VC_BU_FOBIK_SAFE_CSO "Backup for veh config - customer settings menu 3 p";
BA_ "GenSigSNA" SG_ 963 VC_BU_FOB_LEFT_VEHICLE_CHIME_CSO "0h";
BA_ "GenSigSendType" SG_ 963 VC_BU_FOB_LEFT_VEHICLE_CHIME_CSO 1;
BA_ "FlexKomSigStartValue" SG_ 963 VC_BU_FOB_LEFT_VEHICLE_CHIME_CSO "0300000000000000h";
BA_ "FlexKomSigStartPos" SG_ 963 VC_BU_FOB_LEFT_VEHICLE_CHIME_CSO 7;
BA_ "FlexKomSigName" SG_ 963 VC_BU_FOB_LEFT_VEHICLE_CHIME_CSO "VehCfgCSM3_BuPkt";
BA_ "FlexKomSigLaenge" SG_ 963 VC_BU_FOB_LEFT_VEHICLE_CHIME_CSO 64;
BA_ "FlexKomSID" SG_ 963 VC_BU_FOB_LEFT_VEHICLE_CHIME_CSO 2721;
BA_ "FlexKomIsMotorola" SG_ 963 VC_BU_FOB_LEFT_VEHICLE_CHIME_CSO 1;
BA_ "FlexKomComment" SG_ 963 VC_BU_FOB_LEFT_VEHICLE_CHIME_CSO "Backup for veh config - customer settings menu 3 p";
BA_ "GenSigSNA" SG_ 963 VC_BU_FT_PK_LOOSE_SHIP_CSO "0h";
BA_ "GenSigSendType" SG_ 963 VC_BU_FT_PK_LOOSE_SHIP_CSO 1;
BA_ "FlexKomSigStartValue" SG_ 963 VC_BU_FT_PK_LOOSE_SHIP_CSO "0300000000000000h";
BA_ "FlexKomSigStartPos" SG_ 963 VC_BU_FT_PK_LOOSE_SHIP_CSO 7;
BA_ "FlexKomSigName" SG_ 963 VC_BU_FT_PK_LOOSE_SHIP_CSO "VehCfgCSM3_BuPkt";
BA_ "FlexKomSigLaenge" SG_ 963 VC_BU_FT_PK_LOOSE_SHIP_CSO 64;
BA_ "FlexKomSID" SG_ 963 VC_BU_FT_PK_LOOSE_SHIP_CSO 2721;
BA_ "FlexKomIsMotorola" SG_ 963 VC_BU_FT_PK_LOOSE_SHIP_CSO 1;
BA_ "FlexKomComment" SG_ 963 VC_BU_FT_PK_LOOSE_SHIP_CSO "Backup for veh config - customer settings menu 3 p";
BA_ "GenSigSNA" SG_ 963 VC_BU_HWRSS_CSO "0h";
BA_ "GenSigSendType" SG_ 963 VC_BU_HWRSS_CSO 1;
BA_ "FlexKomSigStartValue" SG_ 963 VC_BU_HWRSS_CSO "0300000000000000h";
BA_ "FlexKomSigStartPos" SG_ 963 VC_BU_HWRSS_CSO 7;
BA_ "FlexKomSigName" SG_ 963 VC_BU_HWRSS_CSO "VehCfgCSM3_BuPkt";
BA_ "FlexKomSigLaenge" SG_ 963 VC_BU_HWRSS_CSO 64;
BA_ "FlexKomSID" SG_ 963 VC_BU_HWRSS_CSO 2721;
BA_ "FlexKomIsMotorola" SG_ 963 VC_BU_HWRSS_CSO 1;
BA_ "FlexKomComment" SG_ 963 VC_BU_HWRSS_CSO "Backup for veh config - customer settings menu 3 p";
BA_ "GenSigSNA" SG_ 963 VC_BU_LIFT_GATE_RELEASE_CSO "0h";
BA_ "GenSigSendType" SG_ 963 VC_BU_LIFT_GATE_RELEASE_CSO 1;
BA_ "FlexKomSigStartValue" SG_ 963 VC_BU_LIFT_GATE_RELEASE_CSO "0300000000000000h";
BA_ "FlexKomSigStartPos" SG_ 963 VC_BU_LIFT_GATE_RELEASE_CSO 7;
BA_ "FlexKomSigName" SG_ 963 VC_BU_LIFT_GATE_RELEASE_CSO "VehCfgCSM3_BuPkt";
BA_ "FlexKomSigLaenge" SG_ 963 VC_BU_LIFT_GATE_RELEASE_CSO 64;
BA_ "FlexKomSID" SG_ 963 VC_BU_LIFT_GATE_RELEASE_CSO 2721;
BA_ "FlexKomIsMotorola" SG_ 963 VC_BU_LIFT_GATE_RELEASE_CSO 1;
BA_ "FlexKomComment" SG_ 963 VC_BU_LIFT_GATE_RELEASE_CSO "Backup for veh config - customer settings menu 3 p";
BA_ "GenSigSNA" SG_ 963 VC_BU_LKA_SENS_CSO "0h";
BA_ "GenSigSendType" SG_ 963 VC_BU_LKA_SENS_CSO 1;
BA_ "FlexKomSigStartValue" SG_ 963 VC_BU_LKA_SENS_CSO "0300000000000000h";
BA_ "FlexKomSigStartPos" SG_ 963 VC_BU_LKA_SENS_CSO 7;
BA_ "FlexKomSigName" SG_ 963 VC_BU_LKA_SENS_CSO "VehCfgCSM3_BuPkt";
BA_ "FlexKomSigLaenge" SG_ 963 VC_BU_LKA_SENS_CSO 64;
BA_ "FlexKomSID" SG_ 963 VC_BU_LKA_SENS_CSO 2721;
BA_ "FlexKomIsMotorola" SG_ 963 VC_BU_LKA_SENS_CSO 1;
BA_ "FlexKomComment" SG_ 963 VC_BU_LKA_SENS_CSO "Backup for veh config - customer settings menu 3 p";
BA_ "GenSigSNA" SG_ 963 VC_BU_LKA_STRN_CSO "0h";
BA_ "GenSigSendType" SG_ 963 VC_BU_LKA_STRN_CSO 1;
BA_ "FlexKomSigStartValue" SG_ 963 VC_BU_LKA_STRN_CSO "0300000000000000h";
BA_ "FlexKomSigStartPos" SG_ 963 VC_BU_LKA_STRN_CSO 7;
BA_ "FlexKomSigName" SG_ 963 VC_BU_LKA_STRN_CSO "VehCfgCSM3_BuPkt";
BA_ "FlexKomSigLaenge" SG_ 963 VC_BU_LKA_STRN_CSO 64;
BA_ "FlexKomSID" SG_ 963 VC_BU_LKA_STRN_CSO 2721;
BA_ "FlexKomIsMotorola" SG_ 963 VC_BU_LKA_STRN_CSO 1;
BA_ "FlexKomComment" SG_ 963 VC_BU_LKA_STRN_CSO "Backup for veh config - customer settings menu 3 p";
BA_ "GenSigSNA" SG_ 963 VC_BU_LKA_WARNING_CSO "0h";
BA_ "GenSigSendType" SG_ 963 VC_BU_LKA_WARNING_CSO 1;
BA_ "FlexKomSigStartValue" SG_ 963 VC_BU_LKA_WARNING_CSO "0300000000000000h";
BA_ "FlexKomSigStartPos" SG_ 963 VC_BU_LKA_WARNING_CSO 7;
BA_ "FlexKomSigName" SG_ 963 VC_BU_LKA_WARNING_CSO "VehCfgCSM3_BuPkt";
BA_ "FlexKomSigLaenge" SG_ 963 VC_BU_LKA_WARNING_CSO 64;
BA_ "FlexKomSID" SG_ 963 VC_BU_LKA_WARNING_CSO 2721;
BA_ "FlexKomIsMotorola" SG_ 963 VC_BU_LKA_WARNING_CSO 1;
BA_ "FlexKomComment" SG_ 963 VC_BU_LKA_WARNING_CSO "Backup for veh config - customer settings menu 3 p";
BA_ "GenSigSNA" SG_ 963 VC_BU_PANIC_ALARM_CSO "0h";
BA_ "GenSigSendType" SG_ 963 VC_BU_PANIC_ALARM_CSO 1;
BA_ "FlexKomSigStartValue" SG_ 963 VC_BU_PANIC_ALARM_CSO "0300000000000000h";
BA_ "FlexKomSigStartPos" SG_ 963 VC_BU_PANIC_ALARM_CSO 7;
BA_ "FlexKomSigName" SG_ 963 VC_BU_PANIC_ALARM_CSO "VehCfgCSM3_BuPkt";
BA_ "FlexKomSigLaenge" SG_ 963 VC_BU_PANIC_ALARM_CSO 64;
BA_ "FlexKomSID" SG_ 963 VC_BU_PANIC_ALARM_CSO 2721;
BA_ "FlexKomIsMotorola" SG_ 963 VC_BU_PANIC_ALARM_CSO 1;
BA_ "FlexKomComment" SG_ 963 VC_BU_PANIC_ALARM_CSO "Backup for veh config - customer settings menu 3 p";
BA_ "GenSigSNA" SG_ 963 VC_BU_PEB_CSO "0h";
BA_ "GenSigSendType" SG_ 963 VC_BU_PEB_CSO 1;
BA_ "FlexKomSigStartValue" SG_ 963 VC_BU_PEB_CSO "0300000000000000h";
BA_ "FlexKomSigStartPos" SG_ 963 VC_BU_PEB_CSO 7;
BA_ "FlexKomSigName" SG_ 963 VC_BU_PEB_CSO "VehCfgCSM3_BuPkt";
BA_ "FlexKomSigLaenge" SG_ 963 VC_BU_PEB_CSO 64;
BA_ "FlexKomSID" SG_ 963 VC_BU_PEB_CSO 2721;
BA_ "FlexKomIsMotorola" SG_ 963 VC_BU_PEB_CSO 1;
BA_ "FlexKomComment" SG_ 963 VC_BU_PEB_CSO "Backup for veh config - customer settings menu 3 p";
BA_ "GenSigSNA" SG_ 963 VC_BU_POWER_SIDE_STEP_CSO "0h";
BA_ "GenSigSendType" SG_ 963 VC_BU_POWER_SIDE_STEP_CSO 1;
BA_ "FlexKomSigStartValue" SG_ 963 VC_BU_POWER_SIDE_STEP_CSO "0300000000000000h";
BA_ "FlexKomSigStartPos" SG_ 963 VC_BU_POWER_SIDE_STEP_CSO 7;
BA_ "FlexKomSigName" SG_ 963 VC_BU_POWER_SIDE_STEP_CSO "VehCfgCSM3_BuPkt";
BA_ "FlexKomSigLaenge" SG_ 963 VC_BU_POWER_SIDE_STEP_CSO 64;
BA_ "FlexKomSID" SG_ 963 VC_BU_POWER_SIDE_STEP_CSO 2721;
BA_ "FlexKomIsMotorola" SG_ 963 VC_BU_POWER_SIDE_STEP_CSO 1;
BA_ "FlexKomComment" SG_ 963 VC_BU_POWER_SIDE_STEP_CSO "Backup for veh config - customer settings menu 3 p";
BA_ "GenSigSNA" SG_ 963 VC_BU_RR_CARGO_GUIDE_LGT_CSO "0h";
BA_ "GenSigSendType" SG_ 963 VC_BU_RR_CARGO_GUIDE_LGT_CSO 1;
BA_ "FlexKomSigStartValue" SG_ 963 VC_BU_RR_CARGO_GUIDE_LGT_CSO "0300000000000000h";
BA_ "FlexKomSigStartPos" SG_ 963 VC_BU_RR_CARGO_GUIDE_LGT_CSO 7;
BA_ "FlexKomSigName" SG_ 963 VC_BU_RR_CARGO_GUIDE_LGT_CSO "VehCfgCSM3_BuPkt";
BA_ "FlexKomSigLaenge" SG_ 963 VC_BU_RR_CARGO_GUIDE_LGT_CSO 64;
BA_ "FlexKomSID" SG_ 963 VC_BU_RR_CARGO_GUIDE_LGT_CSO 2721;
BA_ "FlexKomIsMotorola" SG_ 963 VC_BU_RR_CARGO_GUIDE_LGT_CSO 1;
BA_ "FlexKomComment" SG_ 963 VC_BU_RR_CARGO_GUIDE_LGT_CSO "Backup for veh config - customer settings menu 3 p";
BA_ "GenSigSNA" SG_ 963 VC_BU_RR_PK_LOOSE_SHIP_CSO "0h";
BA_ "GenSigSendType" SG_ 963 VC_BU_RR_PK_LOOSE_SHIP_CSO 1;
BA_ "FlexKomSigStartValue" SG_ 963 VC_BU_RR_PK_LOOSE_SHIP_CSO "0300000000000000h";
BA_ "FlexKomSigStartPos" SG_ 963 VC_BU_RR_PK_LOOSE_SHIP_CSO 7;
BA_ "FlexKomSigName" SG_ 963 VC_BU_RR_PK_LOOSE_SHIP_CSO "VehCfgCSM3_BuPkt";
BA_ "FlexKomSigLaenge" SG_ 963 VC_BU_RR_PK_LOOSE_SHIP_CSO 64;
BA_ "FlexKomSID" SG_ 963 VC_BU_RR_PK_LOOSE_SHIP_CSO 2721;
BA_ "FlexKomIsMotorola" SG_ 963 VC_BU_RR_PK_LOOSE_SHIP_CSO 1;
BA_ "FlexKomComment" SG_ 963 VC_BU_RR_PK_LOOSE_SHIP_CSO "Backup for veh config - customer settings menu 3 p";
BA_ "GenSigSNA" SG_ 963 VC_BU_RVC_CVPM_DGRID_CSO "0h";
BA_ "GenSigSendType" SG_ 963 VC_BU_RVC_CVPM_DGRID_CSO 1;
BA_ "FlexKomSigStartValue" SG_ 963 VC_BU_RVC_CVPM_DGRID_CSO "0300000000000000h";
BA_ "FlexKomSigStartPos" SG_ 963 VC_BU_RVC_CVPM_DGRID_CSO 7;
BA_ "FlexKomSigName" SG_ 963 VC_BU_RVC_CVPM_DGRID_CSO "VehCfgCSM3_BuPkt";
BA_ "FlexKomSigLaenge" SG_ 963 VC_BU_RVC_CVPM_DGRID_CSO 64;
BA_ "FlexKomSID" SG_ 963 VC_BU_RVC_CVPM_DGRID_CSO 2721;
BA_ "FlexKomIsMotorola" SG_ 963 VC_BU_RVC_CVPM_DGRID_CSO 1;
BA_ "FlexKomComment" SG_ 963 VC_BU_RVC_CVPM_DGRID_CSO "Backup for veh config - customer settings menu 3 p";
BA_ "GenSigSNA" SG_ 963 VC_BU_RVC_CVPM_SGRID_CSO "0h";
BA_ "GenSigSendType" SG_ 963 VC_BU_RVC_CVPM_SGRID_CSO 1;
BA_ "FlexKomSigStartValue" SG_ 963 VC_BU_RVC_CVPM_SGRID_CSO "0300000000000000h";
BA_ "FlexKomSigStartPos" SG_ 963 VC_BU_RVC_CVPM_SGRID_CSO 7;
BA_ "FlexKomSigName" SG_ 963 VC_BU_RVC_CVPM_SGRID_CSO "VehCfgCSM3_BuPkt";
BA_ "FlexKomSigLaenge" SG_ 963 VC_BU_RVC_CVPM_SGRID_CSO 64;
BA_ "FlexKomSID" SG_ 963 VC_BU_RVC_CVPM_SGRID_CSO 2721;
BA_ "FlexKomIsMotorola" SG_ 963 VC_BU_RVC_CVPM_SGRID_CSO 1;
BA_ "FlexKomComment" SG_ 963 VC_BU_RVC_CVPM_SGRID_CSO "Backup for veh config - customer settings menu 3 p";
BA_ "GenSigSNA" SG_ 963 VC_BU_SECURE_PARK_CSO "0h";
BA_ "GenSigSendType" SG_ 963 VC_BU_SECURE_PARK_CSO 1;
BA_ "FlexKomSigStartValue" SG_ 963 VC_BU_SECURE_PARK_CSO "0300000000000000h";
BA_ "FlexKomSigStartPos" SG_ 963 VC_BU_SECURE_PARK_CSO 7;
BA_ "FlexKomSigName" SG_ 963 VC_BU_SECURE_PARK_CSO "VehCfgCSM3_BuPkt";
BA_ "FlexKomSigLaenge" SG_ 963 VC_BU_SECURE_PARK_CSO 64;
BA_ "FlexKomSID" SG_ 963 VC_BU_SECURE_PARK_CSO 2721;
BA_ "FlexKomIsMotorola" SG_ 963 VC_BU_SECURE_PARK_CSO 1;
BA_ "FlexKomComment" SG_ 963 VC_BU_SECURE_PARK_CSO "Backup for veh config - customer settings menu 3 p";
BA_ "GenSigSNA" SG_ 963 VC_BU_SEIU_INPUT_WIRE_CSO "0h";
BA_ "GenSigSendType" SG_ 963 VC_BU_SEIU_INPUT_WIRE_CSO 1;
BA_ "FlexKomSigStartValue" SG_ 963 VC_BU_SEIU_INPUT_WIRE_CSO "0300000000000000h";
BA_ "FlexKomSigStartPos" SG_ 963 VC_BU_SEIU_INPUT_WIRE_CSO 7;
BA_ "FlexKomSigName" SG_ 963 VC_BU_SEIU_INPUT_WIRE_CSO "VehCfgCSM3_BuPkt";
BA_ "FlexKomSigLaenge" SG_ 963 VC_BU_SEIU_INPUT_WIRE_CSO 64;
BA_ "FlexKomSID" SG_ 963 VC_BU_SEIU_INPUT_WIRE_CSO 2721;
BA_ "FlexKomIsMotorola" SG_ 963 VC_BU_SEIU_INPUT_WIRE_CSO 1;
BA_ "FlexKomComment" SG_ 963 VC_BU_SEIU_INPUT_WIRE_CSO "Backup for veh config - customer settings menu 3 p";
BA_ "GenSigSNA" SG_ 963 VC_BU_SEIU_RPM_CSO "0h";
BA_ "GenSigSendType" SG_ 963 VC_BU_SEIU_RPM_CSO 1;
BA_ "FlexKomSigStartValue" SG_ 963 VC_BU_SEIU_RPM_CSO "0300000000000000h";
BA_ "FlexKomSigStartPos" SG_ 963 VC_BU_SEIU_RPM_CSO 7;
BA_ "FlexKomSigName" SG_ 963 VC_BU_SEIU_RPM_CSO "VehCfgCSM3_BuPkt";
BA_ "FlexKomSigLaenge" SG_ 963 VC_BU_SEIU_RPM_CSO 64;
BA_ "FlexKomSID" SG_ 963 VC_BU_SEIU_RPM_CSO 2721;
BA_ "FlexKomIsMotorola" SG_ 963 VC_BU_SEIU_RPM_CSO 1;
BA_ "FlexKomComment" SG_ 963 VC_BU_SEIU_RPM_CSO "Backup for veh config - customer settings menu 3 p";
BA_ "GenSigSNA" SG_ 963 VC_BU_SPEED_THRESHOLD_CSO "0h";
BA_ "GenSigSendType" SG_ 963 VC_BU_SPEED_THRESHOLD_CSO 1;
BA_ "FlexKomSigStartValue" SG_ 963 VC_BU_SPEED_THRESHOLD_CSO "0300000000000000h";
BA_ "FlexKomSigStartPos" SG_ 963 VC_BU_SPEED_THRESHOLD_CSO 7;
BA_ "FlexKomSigName" SG_ 963 VC_BU_SPEED_THRESHOLD_CSO "VehCfgCSM3_BuPkt";
BA_ "FlexKomSigLaenge" SG_ 963 VC_BU_SPEED_THRESHOLD_CSO 64;
BA_ "FlexKomSID" SG_ 963 VC_BU_SPEED_THRESHOLD_CSO 2721;
BA_ "FlexKomIsMotorola" SG_ 963 VC_BU_SPEED_THRESHOLD_CSO 1;
BA_ "FlexKomComment" SG_ 963 VC_BU_SPEED_THRESHOLD_CSO "Backup for veh config - customer settings menu 3 p";
BA_ "GenSigSNA" SG_ 963 VC_BU_THEFT_ALARM_CSO "0h";
BA_ "GenSigSendType" SG_ 963 VC_BU_THEFT_ALARM_CSO 1;
BA_ "FlexKomSigStartValue" SG_ 963 VC_BU_THEFT_ALARM_CSO "0300000000000000h";
BA_ "FlexKomSigStartPos" SG_ 963 VC_BU_THEFT_ALARM_CSO 7;
BA_ "FlexKomSigName" SG_ 963 VC_BU_THEFT_ALARM_CSO "VehCfgCSM3_BuPkt";
BA_ "FlexKomSigLaenge" SG_ 963 VC_BU_THEFT_ALARM_CSO 64;
BA_ "FlexKomSID" SG_ 963 VC_BU_THEFT_ALARM_CSO 2721;
BA_ "FlexKomIsMotorola" SG_ 963 VC_BU_THEFT_ALARM_CSO 1;
BA_ "FlexKomComment" SG_ 963 VC_BU_THEFT_ALARM_CSO "Backup for veh config - customer settings menu 3 p";
BA_ "GenSigSNA" SG_ 963 VC_BU_TIRE_FILL_ALERT_CSO "0h";
BA_ "GenSigSendType" SG_ 963 VC_BU_TIRE_FILL_ALERT_CSO 1;
BA_ "FlexKomSigStartValue" SG_ 963 VC_BU_TIRE_FILL_ALERT_CSO "0300000000000000h";
BA_ "FlexKomSigStartPos" SG_ 963 VC_BU_TIRE_FILL_ALERT_CSO 7;
BA_ "FlexKomSigName" SG_ 963 VC_BU_TIRE_FILL_ALERT_CSO "VehCfgCSM3_BuPkt";
BA_ "FlexKomSigLaenge" SG_ 963 VC_BU_TIRE_FILL_ALERT_CSO 64;
BA_ "FlexKomSID" SG_ 963 VC_BU_TIRE_FILL_ALERT_CSO 2721;
BA_ "FlexKomIsMotorola" SG_ 963 VC_BU_TIRE_FILL_ALERT_CSO 1;
BA_ "FlexKomComment" SG_ 963 VC_BU_TIRE_FILL_ALERT_CSO "Backup for veh config - customer settings menu 3 p";
BA_ "GenSigSNA" SG_ 963 VC_BU_TRAILER_LENGTH_BLIND_SPOT_ "0h";
BA_ "GenSigSendType" SG_ 963 VC_BU_TRAILER_LENGTH_BLIND_SPOT_ 1;
BA_ "FlexKomSigStartValue" SG_ 963 VC_BU_TRAILER_LENGTH_BLIND_SPOT_ "0300000000000000h";
BA_ "FlexKomSigStartPos" SG_ 963 VC_BU_TRAILER_LENGTH_BLIND_SPOT_ 7;
BA_ "FlexKomSigName" SG_ 963 VC_BU_TRAILER_LENGTH_BLIND_SPOT_ "VehCfgCSM3_BuPkt";
BA_ "FlexKomSigLaenge" SG_ 963 VC_BU_TRAILER_LENGTH_BLIND_SPOT_ 64;
BA_ "FlexKomSID" SG_ 963 VC_BU_TRAILER_LENGTH_BLIND_SPOT_ 2721;
BA_ "FlexKomIsMotorola" SG_ 963 VC_BU_TRAILER_LENGTH_BLIND_SPOT_ 1;
BA_ "FlexKomComment" SG_ 963 VC_BU_TRAILER_LENGTH_BLIND_SPOT_ "Backup for veh config - customer settings menu 3 p";
BA_ "SystemSignalLongSymbol" SG_ 963 VC_BU_TRAILER_LENGTH_BLIND_SPOT_ "VC_BU_TRAILER_LENGTH_BLIND_SPOT_CSO";
BA_ "GenSigSNA" SG_ 963 VC_BU_TRUNK_UNLOCK_ENABLE_CSO "0h";
BA_ "GenSigSendType" SG_ 963 VC_BU_TRUNK_UNLOCK_ENABLE_CSO 1;
BA_ "FlexKomSigStartValue" SG_ 963 VC_BU_TRUNK_UNLOCK_ENABLE_CSO "0300000000000000h";
BA_ "FlexKomSigStartPos" SG_ 963 VC_BU_TRUNK_UNLOCK_ENABLE_CSO 7;
BA_ "FlexKomSigName" SG_ 963 VC_BU_TRUNK_UNLOCK_ENABLE_CSO "VehCfgCSM3_BuPkt";
BA_ "FlexKomSigLaenge" SG_ 963 VC_BU_TRUNK_UNLOCK_ENABLE_CSO 64;
BA_ "FlexKomSID" SG_ 963 VC_BU_TRUNK_UNLOCK_ENABLE_CSO 2721;
BA_ "FlexKomIsMotorola" SG_ 963 VC_BU_TRUNK_UNLOCK_ENABLE_CSO 1;
BA_ "FlexKomComment" SG_ 963 VC_BU_TRUNK_UNLOCK_ENABLE_CSO "Backup for veh config - customer settings menu 3 p";
BA_ "GenSigSNA" SG_ 963 VC_BU_TSI_CSO "0h";
BA_ "GenSigSendType" SG_ 963 VC_BU_TSI_CSO 1;
BA_ "FlexKomSigStartValue" SG_ 963 VC_BU_TSI_CSO "0300000000000000h";
BA_ "FlexKomSigStartPos" SG_ 963 VC_BU_TSI_CSO 7;
BA_ "FlexKomSigName" SG_ 963 VC_BU_TSI_CSO "VehCfgCSM3_BuPkt";
BA_ "FlexKomSigLaenge" SG_ 963 VC_BU_TSI_CSO 64;
BA_ "FlexKomSID" SG_ 963 VC_BU_TSI_CSO 2721;
BA_ "FlexKomIsMotorola" SG_ 963 VC_BU_TSI_CSO 1;
BA_ "FlexKomComment" SG_ 963 VC_BU_TSI_CSO "Backup for veh config - customer settings menu 3 p";
BA_ "GenSigSNA" SG_ 963 VC_BU_TSR_WARNING_MODE_CSO "0h";
BA_ "GenSigSendType" SG_ 963 VC_BU_TSR_WARNING_MODE_CSO 1;
BA_ "FlexKomSigStartValue" SG_ 963 VC_BU_TSR_WARNING_MODE_CSO "0300000000000000h";
BA_ "FlexKomSigStartPos" SG_ 963 VC_BU_TSR_WARNING_MODE_CSO 7;
BA_ "FlexKomSigName" SG_ 963 VC_BU_TSR_WARNING_MODE_CSO "VehCfgCSM3_BuPkt";
BA_ "FlexKomSigLaenge" SG_ 963 VC_BU_TSR_WARNING_MODE_CSO 64;
BA_ "FlexKomSID" SG_ 963 VC_BU_TSR_WARNING_MODE_CSO 2721;
BA_ "FlexKomIsMotorola" SG_ 963 VC_BU_TSR_WARNING_MODE_CSO 1;
BA_ "FlexKomComment" SG_ 963 VC_BU_TSR_WARNING_MODE_CSO "Backup for veh config - customer settings menu 3 p";
BA_ "GenSigSNA" SG_ 963 VC_BU_TSR_WARNING_MODE_OFFSET_CS "0h";
BA_ "GenSigSendType" SG_ 963 VC_BU_TSR_WARNING_MODE_OFFSET_CS 1;
BA_ "FlexKomSigStartValue" SG_ 963 VC_BU_TSR_WARNING_MODE_OFFSET_CS "0300000000000000h";
BA_ "FlexKomSigStartPos" SG_ 963 VC_BU_TSR_WARNING_MODE_OFFSET_CS 7;
BA_ "FlexKomSigName" SG_ 963 VC_BU_TSR_WARNING_MODE_OFFSET_CS "VehCfgCSM3_BuPkt";
BA_ "FlexKomSigLaenge" SG_ 963 VC_BU_TSR_WARNING_MODE_OFFSET_CS 64;
BA_ "FlexKomSID" SG_ 963 VC_BU_TSR_WARNING_MODE_OFFSET_CS 2721;
BA_ "FlexKomIsMotorola" SG_ 963 VC_BU_TSR_WARNING_MODE_OFFSET_CS 1;
BA_ "FlexKomComment" SG_ 963 VC_BU_TSR_WARNING_MODE_OFFSET_CS "Backup for veh config - customer settings menu 3 p";
BA_ "SystemSignalLongSymbol" SG_ 963 VC_BU_TSR_WARNING_MODE_OFFSET_CS "VC_BU_TSR_WARNING_MODE_OFFSET_CSO";
BA_ "GenSigSNA" SG_ 963 VC_BU_VISM_KEEP_AWAKE_CSO "0h";
BA_ "GenSigSendType" SG_ 963 VC_BU_VISM_KEEP_AWAKE_CSO 1;
BA_ "FlexKomSigStartValue" SG_ 963 VC_BU_VISM_KEEP_AWAKE_CSO "0300000000000000h";
BA_ "FlexKomSigStartPos" SG_ 963 VC_BU_VISM_KEEP_AWAKE_CSO 7;
BA_ "FlexKomSigName" SG_ 963 VC_BU_VISM_KEEP_AWAKE_CSO "VehCfgCSM3_BuPkt";
BA_ "FlexKomSigLaenge" SG_ 963 VC_BU_VISM_KEEP_AWAKE_CSO 64;
BA_ "FlexKomSID" SG_ 963 VC_BU_VISM_KEEP_AWAKE_CSO 2721;
BA_ "FlexKomIsMotorola" SG_ 963 VC_BU_VISM_KEEP_AWAKE_CSO 1;
BA_ "FlexKomComment" SG_ 963 VC_BU_VISM_KEEP_AWAKE_CSO "Backup for veh config - customer settings menu 3 p";
BA_ "GenSigStartValue" SG_ 963 VC_BU_VehCfgCSO3_Stat 3;
BA_ "GenSigSNA" SG_ 963 VC_BU_VehCfgCSO3_Stat "0h";
BA_ "GenSigSendType" SG_ 963 VC_BU_VehCfgCSO3_Stat 1;
BA_ "FlexKomSigStartValue" SG_ 963 VC_BU_VehCfgCSO3_Stat "0300000000000000h";
BA_ "FlexKomSigStartPos" SG_ 963 VC_BU_VehCfgCSO3_Stat 7;
BA_ "FlexKomSigName" SG_ 963 VC_BU_VehCfgCSO3_Stat "VehCfgCSM3_BuPkt";
BA_ "FlexKomSigLaenge" SG_ 963 VC_BU_VehCfgCSO3_Stat 64;
BA_ "FlexKomSID" SG_ 963 VC_BU_VehCfgCSO3_Stat 2721;
BA_ "FlexKomIsMotorola" SG_ 963 VC_BU_VehCfgCSO3_Stat 1;
BA_ "FlexKomComment" SG_ 963 VC_BU_VehCfgCSO3_Stat "Backup for veh config - customer settings menu 3 p";
BA_ "GenSigSNA" SG_ 963 VC_BU_WIRELESS_CHARGER_CSO "0h";
BA_ "GenSigSendType" SG_ 963 VC_BU_WIRELESS_CHARGER_CSO 1;
BA_ "FlexKomSigStartValue" SG_ 963 VC_BU_WIRELESS_CHARGER_CSO "0300000000000000h";
BA_ "FlexKomSigStartPos" SG_ 963 VC_BU_WIRELESS_CHARGER_CSO 7;
BA_ "FlexKomSigName" SG_ 963 VC_BU_WIRELESS_CHARGER_CSO "VehCfgCSM3_BuPkt";
BA_ "FlexKomSigLaenge" SG_ 963 VC_BU_WIRELESS_CHARGER_CSO 64;
BA_ "FlexKomSID" SG_ 963 VC_BU_WIRELESS_CHARGER_CSO 2721;
BA_ "FlexKomIsMotorola" SG_ 963 VC_BU_WIRELESS_CHARGER_CSO 1;
BA_ "FlexKomComment" SG_ 963 VC_BU_WIRELESS_CHARGER_CSO "Backup for veh config - customer settings menu 3 p";
BA_ "GenSigSNA" SG_ 2047 WAKE_SGW_Signal "0h";
BA_ "GenSigSendType" SG_ 2047 WAKE_SGW_Signal 1;
BA_ "FlexKomSigStartValue" SG_ 2047 WAKE_SGW_Signal "00h";
BA_ "FlexKomSigStartPos" SG_ 2047 WAKE_SGW_Signal 7;
BA_ "FlexKomSigName" SG_ 2047 WAKE_SGW_Signal "WAKE_SGW_Signal";
BA_ "FlexKomSigLaenge" SG_ 2047 WAKE_SGW_Signal 8;
BA_ "FlexKomSID" SG_ 2047 WAKE_SGW_Signal 2669;
BA_ "FlexKomIsMotorola" SG_ 2047 WAKE_SGW_Signal 1;
BA_ "FlexKomComment" SG_ 2047 WAKE_SGW_Signal "This signal is used to wakeup networks";
BA_ "GenSigSNA" SG_ 47 BrkPdlRawStat "0h";
BA_ "GenSigCycleTime" SG_ 47 BrkPdlRawStat 10;
BA_ "FlexKomSigStartValue" SG_ 47 BrkPdlRawStat "0000h";
BA_ "FlexKomSigStartPos" SG_ 47 BrkPdlRawStat 39;
BA_ "FlexKomSigName" SG_ 47 BrkPdlRawStat "BrkPdlRawStat";
BA_ "FlexKomSigLaenge" SG_ 47 BrkPdlRawStat 16;
BA_ "FlexKomSID" SG_ 47 BrkPdlRawStat 2437;
BA_ "FlexKomIsMotorola" SG_ 47 BrkPdlRawStat 1;
BA_ "FlexKomComment" SG_ 47 BrkPdlRawStat "Brake pedal state raw value";
BA_ "GenSigSNA" SG_ 47 RAW_OBD_VEHACCEL_X "0h";
BA_ "GenSigCycleTime" SG_ 47 RAW_OBD_VEHACCEL_X 10;
BA_ "FlexKomSigStartValue" SG_ 47 RAW_OBD_VEHACCEL_X "00h";
BA_ "FlexKomSigStartPos" SG_ 47 RAW_OBD_VEHACCEL_X 55;
BA_ "FlexKomSigName" SG_ 47 RAW_OBD_VEHACCEL_X "RAW_OBD_VEHACCEL_X";
BA_ "FlexKomSigLaenge" SG_ 47 RAW_OBD_VEHACCEL_X 8;
BA_ "FlexKomSID" SG_ 47 RAW_OBD_VEHACCEL_X 2596;
BA_ "FlexKomIsMotorola" SG_ 47 RAW_OBD_VEHACCEL_X 1;
BA_ "FlexKomComment" SG_ 47 RAW_OBD_VEHACCEL_X "Raw vehicle acceleration in the X direction";
VAL_ 948 VC_SPEED_WARNING_CSO 0 "ABSENT" 1 "ONE" 2 "FIVE" ;
VAL_ 948 VC_VehCfgCSO2_Stat 0 "NA" 1 "PROGAMMED" 2 "REQUEST_DATA" 3 "SNA" ;
VAL_ 950 VC_BU_SPEED_WARNING_CSO 0 "ABSENT" 1 "ONE" 2 "FIVE" ;
VAL_ 950 VC_BU_VehCfgCSO2_Stat 0 "NA" 1 "PROGAMMED" 2 "REQUEST_DATA" 3 "SNA" ;
VAL_ 962 VC_AL_FFC_OR_PLUS_CSO 0 "Absent" 1 "Present" ;
VAL_ 962 VC_AL_OR_PLUS_CSO 0 "Absent" 1 "Present" ;
VAL_ 962 VC_AUTO_STOP_START_CSO 0 "Absent" 1 "Present" ;
VAL_ 962 VC_BUZZER_VOLUME_LEVEL_CSO 0 "Absent" 1 "Present" ;
VAL_ 962 VC_CHMSL_DYN_CNTR_CSO 0 "Absent" 1 "Present" ;
VAL_ 962 VC_ESAVE_BATT_LVL_CSO 0 "Absent" 1 "Present" ;
VAL_ 962 VC_ESAVE_CSO 0 "Absent" 1 "Present" ;
VAL_ 962 VC_EXTERNAL_LIGHT_SENSOR_CSO 0 "Absent" 1 "Present" ;
VAL_ 962 VC_PEB_CSO 0 "Absent" 1 "Present" ;
VAL_ 962 VC_SPEED_THRESHOLD_CSO 0 "Absent" 1 "Present" ;
VAL_ 962 VC_TRUNK_UNLOCK_ENABLE_CSO 0 "Absent" 1 "Present" ;
VAL_ 962 VC_VehCfgCSO3_Stat 0 "NA" 1 "PROGAMMED" 2 "REQUEST_DATA" 3 "SNA" ;
VAL_ 963 VC_BU_AL_FFC_OR_PLUS_CSO 0 "Absent" 1 "Present" ;
VAL_ 963 VC_BU_AL_OR_PLUS_CSO 0 "Absent" 1 "Present" ;
VAL_ 963 VC_BU_AUTO_STOP_START_CSO 0 "Absent" 1 "Present" ;
VAL_ 963 VC_BU_BUZZER_VOLUME_LEVEL_CSO 0 "Absent" 1 "Present" ;
VAL_ 963 VC_BU_CHMSL_DYN_CNTR_CSO 0 "Absent" 1 "Present" ;
VAL_ 963 VC_BU_ESAVE_BATT_LVL_CSO 0 "Absent" 1 "Present" ;
VAL_ 963 VC_BU_ESAVE_CSO 0 "Absent" 1 "Present" ;
VAL_ 963 VC_BU_EXTERNAL_LIGHT_SENSOR_CSO 0 "Absent" 1 "Present" ;
VAL_ 963 VC_BU_PEB_CSO 0 "Absent" 1 "Present" ;
VAL_ 963 VC_BU_SPEED_THRESHOLD_CSO 0 "Absent" 1 "Present" ;
VAL_ 963 VC_BU_TRUNK_UNLOCK_ENABLE_CSO 0 "Absent" 1 "Present" ;
VAL_ 963 VC_BU_VehCfgCSO3_Stat 0 "NA" 1 "PROGAMMED" 2 "REQUEST_DATA" 3 "SNA" ;
